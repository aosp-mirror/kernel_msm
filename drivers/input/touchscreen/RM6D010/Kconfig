## drivers/net/wireless/bcmdhd/Kconfig
```kconfig
config BCMDHD
	tristate "Broadcom FullMAC wireless cards support"
	---help---
	  This module adds support for wireless adapters based on
	  Broadcom FullMAC chipset.

	  If you choose to build a module, it'll be called dhd. Say M if
	  unsure.

config BCMDHD_SDIO
	bool "SDIO bus interface support"
	depends on BCMDHD && MMC
        default y

config BCMDHD_PCIE
	bool "PCIe bus interface support"
	depends on BCMDHD && PCI && !BCMDHD_SDIO

config BCM4354
	tristate "BCM4354 support"
	depends on BCMDHD

config BCM4356
	tristate "BCM4356 support"
	depends on BCMDHD
	default n

config BCMDHD_SEMCO_FW_PATH
	depends on BCMDHD
	string "Semco Firmware path"
	default "/system/vendor/firmware/semco/fw_bcmdhd.bin"
	---help---
	  Path to the semco firmware file.

config BCMDHD_MURATA_FW_PATH
        depends on BCMDHD
        string "Murata Firmware path"
        default "/system/vendor/firmware/murata/fw_bcmdhd.bin"
        ---help---
          Path to the murata firmware file.

config BCMDHD_SEMCO_NVRAM_PATH
	depends on BCMDHD
	string "Semco NVRAM path"
	default "/system/etc/wifi/nv_semco.txt"
	---help---
	  Path to the semco calibration file.

config BCMDHD_MURATA_NVRAM_PATH
        depends on BCMDHD
        string "Murata NVRAM path"
        default "/system/etc/wifi/nv_murata.txt"
        ---help---
          Path to the murata calibration file.

config DHD_USE_STATIC_BUF
	bool "Enable memory preallocation"
	depends on BCMDHD
	default n
	---help---
	  Use memory preallocated in platform

config DHD_USE_SCHED_SCAN
	bool "Use CFG80211 sched scan"
	depends on BCMDHD && CFG80211
	default y
	---help---
	  Use CFG80211 sched scan

config DHD_OF_SUPPORT
	bool "Enable DHD OF SUPPORT"
	depends on BCMDHD
	default y
	---help---
	  enable dhd of support

config WLAN_SDIO
	bool "Enable SDIO interface for BCMDHD"
	depends on BCMDHD
	default y
	---help---
	  Use memory preallocated in platform
```

## drivers/nfc/p73-spi/Kconfig
```kconfig
#
# Nxp SPi protocol (SPI) devices
#

config NXP_P73_DEVICES
	tristate "Nxp P73 secure element protocol driver (SPI) devices"
	depends on SPI
	default n
	---help---
	  You'll have to say Y if your computer contains an SPI device that
	  you want to use under Linux.

	  You can say N here if you don't have any SPI connected to your computer.

config NXP_P73_DEVICES_DEBUG
	tristate "Nxp P73 secure element protocol driver (SPI) DEBUG"
	depends on NXP_P73_DEVICES
	default n
	---help---
	  You'll have to say Y if your want to debug Nxp P73 SPI device that
	  you want to use under Linux.

	  You can say N here if you don't have any SPI connected to your computer.
```

## drivers/nfc/pn548/Kconfig
```kconfig
config NFC_PN548
	tristate "NXP PN548 NFC driver"
	depends on I2C
	---help---
	  NXP PN548 core driver.
	  This is a driver based on the HCI NFC kernel layers and
	  will thus not work with NXP libnfc library.

	  To compile this driver as a module, choose m here. The module will
	  be called pn548.
	  Say N if unsure.
```

## drivers/nfc/st21nfcd/Kconfig
```kconfig
config NFC_ST21NFCD
	tristate "STMicroelectronics ST21NFCD NFC driver"
	depends on I2C
	---help---
	  STMicroelectronics ST21NFCD core driver. It implements the chipset
	  NCI logic and hooks into the NFC kernel APIs. Physical layers will
	  register against it.

	  Say N if unsure.
```

## drivers/oppo/Kconfig
```kconfig
#
# oppo's custom devices
#

menu "OPPO's custom device support"
	depends on !UML

config OPPO
        tristate "OPPO's custom devices"
	help
	  OPPO's custom devices

if OPPO

config OPPO_LCD_MODIFY
	tristate "config lcd"
	help
	  define this config for lcd.

config OPPO_TP_MODIFY
	tristate "config tp"
	help
	  define this config for tp.
	  
config OPPO_CHARGING_MODIFY
	tristate "config charging"
	help
	  define this config for charging, battery or usb.

config OPPO_POWER_MODIFY
	tristate "config power"
	help
	  define this config for system power supply.

config OPPO_DUAL_SYS_COMM_MODIFY
	tristate "config dual sys comm"
	help
	  define this config for add the commuction between 8909 and mcu.

config OPPO_AUDIO_MODIFY
	tristate "config audio"
	help
	  define this config for modifying the audio driver.

config OPPO_WIFI_MODIFY
	tristate "config wifi"
	help
	  define this config for modifying the wifi function.

config OPPO_BT_MODIFY
	tristate "config bt"
	help
	  define this config for modifying the bt function.

config OPPO_NFC_MODIFY
	tristate "config nfc"
	help
	  define this config for modifying the nfc function.

config OPPO_SENSOR_MODIFY
	tristate "config sensor"
	help
	  define this config for modifying the sensor function.

config OPPO_MOTOR_MODIFY
	tristate "config motor"
	help
	  define this config for modifying the motor function.
	  
config OPPO_PRODUCTION_TEST_MODIFY
	tristate "config PRODUCTION_TEST"
	help
	  define this config for production line test function.

config OPPO_GPS_MODIFY
	tristate "config gps"
	help
	  define this config for modifying the gps function.
	  
config RECORD_MDMRST
	tristate "config record mdmrst"
	help
	  define this config to count the modem restart times.	  

config OPPO_HW_VER
	tristate "hw ver driver"
	depends on SENSORS_QPNP_ADC_VOLTAGE
	default n
	help
	  hardwear ver driver
	  gpio and adc

	  Say Y here to compile support for hwver devices into the
	  kernel or say M to compile it as module.

config OPPO_FTM_MODE
	tristate "ftm mode driver"
	default n
	help
	  ftm mode config driver

	  Say Y here to compile support for hwver devices into the
	  kernel or say M to compile it as module.

config OPPO_COMMON_SOFT
	tristate "config oppo common software"
	help
	  define this config to get project verion from sharemem.
	  Maybe this value is from CDT or dynamic identify by hardware
	  id.

config OPPO_SHUTDOWN_DETECT
	tristate "OPPO shutdown hang detect"
	help
	  define this config to init oppo oppo_shutdown_detect.

config REGULATOR_FAN49103
	tristate "Fairchild FAN49103 Regulator"
	depends on I2C
	help
	  This driver supports Fairchild FAN49103 Digitally Programmable
	  TinyBuck Regulator. The FAN49103 is a step-down switching voltage
	  regulator that delivers a digitally programmable output from an
	  input voltage supply of 2.8V to 4V. The output voltage is
	  programmed through an I2C interface.
	  
endif

endmenu
```

## drivers/power/supply/google/Kconfig
```kconfig
menuconfig GOOGLE_BMS
	bool "Google, Inc. Charging and Fuel Gauge support"
	help
	  Say Y here to enable Google, Inc. support for Battery and Charging.

if GOOGLE_BMS

config GOOGLE_BATTERY_CHARGING
	tristate "Google Battery and Charging Control"
	select GOOGLE_CHARGER
	select GOOGLE_BATTERY
	help
	  Say Y here to enable new Google Gen Features.
	  This option selects Google Battery and Multi Step Charging enabling
	  new features such as battery controlled charge tables and charge path
	  resistance compensation. New gen features require configuration in
	  device tree.

config GOOGLE_CHARGER
	tristate "Google Multi Step Charging"
	help
	  Say Y here to choose the Google Multi Step Charging control.
	  The driver implements a multi CC-CV steps charging using battery
	  temperature and voltage to set the charger's constant charging
	  current and float voltage.

config GOOGLE_BATTERY
	tristate "Google Battery"
	help
	  Say Y here to choose the Google Battery.
	  The driver handles charge tables, recharge threshold, state of charge,
	  battery statistics such as bin count and other features common to all
	  google battery powered devices.

config USB_OVERHEAT_MITIGATION
	tristate "Google USB Overheat Mitigation"
	help
	  Say Y here to enable Google USB overheat mitigation

config GOOGLE_LOGBUFFER
	tristate "debugfs logbuffer"
	help
	  Say Y here to enable logbuffer.
	  This option enables a module that exposes an API to maintain driver
	  specific logs in an exclusive ring buffer and exposes it through
	  debugfs.

endif	# GOOGLE_BMS
```
