## drivers/soc/qcom/lge/Kconfig
```kconfig
menu "LGE Board Selection"

config MACH_SWORDFISH
	bool "MSM8909 SWORDFISH"
	depends on ARCH_MSM8909
	help
	  Support for the LGE MSM8909W SWORDFISH device.

config MACH_ANGELFISH
	bool "APQ8009W ANGELFISH"
	depends on ARCH_MSM8909
	help
	  Support for the LGE APQ8009W SWORDFISH device.

endmenu

menu "LGE Specific Patches"

config LGE_HANDLE_PANIC
	tristate "Support LGE Kernel Panic Handler"
	default n
	help
	  LGE Crash Handler

endmenu
```

## drivers/staging/audio-kernel-8x09/Kconfig
```kconfig
comment "Qualcomm audio modem"

config SND_SOC_BG_8909

	tristate "Qualcomm Audio BG"
	default m
	help
	Add support for the Qualcomm Audio BG module

config MSM_ADSP_LOADER

	tristate "Qualcomm adsp loader"
	default m
	help
	Add support for the Qualcomm ADSP loader module

config SND_SOC_BG_CODEC

	tristate "Qualcomm bg codec"
	default m
	help
	Add support for the Qualcomm Blackghost codec

#source "drivers/staging/audio-kernel-8x09/asoc"
```

## drivers/staging/bcm15602/Kconfig
```kconfig
config BCM15602
	tristate "BCM15602 regulator"
	depends on I2C
	select REGMAP_I2C
	help
	  This driver controls the BCM15602 voltage regulator via I2C.
```
