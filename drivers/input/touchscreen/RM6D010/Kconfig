## drivers/input/touchscreen/RM6D010/Kconfig
```kconfig
#
# RM6D010 Touchscreen driver configuration
#

config TOUCHSCREEN_RM6D010
	bool "RM6D010 Touchscreen"
	depends on I2C
	default n
	help
		Say Y here if you have RM6D010 touch panel.
		If unsure, say N.

config TOUCHSCREEN_RM6D010_DIRECTORY
	string "RM6D010 ts directory name"
	default "RM6D010_touch"
	depends on TOUCHSCREEN_RM6D010
```

## drivers/input/touchscreen/ft8716/Kconfig
```kconfig
#
# FT8716 Touchscreen driver configuration
#

config TOUCHSCREEN_FTS
        tristate "FTS i2c touchscreen"
		depends on TOUCHSCREEN_FT8716
		help
		This enables support for FT8716 I2C based touchscreens.
```

## drivers/input/touchscreen/gt1x/Kconfig
```kconfig
#
# Goodix GT1x Touchscreen driver
#

config GT1X_TOUCHPANEL_DRIVER
	tristate "Goodix GT1x touchpanel driver"
	depends on TOUCHSCREEN_GT1X
	default n
	help
	  This is the main file for touchpanel driver for Goodix GT1x
	  touchscreens.

	  Say Y here if you have a Goodix GT9xx touchscreen connected
	  to your system.

	  If unsure, say N.

	  To compile this driver as a module, choose M here: the
	  module will be called gt1x_tool.

config GT1X_TOUCHPANEL_UPDATE
	tristate "Goodix GT1x touchpanel auto update support"
	depends on GT1X_TOUCHPANEL_DRIVER
	default n
	help
	  This enables support for firmware update for Goodix GT1x
	  touchscreens.

	  Say Y here if you have a Goodix GT1x touchscreen connected
	  to your system.

	  If unsure, say N.

	  To compile this driver as a module, choose M here: the
	  module will be called gt1x_update.

config GT1X_TOUCHPANEL_DEBUG
	tristate "Goodix GT1x Tools for debuging"
	depends on GT1X_TOUCHPANEL_DRIVER
	default n
	help
	  This is application debug interface support for Goodix GT1x
	  touchscreens.

	  Say Y here if you want to have a Android app debug interface
	  to your system.

	  If unsure, say N.

	  To compile this driver as a module, choose M here: the
	  module will be called gt1x_tool.
```

## drivers/input/touchscreen/lge/Kconfig
```kconfig
#
# LGE touch core configuration
#

if INPUT_TOUCHSCREEN

menuconfig LGE_TOUCH_CORE
	tristate "LGE Touch Core - Generic"
	select LGE_TOUCH_CORE_BASE
	help
	  If your plaform is generic linux, say Y

config LGE_TOUCH_CORE_BASE
	tristate "LGE Touch Core Base"
	depends on SPI_MASTER && I2C

config LGE_TOUCH_FW_PATH
	string "LGE Touch Core Firmware Path"
	help
	LGE_TOUCH_FW_PATH is set to path of synaptics firmware

source "drivers/input/touchscreen/lge/lgsic/Kconfig"

endif
```

## drivers/input/touchscreen/lge/lgsic/Kconfig
```kconfig
#
# LGE touch core configuration
#
if INPUT_TOUCHSCREEN

menuconfig LGE_TOUCH_LGSIC_SW49408
        tristate "LGE Touch Core ODM Device Driver - SW49408"
        depends on LGE_TOUCH_CORE_BASE
        help
          If your device is sw49408, say Y

menuconfig LGE_TOUCH_LGSIC_SW49408_PRD
        tristate "LGE Touch Core ODM Device Driver - SW49408 Production Test"
        depends on LGE_TOUCH_CORE_BASE
        help
          If your device is sw49408 and you need the sysfs entries
          to support production test, say Y

# To Do : LGSIC Chipseet
endif
```

## drivers/input/touchscreen/stm/Kconfig
```kconfig
#
# STMicroelectronics TOUCH driver configuration
#

config TOUCHSCREEN_FTS
	tristate "STMicroelectronics multitouch touchscreen - FingerTipS (FTM5)"
	depends on SPI
	select TOUCHSCREEN_HEATMAP
	help
	  Say Y here to enable STMicroelectronics (FTM5) touchscreen support.
	  If unsure, say N.
	  To compile this driver as a module, choose M here: the module
	  will be called ftm5.
```

## drivers/input/touchscreen/synaptics_dsx_htc/Kconfig
```kconfig
#
# Synaptics DSX v2.6 touchscreen driver configuration
#
menuconfig TOUCHSCREEN_SYNAPTICS_DSX_HTC
	bool "Synaptics DSX v2.6 touchscreen"
	default n
	help
	  Say Y here if you have a Synaptics DSX touchscreen connected
	  to your system.

	  If unsure, say N.

if TOUCHSCREEN_SYNAPTICS_DSX_HTC

choice
	default TOUCHSCREEN_SYNAPTICS_DSX_I2C_HTC
	prompt "Synaptics DSX v2.6 bus interface"
config TOUCHSCREEN_SYNAPTICS_DSX_I2C_HTC
	bool "RMI over I2C"
	depends on I2C
config TOUCHSCREEN_SYNAPTICS_DSX_SPI_HTC
	bool "RMI over SPI"
	depends on SPI_MASTER
config TOUCHSCREEN_SYNAPTICS_DSX_RMI_HID_I2C_HTC
	bool "HID over I2C"
	depends on I2C
endchoice

config TOUCHSCREEN_SYNAPTICS_DSX_CORE_HTC
	tristate "Synaptics DSX v2.6 core driver module"
	depends on I2C || SPI_MASTER
	help
	  Say Y here to enable basic touch reporting functionality.

	  If unsure, say N.

	  To compile this driver as a module, choose M here: the
	  module will be called synaptics_dsx_core.

config TOUCHSCREEN_SYNAPTICS_DSX_RMI_DEV_HTC
	tristate "Synaptics DSX v2.6 RMI device module"
	depends on TOUCHSCREEN_SYNAPTICS_DSX_CORE_HTC
	help
	  Say Y here to enable support for direct RMI register access.

	  If unsure, say N.

	  To compile this driver as a module, choose M here: the
	  module will be called synaptics_dsx_rmi_dev.

config TOUCHSCREEN_SYNAPTICS_DSX_FW_UPDATE_HTC
	tristate "Synaptics DSX v2.6 firmware update module"
	depends on TOUCHSCREEN_SYNAPTICS_DSX_CORE_HTC
	help
	  Say Y here to enable support for doing firmware update.

	  If unsure, say N.

	  To compile this driver as a module, choose M here: the
	  module will be called synaptics_dsx_fw_update.

config TOUCHSCREEN_SYNAPTICS_DSX_FW_UPDATE_SYSFS_HTC
	bool "Synaptics DSX firmware update sysfs attributes"
	depends on TOUCHSCREEN_SYNAPTICS_DSX_FW_UPDATE_HTC
	help
	  Say Y here to enable support for sysfs attributes for
	  performing firmware update in a development environment.
	  This does not affect the core or other subsystem attributes.

	  If unsure, say N.

config TOUCHSCREEN_SYNAPTICS_DSX_TEST_REPORTING_HTC
	tristate "Synaptics DSX v2.6 test reporting module"
	depends on TOUCHSCREEN_SYNAPTICS_DSX_CORE_HTC
	help
	  Say Y here to enable support for retrieving production test reports.

	  If unsure, say N.

	  To compile this driver as a module, choose M here: the
	  module will be called synaptics_dsx_test_reporting.

config TOUCHSCREEN_SYNAPTICS_DSX_PROXIMITY_HTC
	tristate "Synaptics DSX v2.6 proximity module"
	depends on TOUCHSCREEN_SYNAPTICS_DSX_CORE_HTC
	help
	  Say Y here to enable support for proximity functionality.

	  If unsure, say N.

	  To compile this driver as a module, choose M here: the
	  module will be called synaptics_dsx_proximity.

config TOUCHSCREEN_SYNAPTICS_DSX_ACTIVE_PEN_HTC
	tristate "Synaptics DSX v2.6 active pen module"
	depends on TOUCHSCREEN_SYNAPTICS_DSX_CORE_HTC
	help
	  Say Y here to enable support for active pen functionality.

	  If unsure, say N.

	  To compile this driver as a module, choose M here: the
	  module will be called synaptics_dsx_active_pen.

config TOUCHSCREEN_SYNAPTICS_DSX_GESTURE_HTC
	tristate "Synaptics DSX v2.6 user defined gesture module"
	depends on TOUCHSCREEN_SYNAPTICS_DSX_CORE_HTC
	help
	  Say Y here to enable support for user defined gesture functionality.

	  If unsure, say N.

	  To compile this driver as a module, choose M here: the
	  module will be called synaptics_dsx_gesture.

config TOUCHSCREEN_SYNAPTICS_DSX_VIDEO_HTC
	tristate "Synaptics DSX v2.6 video module"
	depends on TOUCHSCREEN_SYNAPTICS_DSX_CORE_HTC
	help
	  Say Y here to enable support for video communication functionality.

	  If unsure, say N.

	  To compile this driver as a module, choose M here: the
	  module will be called synaptics_dsx_video.

endif
```

## drivers/media/platform/msm/camera/Kconfig
```kconfig
#
# CAMERA
#

menuconfig CAMERA_FW_UPDATE
	tristate "Qualcomm Technologies, Inc. Camera Firmware Update"
		depends on I2C

menuconfig CAMERA_ACT_RW_PROTECT
	tristate "Qualcomm Technologies, Inc. Camera Actuator R/W Protect"
		depends on I2C
```

## drivers/media/video/msm/Kconfig
```kconfig
comment "Qualcomm MSM Camera And Video"

menuconfig MSM_CAMERA
	bool "Qualcomm MSM camera and video capture support"
	depends on ARCH_MSM
	help
	  Say Y here to enable selecting the video adapters for
	  Qualcomm msm camera and video encoding

config MSM_CAMERA_V4L2
	bool "Video For Linux interface to MSM camera"
	depends on MSM_CAMERA && VIDEO_V4L2 && EXPERIMENTAL
	default y
	help
	  Say Y here to enable the V4L2 interface for the MSM camera.
	  Not everything works through this interface and it has not
	  been thoroughly tested.

config MSM_CAMERA_DEBUG
	bool "Qualcomm MSM camera debugging with printk"
	depends on MSM_CAMERA
	help
	  Enable printk() debug for msm camera

comment "Camera Sensor Selection"
config MT9T013
	bool "Sensor mt9t013 (BAYER 3M)"
	depends on MSM_CAMERA
	---help---
	  MICRON 3M Bayer Sensor with AutoFocus

config MT9D112
	bool "Sensor mt9d112 (YUV 2M)"
	depends on MSM_CAMERA
	---help---
	  MICRON 2M YUV Sensor

config MT9P012
	bool "Sensor mt9p012 (BAYER 5M)"
	depends on MSM_CAMERA
	---help---
	  MICRON 5M Bayer Sensor with Autofocus

config S5K3E2FX
	bool "Sensor s5k3e2fx (Samsung 5M)"
	depends on MSM_CAMERA
	---help---
	  Samsung 5M with Autofocus
```

## drivers/misc/airbrush/Kconfig
```kconfig
#
# Airbrush
#

menu "Airbrush"

config AIRBRUSH_SM
	bool "Device driver for Airbrush State Manager"
	default "n"
	---help---
	  This option enables device driver support for airbrush state manager.
	  This includes the support for CLK, LPDDR, UART, SPI and other IP
	  configurations which can be controlled through the PCIe interface.

config AIRBRUSH_SM_DEBUGFS
	depends on AIRBRUSH_SM
	bool "Debugfs entries for Airbrush State Manager"
	default "n"
	---help---
	  This option enables Debugfs entries for airbrush state manager.

config AIRBRUSH_SM_PROFILE
	depends on AIRBRUSH_SM && AIRBRUSH_SM_DEBUGFS
	bool "Profiling support for Airbrush State Manager"
	default "y"
	---help---
	  This option enables profiling support for airbrush state manager.

config AIRBRUSH_SM_DEBUG_IOCTLS
	depends on AIRBRUSH_SM
	bool "Debug ioctls for Airbrush State Manager"
	default "y"
	---help---
	  This option enables debug ioctls for airbrush state manager.

endmenu
```

## drivers/misc/mnh/Kconfig
```kconfig
#
# MNH PCIE Host driver configuration
#
config MNH_PCIE_HOST
    tristate "MNH PCIe Host-side driver"
    depends on PCI
    default "y"
    ---help---
      Include support for MNH PCIe Host-side driver


config MNH_SM_HOST
    tristate "MNH Easel State Machine Host-side driver"
    depends on PCI
    default "y"
    ---help---
      Include support for MNH State Machine Host-side driver. This driver
      controls the power-on and power-down sequences including firmware
      download. The state manager is controlled by a userspace service
      to control state transitions.

config MNH_THERMAL_HOST
    tristate "MNH Easel Thermal Sensor Device Host-side driver"
    depends on MNH_SM_HOST
    default "n"
    ---help---
      Include support for MNH Thermal Sensor Device Host-side driver. This
      driver adds support for all thermal zone sensors on the Easel device and
      exposes them to the kernel thermal framework.

config MNH_PCIE_MULTIPLE_MSI
    tristate "MNH PCIE Multiple MSI support"
    depends on MNH_PCIE_HOST
    default "n"
    ---help---
       Include support for multiple MSIs in MNH PCIe Host driver

config MNH_SIG
    tristate "MNH signing engine"
    depends on MNH_SM_HOST
    default "n"
    ---help---
       Adds support for authentication of MNH images

config MNH_SIG_FORCE_OTA
    tristate "MNH signature enforcement - OTA"
    depends on MNH_SIG
    default "n"
    ---help---
       Enforce firmware signing for images delivered through an OTA

config MNH_SIG_FORCE_PS
    tristate "MNH signature enforcement - Play Store"
    depends on MNH_SIG
    default "y"
    ---help---
       Enforce firmware signing for images delivered through the Play Store
```

## drivers/misc/paintbox/Kconfig
```kconfig
#
# Paintbox Programmable IPU
#

menu "Paintbox Programmable IPU"

config PAINTBOX
	tristate "Paintbox programmable ISP"
	help
	  Say Y here if you want to support the Paintbox programmable ISP

config PAINTBOX_DEBUG
	bool  "Paintbox Debug Support"
	depends on PAINTBOX && DEBUG_FS
	default n
	---help---
	This option enables support for Paintbox debug support.
	If you are unsure, say N.

config PAINTBOX_FPGA_SUPPORT
	bool  "Paintbox FPGA Support"
	depends on PAINTBOX
	default n
	---help---
	This option enables support for the Paintbox FPGA hardware.
	If you are unsure, say N.

config PAINTBOX_FPGA_SOFT_RESET
	bool  "Paintbox FPGA Soft Reset Support"
	depends on PAINTBOX_FPGA_SUPPORT
	default n
	---help---
	This option enables support for the FPGA soft reset register.
	If you are unsure, say N.

config PAINTBOX_SIMULATOR_SUPPORT
	bool  "Paintbox Simulator Support"
	depends on PAINTBOX
	default n
	---help---
	This option enables support for the Paintbox Simulator.
	If you are unsure, say N.

config PAINTBOX_TEST_SUPPORT
	bool  "Paintbox Test Support"
	depends on PAINTBOX
	default n
	---help---
	This option enables support for Paintbox test only ioctls and debugging.
	If you are unsure, say N.

config PAINTBOX_IOMMU_ENABLED
	bool  "Set the default state for the Painbox to on"
	depends on PAINTBOX
	depends on PAINTBOX_IOMMU
	default y
	---help---
	This option sets the default state for Paintbox IOMMU to on.

config PAINTBOX_PLATFORM_BUS
	bool  "Paintbox Platform Bus Support"
	depends on PAINTBOX
	default n
	---help---
	This option enables support for IPU hardware on an AXI bus.
	If you are unsure, say N.

config PAINTBOX_AIRBRUSH_MFD
	bool  "Paintbox Airbrush Multi-function Device Support"
	depends on PAINTBOX
	depends on MFD_ABC_PCIE
	default n
	---help---
	This option enables support for IPU hardware on the Airbrush companion
	chip.  If you are unsure, say N.

choice
	prompt "Paintbox Version"
	depends on PAINTBOX
	default PAINTBOX_V0

config PAINTBOX_V0
	bool  "Paintbox V0 functionality and errata"
	---help---
	This option enables Paintbox V0 specific functionality and errata.

config PAINTBOX_V1
	bool  "Paintbox V1 functionality and errata"
	---help---
	This option enables Paintbox V1 specific functionality and errata.

config PAINTBOX_V2
	bool  "Paintbox V2 functionality and errata"
	---help---
	This option enables Paintbox V2 specific functionality and errata.

endchoice

config PAINTBOX_VERSION_MAJOR
	int
	depends on PAINTBOX
	default 2 if PAINTBOX_V2
	default 1 if PAINTBOX_V1
	default 0

endmenu
```

## drivers/misc/st33/Kconfig
```kconfig
#
# ST33 SPI driver
#
config ST33
    tristate "ST33"
    depends on SPI
    default "n"
    ---help---
      Include support for ST33 SPI driver
```

## drivers/misc/vibrator/Kconfig
```kconfig
config TI_VIBRATOR
	bool "Ti Vibrator driver"
		default n
	---help---
	  Vibrator driver support for TI haptics SOC
	  If you want to use this driver, say Y or M here.
	  If unsure, say N.
```

## drivers/misc/video_core/720p/Kconfig
```kconfig
#
# VIDEO CORE
#
menuconfig MSM_720P_CORE
        bool "720P Core Video Driver"
	depends on ARCH_MSM7X30
        default n
        ---help---
        Say Y here to see options for video device drivers.
	If you say N, all options in this submenu will be skipped and disabled.

if MSM_720P_CORE

config MSM_VIDEO_CORE_REG
	tristate "MSM Video core registration"
	depends on MSM_720P_CORE
	default n
	help
	  This option enables support for Video core.

config MSM_VIDEO_CORE_VENC
	tristate "Video encoder"
	depends on MSM_VIDEO_CORE_REG
	default n
	help
	  This option enables support for Video encoder.

config MSM_VIDEO_CORE_VDEC
	tristate "Video decoder"
	depends on MSM_VIDEO_CORE_REG
	default n
	help
	  This option enables support for Video decoder.

endif # MSM_720P_CORE
```
