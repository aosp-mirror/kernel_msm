## drivers/staging/iio/sensors/Kconfig
```kconfig
#
# Industrial I/O sensors configuration
#
menu "IIO sensors drivers"
	depends on IIO

config INPUT_CWSTM32
	tristate "CyWee CWSTM32 Sensor HUB"
	depends on SPI && I2C && INPUT
	select INPUT_POLLDEV
	help
		This driver provides support for CWSTM32 Sensor HUB.

config CWSTM32_DEBUG
	tristate "CyWee CWSTM32 Sensor HUB DEBUG MECHANISM"
	depends on INPUT_CWSTM32
	help
		This driver depends on CWSTM32 Sensor HUB for enable DEBUG. 

config SENSORS_I2C_BUS
		tristate "Sensor HUB I/O for I2C BUS"
		depends on INPUT_CWSTM32
		help
		  This driver depends on CWSTM32 Sensor HUB for I2C BUS.

config SENSORS_SPI_BUS
		tristate "Sensor HUB I/O for SPI BUS"
		depends on INPUT_CWSTM32
		help
		  This driver depends on CWSTM32 Sensor HUB for SPI BUS.

config SYNC_TOUCH_STATUS
        bool "Sync touch i2c switch status to sensor hub"
	default n
	help
	  Sync touch i2c switch status to sensor hub

endmenu
```

## drivers/staging/s2mpb04/Kconfig
```kconfig
config S2MPB04
	tristate "S2MPB04 regulator"
	depends on I2C
	select REGMAP_I2C
	help
	  This driver controls the S2MPB04 voltage regulator via I2C.
```

## drivers/staging/servicefs/Kconfig
```kconfig
config SERVICE_FS
	bool "ServiceFS Filesystem"
	default Y

config SERVICEFS_USE_POISON
	bool "Poison memory used by ServiceFS on release."
	default N
```

## drivers/staging/wlan-mac/Kconfig
```kconfig
#
# WLAN Mac Configuraiton
#
config WLAN_MAC_CMDLINE
	bool "Read WiFi MAC addresses from the kernel command-line."
	default n
	help
	  Say Y here if you want to read the WiFi MAC addresses from
          the kernel command-line.
```

## drivers/staging/wlan_mac/Kconfig
```kconfig
#
# google set wlan mac
#
config GOOGLE_WLAN_MAC
	tristate "Read MAC from device tree"
	default n
	help
	  Say Y here if you want the GOOGLE WLAN MAC features
```

## drivers/usb/fusb302/Kconfig
```kconfig
config FUSB_30X
	tristate "Fairchild Type-C interface support"
	default n
	help
	  Fairchild type-c interface is a  chip support USB PD protocol device
```

## drivers/usb/ptn36241g/Kconfig
```kconfig
#
# PTN36241G USB3 Redriver configuration
#

config USB_PTN36241G
	bool "PTN36241G USB3 Redriver"
	default n
	help
	  Say Y here to enable the PTN36241G USB3.0 Redriver
```

## drivers/usb/tusb1044/Kconfig
```kconfig
#
# TUSB1044 USB3 Redriver configuration
#

config USB_TUSB1044
	bool "TUSB1044 USB3 Redriver"
	default n
	help
	  Say Y here to enable the TUSB1044 USB3.0 Redriver
```

## drivers/usb/typec/Kconfig
```kconfig
menu "USB Power Delivery and Type-C drivers"

config TYPEC
	tristate

config TYPEC_TCPM
	tristate "USB Type-C Port Controller Manager"
	select TYPEC
	help
	  The Type-C Port Controller Manager provides a USB PD and USB Type-C
	  state machine for use with Type-C Port Controllers.

source "drivers/usb/typec/fusb302/Kconfig"

endmenu
```

## drivers/usb/typec/fusb302/Kconfig
```kconfig
config TYPEC_FUSB302
	tristate "Fairchild FUSB302 Type-C chip driver"
	select TYPEC_TCPM
```

## drivers/video/Kconfig
```kconfig
#
# Video configuration
#

menu "Graphics support"

if HAS_IOMEM

config HAVE_FB_ATMEL
	bool

source "drivers/char/agp/Kconfig"

source "drivers/gpu/vga/Kconfig"

source "drivers/gpu/host1x/Kconfig"
source "drivers/gpu/ipu-v3/Kconfig"

source "drivers/gpu/drm/Kconfig"

menu "Frame buffer Devices"
source "drivers/video/fbdev/Kconfig"
endmenu

source "drivers/video/backlight/Kconfig"

config VGASTATE
       tristate
       default n

config VIDEOMODE_HELPERS
	bool

config HDMI
	bool

endif # HAS_IOMEM

if VT
	source "drivers/video/console/Kconfig"
endif

if FB || SGI_NEWPORT_CONSOLE
	source "drivers/video/logo/Kconfig"

endif


endmenu

config MSM_VIDC_V4L2
	tristate "Support MSM techpack/video device"
	depends on QCOM_LLCC
	---help---
	  The device is represented by an out-of-tree video driver
	  in techpack/video.  This config represents the truth regarding
	  the state of the video driver.

	  Default is technically n, but the out of tree driver overrides
	  that to y.  But if this configuration is m, then the out of tree
	  driver will respect that configuration.
```

## drivers/video/msm/Kconfig
```kconfig
config FB_MSM
	tristate
	depends on FB && ARCH_MSM
	select FB_CFB_FILLRECT
	select FB_CFB_COPYAREA
	select FB_CFB_IMAGEBLIT
	default y

config FB_MSM_LEGACY_MDP
	bool
	depends on FB_MSM && (MSM_MDP31 || MSM_MDP22)
	default y

config FB_MSM_MDP_PPP
	bool
	depends on FB_MSM_LEGACY_MDP
	default y

config FB_MSM_LCDC
	bool "Support for integrated LCD controller in qsd8x50"
	depends on FB_MSM && MSM_MDP31
	default y

config FB_MSM_MDDI
	bool "Support for MSM MDDI controllers"
	depends on FB_MSM
	default y

config GPU_MSM_KGSL
	tristate "MSM 3D Graphics driver for Adreno class GPUs"
	default n
	depends on FB_MSM && (ARCH_QSD8X50 || ARCH_MSM7X30)
	select GENERIC_ALLOCATOR
	select CONFIG_FW_LOADER
	help
	  3D graphics driver for QSD8x50 and MSM7x27. Required to
	  use hardware accelerated OpenGL ES 2.0 and 1.1 on these
	  chips.

config MSM_KGSL_MMU
	bool "Turn on MMU for graphics driver "
	depends on GPU_MSM_KGSL && MMU
	default n
	help
	  If enabled, the GPU driver will allocate memory from vmalloc
	  and enable the use of GPU MMU, instead of using pmem.
```

## drivers/video/msm/mdss/Kconfig
```kconfig
config FB_MSM_MDSS_WRITEBACK
	bool "MDSS Writeback Panel"
	---help---
	The MDSS Writeback Panel provides support for routing the output of
	MDSS frame buffer driver and MDP processing to memory.

config FB_MSM_MDSS_HDMI_PANEL
	depends on FB_MSM_MDSS
	bool "MDSS HDMI Tx Panel"
	default n
	---help---
	The MDSS HDMI Panel provides support for transmitting TMDS signals of
	MDSS frame buffer data to connected hdmi compliant TVs, monitors etc.

config FB_MSM_MDSS_HDMI_MHL_SII8334
	depends on FB_MSM_MDSS_HDMI_PANEL
	bool 'MHL SII8334 support '
	default n
	---help---
	  Support the HDMI to MHL conversion.
	  MHL (Mobile High-Definition Link) technology
	  uses USB connector to output HDMI content

config FB_MSM_MDSS_MHL3
	depends on FB_MSM_MDSS_HDMI_PANEL
	bool "MHL3 SII8620 Support"
	default n
	---help---
	  Support the SiliconImage 8620 MHL Tx transmitter that uses
	  USB connector to output HDMI content. Transmitter is an
	  i2c device acting as an HDMI to MHL bridge. Chip supports
	  MHL 3.0 standard.

config FB_MSM_MDSS_DSI_CTRL_STATUS
	tristate "DSI controller status check feature"
	---help---
	  Check DSI controller status periodically (default period is 5
	  seconds) by sending Bus-Turn-Around (BTA) command. If DSI controller
	  fails to acknowledge the BTA command, it sends PANEL_ALIVE=0 status
	  to HAL layer to reset the controller.

config FB_MSM_MDSS_EDP_PANEL
	depends on FB_MSM_MDSS
	bool "MDSS eDP Panel"
	---help---
	The MDSS eDP Panel provides support for eDP host controller driver
	which runs in Video mode only and is responsible for transmitting
	frame buffer from host SOC to eDP display panel.

config FB_MSM_MDSS_MDP3
	depends on FB_MSM_MDSS
	bool "MDP3 display controller"
	---help---
	The MDP3 provides support for an older version display controller
	included in latest display sub-system, known as MDSS.

config FB_MSM_MDSS_XLOG_DEBUG
	depends on FB_MSM_MDSS
	bool "Enable MDSS debugging"
	---help---
	The MDSS debugging provides support to enable display debugging
	features to: Dump MDSS registers during driver errors, panic
	driver during fatal errors and enable some display-driver logging
	into an internal buffer (this avoids logging overhead).

config KEEP_POWER_ON_WHEN_PANEL_OFF
	bool "Enable Keep Panel Power On When Panel Off"
	default n
	---help---
	For some reason, shutting down panel power when panel off is more
	time and power consuming because it will take more time and power
	on panel on sequence. Set this option true if you don't want to
	turn panel power off when panel off.

config ASUS_BACKLIGHT_DEBUG
    bool 'enable backlight debug mode'
    default n
    ---help---
        Enable backlight debug mode
```

## fs/overlayfs/Kconfig
```kconfig
config OVERLAY_FS
	tristate "Overlay filesystem support"
	help
	  An overlay filesystem combines two filesystems - an 'upper' filesystem
	  and a 'lower' filesystem.  When a name exists in both filesystems, the
	  object in the 'upper' filesystem is visible while the object in the
	  'lower' filesystem is either hidden or, in the case of directories,
	  merged with the 'upper' object.

	  For more information see Documentation/filesystems/overlayfs.txt

config OVERLAY_FS_OVERRIDE_CREDS
	bool "Overlay filesystem override credentials"
	depends on OVERLAY_FS
	default y
	help
	  If set, all access to the upper, lower and work directories is the
	  recorded mounter's MAC and DAC credentials.  The incoming accesses
	  are checked against the caller's credentials.

	  If the principles of least privilege are applied, the mounter's
	  credentials might not overlap the credentials of the caller's when
	  accessing the overlayfs filesystem.  The mount option
	  "override_creds=off" drops the mounter's credential check, so that
	  all subsequent operations, after mount, on the filesystem will only
	  be the caller's credentials.  This option sets the default for the
	  module option override_creds, and thus the default for all mounts
	  that do not specify this option.

	  For more information see Documentation/filesystems/overlayfs.txt
```

## lib/Kconfig.ubsan
```kconfig
config ARCH_HAS_UBSAN_SANITIZE_ALL
	bool

config UBSAN
	bool "Undefined behaviour sanity checker"
	help
	  This option enables undefined behaviour sanity checker.
	  Compile-time instrumentation is used to detect various undefined
	  behaviours at runtime. Various types of checks may be enabled
	  via boot parameter ubsan_handle
	  (see: Documentation/dev-tools/ubsan.rst).

config UBSAN_TRAP
	bool "On Sanitizer warnings, stop the offending kernel thread"
	depends on UBSAN
	depends on $(cc-option, -fsanitize-undefined-trap-on-error)
	help
	  Building kernels with Sanitizer features enabled tends to grow
	  the kernel size by over 5%, due to adding all the debugging
	  text on failure paths. To avoid this, Sanitizer instrumentation
	  can just issue a trap. This reduces the kernel size overhead but
	  turns all warnings into full thread-killing exceptions.

config UBSAN_SANITIZE_ALL
	bool "Enable instrumentation for the entire kernel"
	depends on UBSAN
	depends on ARCH_HAS_UBSAN_SANITIZE_ALL

	# We build with -Wno-maybe-uninitilzed, but we still want to
	# use -Wmaybe-uninitilized in allmodconfig builds.
	# So dependsy bellow used to disable this option in allmodconfig
	depends on !COMPILE_TEST
	default y
	help
	  This option activates instrumentation for the entire kernel.
	  If you don't enable this option, you have to explicitly specify
	  UBSAN_SANITIZE := y for the files/directories you want to check for UB.
	  Enabling this option will get kernel image size increased
	  significantly.

config UBSAN_ALIGNMENT
	bool "Enable checking of pointers alignment"
	depends on UBSAN
	default y if !HAVE_EFFICIENT_UNALIGNED_ACCESS
	help
	  This option enables detection of unaligned memory accesses.
	  Enabling this option on architectures that support unaligned
	  accesses may produce a lot of false positives.

config TEST_UBSAN
	tristate "Module for testing for undefined behavior detection"
	depends on m && UBSAN
	help
	  This is a test module for UBSAN.
	  It triggers various undefined behavior, and detect it.
```

## net/bluetooth/bdaddress/Kconfig
```kconfig
config BT_BDA
	tristate "Load Bluetooth Device Address"
	depends on BT
	default n
	help
	  Extract Bluetooth bd_address information from ATAG set up
	  by the bootloader.
```

## sound/soc/codecs/adnc/Kconfig
```kconfig
#
# iaxxx codec driver
#
if MFD_IAXXX
config SND_SOC_IAXXX
	tristate "Knowles IAxxx Audio Device"
	---help---
	  Enable codec driver for IAxxx

config IAXXX_ACLK_338640
	bool "Enable for ACLK 338640"
	---help---
	This config enables IAXXX ACLK 338640

config IAXXX_PCM_DAI_FORMAT_DSP_A
	bool "Set Default PCM DAI Format"
	---help---
	This config sets default PCM DAI
	Format to DSP_A instead of I2S.

config IAXXX_PORT_CLOCK_FORWARD
	bool "Enable Port clock forwarding"
	---help---
	This config enables Port Clock
	forwarding for PDM Port clocks.
endif
```
