/*
 * Copyright (c) 2016, HUAWEI TECHNOLOGIES CO., LTD. All rights reserved.
 *
 * This program is free software; you can redistribute it and/or modify
 * it under the terms of the GNU General Public License version 2 and
 * only version 2 as published by the Free Software Foundation.
 *
 * This program is distributed in the hope that it will be useful,
 * but WITHOUT ANY WARRANTY; without even the implied warranty of
 * MERCHANTABILITY or FITNESS FOR A PARTICULAR PURPOSE.  See the
 * GNU General Public License for more details.
 */

&soc {
    i2c@78b9000 {
		synaptics@20 {
			avdd-supply = <&pm8916_l10>;
			vdd-supply = <&pm8916_l5>;
			synaptics,display-coords = <0 0 479 479>;
			/delete-property/ synaptics,power-down;
			/delete-property/ synaptics,disable-gpios;
			synaptics,is_wake;
		};
	};
};
