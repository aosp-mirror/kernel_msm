/* Copyright (c) 2013, The Linux Foundation. All rights reserved.
 *
 * This program is free software; you can redistribute it and/or modify
 * it under the terms of the GNU General Public License version 2 and
 * only version 2 as published by the Free Software Foundation.
 *
 * This program is distributed in the hope that it will be useful,
 * but WITHOUT ANY WARRANTY; without even the implied warranty of
 * MERCHANTABILITY or FITNESS FOR A PARTICULAR PURPOSE.  See the
 * GNU General Public License for more details.
 */

/*---------------------------------------------------------------------------
 * This file is autogenerated file using gcdb parser. Please do not edit it.
 * Update input XML file to add a new entry or update variable in this file
 * VERSION = "1.0"
 *---------------------------------------------------------------------------*/
&mdss_mdp {
	dsi_edo_rm67169_hvga_cmd: qcom,mdss_dsi_edo_rm67169_hvga_cmd {
		qcom,mdss-dsi-panel-name = "edo rm67169 hvga cmd mode dsi panel";
		qcom,mdss-dsi-panel-signature = <2>;
		qcom,mdss-dsi-panel-controller = <&mdss_dsi0>;
		qcom,mdss-dsi-panel-type = "dsi_cmd_mode";
		qcom,mdss-dsi-panel-destination = "display_1";
		qcom,mdss-dsi-panel-framerate = <60>;
		qcom,mdss-dsi-virtual-channel-id = <0>;
		qcom,mdss-dsi-stream = <0>;
		qcom,mdss-dsi-panel-width = <390>;
		qcom,mdss-dsi-panel-height = <390>;
		qcom,mdss-dsi-h-front-porch = <20>;
		qcom,mdss-dsi-h-back-porch = <40>;
		qcom,mdss-dsi-h-pulse-width = <20>;
		qcom,mdss-dsi-h-sync-skew = <0>;
		qcom,mdss-dsi-v-back-porch = <12>;
		qcom,mdss-dsi-v-front-porch = <20>;
		qcom,mdss-dsi-v-pulse-width = <4>;
		qcom,mdss-dsi-h-left-border = <0>;
		qcom,mdss-dsi-h-right-border = <0>;
		qcom,mdss-dsi-v-top-border = <0>;
		qcom,mdss-dsi-v-bottom-border = <0>;
		qcom,mdss-dsi-bpp = <24>;
		qcom,mdss-dsi-color-order = "rgb_swap_rgb";
		qcom,mdss-dsi-underflow-color = <0xff>;
		qcom,mdss-dsi-border-color = <0>;
		qcom,mdss-dsi-panel-orientation = "vflip";
		qcom,ulps-enabled;
		qcom,mdss-dsi-on-command = [
			15 01 00 00 00 00 02 fe 04
			15 01 00 00 00 00 02 6a 00
			15 01 00 00 00 00 02 fe 05
			15 01 00 00 00 00 02 05 00
			15 01 00 00 00 00 02 51 81
			15 01 00 00 00 00 02 52 c2
			15 01 00 00 00 00 02 53 04
			15 01 00 00 00 00 02 54 82
			15 01 00 00 00 00 02 55 e8
			15 01 00 00 00 00 02 56 12
			15 01 00 00 00 00 02 57 04
			15 01 00 00 00 00 02 58 43
			15 01 00 00 00 00 02 59 04
			15 01 00 00 00 00 02 5a 0e
			15 01 00 00 00 00 02 5b 02
			15 01 00 00 00 00 02 5c 20
			15 01 00 00 00 00 02 5d 00
			15 01 00 00 00 00 02 5e 80
			15 01 00 00 00 00 02 5f 04
			15 01 00 00 00 00 02 60 10
			15 01 00 00 00 00 02 61 a6
			15 01 00 00 00 00 02 62 02
			15 01 00 00 00 00 02 63 86
			15 01 00 00 00 00 02 64 04
			15 01 00 00 00 00 02 65 01
			15 01 00 00 00 00 02 66 86
			15 01 00 00 00 00 02 67 00
			15 01 00 00 00 00 02 68 26
			15 01 00 00 00 00 02 69 48
			15 01 00 00 00 00 02 6a 04
			15 01 00 00 00 00 02 6b 02 
			15 01 00 00 00 00 02 6c 48
			15 01 00 00 00 00 02 6d 04
			15 01 00 00 00 00 02 6e 02
			15 01 00 00 00 00 02 6f 90
			15 01 00 00 00 00 02 70 42
			15 01 00 00 00 00 02 71 48
			15 01 00 00 00 00 02 72 22
			15 01 00 00 00 00 02 73 08
			15 01 00 00 00 00 02 74 02
			15 01 00 00 00 00 02 75 01
			15 01 00 00 00 00 02 76 90
			15 01 00 00 00 00 02 77 02
			15 01 00 00 00 00 02 78 10
			15 01 00 00 00 00 02 79 20
			15 01 00 00 00 00 02 7a 00
			15 01 00 00 00 00 02 7b 80
			15 01 00 00 00 00 02 7c e0
			15 01 00 00 00 00 02 7d 02
			15 01 00 00 00 00 02 7e 04
			15 01 00 00 00 00 02 7f 04
			15 01 00 00 00 00 02 80 03
			15 01 00 00 00 00 02 81 86
			15 01 00 00 00 00 02 82 02
			15 01 00 00 00 00 02 83 20
			15 01 00 00 00 00 02 84 4e
			15 01 00 00 00 00 02 85 04
			15 01 00 00 00 00 02 86 02
			15 01 00 00 00 00 02 87 02
			15 01 00 00 00 00 02 88 49
			15 01 00 00 00 00 02 89 02
			15 01 00 00 00 00 02 8a 10
			15 01 00 00 00 00 02 8b 10
			15 01 00 00 00 00 02 8c 60
			15 01 00 00 00 00 02 8d 88
			15 01 00 00 00 00 02 8e 02
			15 01 00 00 00 00 02 ac 01
			15 01 00 00 00 00 02 ad 04
			15 01 00 00 00 00 02 ae 10
			15 01 00 00 00 00 02 af 90
			15 01 00 00 00 00 02 b0 18
			15 01 00 00 00 00 02 b1 88
			15 01 00 00 00 00 02 b2 00
			15 01 00 00 00 00 02 b3 10
			15 01 00 00 00 00 02 b4 a0
			15 01 00 00 00 00 02 b5 08
			15 01 00 00 00 00 02 b6 04
			15 01 00 00 00 00 02 b7 02
			15 01 00 00 00 00 02 b8 00
			15 01 00 00 00 00 02 b9 00
			15 01 00 00 00 00 02 ba 90
			15 01 00 00 00 00 02 bb 20
			15 01 00 00 00 00 02 bc 08
			15 01 00 00 00 00 02 bd 04
			15 01 00 00 00 00 02 be 0a
			15 01 00 00 00 00 02 bf 00
			15 01 00 00 00 00 02 c2 03
			15 01 00 00 00 00 02 FE 01
			15 01 00 00 00 00 02 2a 03
			15 01 00 00 00 00 02 fe 00
			15 01 00 00 00 00 02 35 00
			15 01 00 00 00 00 02 36 c0
			15 01 00 00 00 00 02 51 00
			39 01 00 00 00 00 05 2A 00 06 01 8b
			39 01 00 00 00 00 05 2B 00 02 01 87
			05 01 00 00 80 00 02 11 00
			05 01 00 00 00 00 02 29 00];
		qcom,mdss-dsi-off-command = [05 01 00 00 00 00 02 28 00
					05 01 00 00 78 00 02 10 00
];
		qcom,mdss-dsi-on-command-state = "dsi_lp_mode";
		qcom,mdss-dsi-off-command-state = "dsi_hs_mode";
		qcom,mdss-dsi-idle-on-command = [
					15 01 00 00 00 00 02 fe 00
					15 01 00 00 00 00 02 39 00/*Idle Mode on*/
					];
		qcom,mdss-dsi-idle-on-command-state = "dsi_hs_mode";
		qcom,mdss-dsi-idle-off-command = [
					15 01 00 00 00 00 02 fe 00
					15 01 00 00 00 00 02 38 00/*Idle Mode Off*/
					];
		qcom,mdss-dsi-idle-off-command-state = "dsi_hs_mode";
		qcom,mdss-dsi-boost-on-command = [
					15 01 00 00 00 00 02 FE 04
					15 01 00 00 00 00 02 53 92
					];
		qcom,mdss-dsi-boost-on-command-state = "dsi_hs_mode";
		qcom,mdss-dsi-boost-off-command = [
					15 01 00 00 00 00 02 FE 04
					15 01 00 00 00 00 02 53 de
					];
		qcom,mdss-dsi-boost-off-command-state = "dsi_hs_mode";
		qcom,mdss-dsi-h-sync-pulse = <1>;
		qcom,mdss-dsi-traffic-mode = "burst_mode";
		qcom,mdss-dsi-lane-map = "lane_map_3012";
		qcom,mdss-dsi-bllp-eof-power-mode;
		qcom,mdss-dsi-bllp-power-mode;
		qcom,mdss-dsi-lane-0-state;
		qcom,mdss-dsi-te-pin-select = <1>;
		qcom,mdss-dsi-wr-mem-start = <0x2c>;
		qcom,mdss-dsi-wr-mem-continue = <0x3c>;
		qcom,mdss-dsi-te-dcs-command = <1>;
		qcom,mdss-dsi-te-check-enable;
		qcom,mdss-dsi-te-using-te-pin;
		qcom,mdss-dsi-panel-timings = [6A 16 0E 00 38 3C 12 18 2A 03 04 00];
		qcom,mdss-dsi-t-clk-post = <0x3c>;
		qcom,mdss-dsi-t-clk-pre = <0x08>;
		qcom,mdss-dsi-bl-min-level = <1>;
		qcom,mdss-dsi-bl-max-level = <255>;
		qcom,mdss-dsi-dma-trigger = "trigger_sw";
		qcom,mdss-dsi-mdp-trigger = "none";
		qcom,mdss-dsi-bl-pmic-control-type = "bl_ctrl_dcs";
		qcom,mdss-dsi-reset-sequence = <0 10>, <1 5>, <0 10>;
		qcom,mdss-pan-physical-width-dimension = <36>;
		qcom,mdss-pan-physical-height-dimension = <36>;
		qcom,delta-pixel;
	};
};
