/* Copyright (c) 2013, The Linux Foundation. All rights reserved.
 *
 * This program is free software; you can redistribute it and/or modify
 * it under the terms of the GNU General Public License version 2 and
 * only version 2 as published by the Free Software Foundation.
 *
 * This program is distributed in the hope that it will be useful,
 * but WITHOUT ANY WARRANTY; without even the implied warranty of
 * MERCHANTABILITY or FITNESS FOR A PARTICULAR PURPOSE.  See the
 * GNU General Public License for more details.
 */

/*---------------------------------------------------------------------------
 * This file is autogenerated file using gcdb parser. Please do not edit it.
 * Update input XML file to add a new entry or update variable in this file
 * VERSION = "1.0"
 *---------------------------------------------------------------------------*/
&mdss_mdp {
	dsi_boe_amoled_cmd: qcom,mdss_dsi_boe_amoled_cmd {
		qcom,mdss-dsi-panel-name = "BOE AMOLED command mode dsi panel";
		qcom,mdss-dsi-panel-controller = <&mdss_dsi0>;
		qcom,mdss-dsi-panel-type = "dsi_cmd_mode";
		qcom,mdss-dsi-panel-destination = "display_1";
		qcom,mdss-dsi-panel-framerate = <60>;
		qcom,mdss-dsi-virtual-channel-id = <0>;
		qcom,mdss-dsi-stream = <0>;
		qcom,mdss-dsi-panel-width = <454>;
		qcom,mdss-dsi-panel-height = <454>;
		qcom,mdss-dsi-h-front-porch = <6>;
		qcom,mdss-dsi-h-back-porch = <6>;
		qcom,mdss-dsi-h-pulse-width = <6>;
		qcom,mdss-dsi-h-sync-skew = <0>;
		qcom,mdss-dsi-v-back-porch = <6>;
		qcom,mdss-dsi-v-front-porch = <6>;
		qcom,mdss-dsi-v-pulse-width = <2>;
		qcom,mdss-dsi-h-left-border = <10>;
		qcom,mdss-dsi-h-right-border = <10>;
		qcom,mdss-dsi-v-top-border = <10>;
		qcom,mdss-dsi-v-bottom-border = <10>;
		qcom,mdss-dsi-bpp = <24>;
		qcom,mdss-dsi-color-order = "rgb_swap_rgb";
		qcom,mdss-dsi-underflow-color = <0xff>;
		qcom,mdss-dsi-border-color = <0>;
		qcom,mdss-dsi-pixel-packing = "tight";
		qcom,mdss-dsi-pixel-alignment = <0>;
		qcom,mdss-dsi-on-command = [15 01 00 00 00 00 02 FE 01
				15 01 00 00 00 00 02 36 20
				15 01 00 00 00 00 02 14 A0
				15 01 00 00 00 00 02 70 55
				15 01 00 00 00 00 02 FE 0A
				15 01 00 00 00 00 02 29 10
				15 01 00 00 00 00 02 FE 05
				15 01 00 00 00 00 02 05 01
				15 01 00 00 00 00 02 FE 04
				15 01 00 00 00 00 02 1B 8D
				15 01 00 00 00 00 02 FE 02
				15 01 00 00 00 00 02 00 03
				15 01 00 00 00 00 02 01 ff
				15 01 00 00 00 00 02 34 03
				15 01 00 00 00 00 02 35 ff
				15 01 00 00 00 00 02 69 03
				15 01 00 00 00 00 02 6a ff
				15 01 00 00 00 00 02 FE 00
				15 01 00 00 00 00 02 35 00
				39 01 00 00 00 00 05 2A 00 0C 01 D1
				39 01 00 00 00 00 05 2B 00 00 01 C5
				05 01 00 00 78 00 02 11 00];
		qcom,mdss-dsi-post-panel-on-command = [05 01 00 00 14 00 02 29 00];
		qcom,mdss-dsi-off-command = [05 01 00 00 32 00 02 28 00
				05 01 00 00 78 00 02 10 00];
		qcom,mdss-dsi-on-command-state = "dsi_hs_mode";
		qcom,mdss-dsi-off-command-state = "dsi_hs_mode";
		qcom,mdss-dsi-h-sync-pulse = <1>;
		qcom,mdss-dsi-traffic-mode = "burst_mode";
		qcom,mdss-dsi-lane-map = "lane_map_0123";
		qcom,mdss-dsi-bllp-eof-power-mode;
		qcom,mdss-dsi-bllp-power-mode;
		qcom,mdss-dsi-lane-0-state;
		qcom,mdss-tear-check-frame-rate = <5700>;
		qcom,mdss-dsi-te-pin-select = <1>;
		qcom,mdss-dsi-te-v-sync-rd-ptr-irq-line = <0x2c>;
		qcom,mdss-dsi-te-dcs-command = <1>;
		qcom,mdss-dsi-te-check-enable;
		qcom,mdss-dsi-te-using-te-pin;
		qcom,mdss-dsi-panel-timings = [66 14 0c 00 34 38 10 18 0e 03 04 00];
		qcom,mdss-dsi-t-clk-post = <0x05>;
		qcom,mdss-dsi-t-clk-pre = <0x16>;
		qcom,mdss-dsi-bl-min-level = <1>;
		qcom,mdss-dsi-bl-max-level = <255>;
		qcom,mdss-dsi-dma-trigger = "trigger_sw";
		qcom,mdss-dsi-mdp-trigger = "none";
		qcom,mdss-dsi-bl-pmic-control-type = "bl_ctrl_dcs";
		qcom,mdss-dsi-reset-sequence = <0 20>, <1 20>;
	};
};
