/* Copyright (c) 2017-2018, The Linux Foundation. All rights reserved.
 *
 * This program is free software; you can redistribute it and/or modify
 * it under the terms of the GNU General Public License version 2 and
 * only version 2 as published by the Free Software Foundation.
 *
 * This program is distributed in the hope that it will be useful,
 * but WITHOUT ANY WARRANTY; without even the implied warranty of
 * MERCHANTABILITY or FITNESS FOR A PARTICULAR PURPOSE.  See the
 * GNU General Public License for more details.
 */

&mdss_mdp {
	dsi_auo_x120_amoled_cmd: qcom,mdss_dsi_auo_x120_amoled_cmd {
		qcom,mdss-dsi-panel-name = "AUO 390p command mode dsi panel";
		qcom,mdss-dsi-panel-type = "dsi_cmd_mode";
		qcom,mdss-dsi-panel-framerate = <45>;
		qcom,mdss-dsi-virtual-channel-id = <0>;
		qcom,mdss-dsi-stream = <0>;
		qcom,mdss-dsi-panel-width = <390>;
		qcom,mdss-dsi-panel-height = <390>;
		qcom,mdss-pan-physical-height-dimension = <29>;
		qcom,mdss-pan-physical-width-dimension = <29>;
		qcom,mdss-dsi-h-front-porch = <4>;
		qcom,mdss-dsi-h-back-porch = <4>;
		qcom,mdss-dsi-h-pulse-width = <4>;
		qcom,mdss-dsi-h-sync-skew = <0>;
		qcom,mdss-dsi-v-back-porch = <8>;
		qcom,mdss-dsi-v-front-porch = <8>;
		qcom,mdss-dsi-v-pulse-width = <8>;
		qcom,mdss-dsi-h-left-border = <0>;
		qcom,mdss-dsi-h-right-border = <0>;
		qcom,mdss-dsi-v-top-border = <0>;
		qcom,mdss-dsi-v-bottom-border = <0>;
		qcom,mdss-dsi-bpp = <24>;
		qcom,mdss-dsi-color-order = "rgb_swap_rgb";
		qcom,mdss-dsi-underflow-color = <0xff>;
		qcom,mdss-dsi-border-color = <0>;
		qcom,mdss-tear-check-frame-rate = <4500>;
		/*
		byte 0: dcs data type
		byte 1: set to indicate;
			this is an individual packet (no chain) 
		byte 2: virtual channel number
		byte 3: expect ack from client (dcs read command)
		byte 4: wait number of specified ms;
			 after dcs command transmitted 
		byte 5, 6: 16 bits length in network byte order
		byte 7 and beyond: number byte of payload
		*/
		qcom,mdss-dsi-on-command = [
			05 01 00 00 03 00 02 00 00
			15 01 00 00 00 00 02 FE 01
			15 01 00 00 00 00 02 0A F0
			15 01 00 00 00 00 02 FE 0A
			15 01 00 00 00 00 02 29 92
			15 01 00 00 00 00 02 FE 00
			29 01 00 00 00 00 05 2A 00 02 01 87
			29 01 00 00 00 00 05 2B 00 00 01 85
			29 01 00 00 00 00 05 30 00 00 01 85
			29 01 00 00 00 00 05 31 00 02 01 87
			05 01 00 00 00 00 02 12 00
			15 01 00 00 00 00 02 35 00
			15 01 00 00 00 00 02 53 20
			15 01 00 00 00 00 02 FE 07
		        15 01 00 00 00 00 02 00 30
	           	15 01 00 00 00 00 02 FE 00
			/*05 01 00 00 96 00 02 11 00:
			reduce delay from 150ms(0x96) 
				to 82 ms (0x52) 
			*/
	           	05 01 00 00 52 00 02 11 00
			];
		qcom,mdss-dsi-post-panel-on-command = [
			05 01 00 00 00 00 02 29 00];

		qcom,mdss-dsi-off-command = [
			05 01 00 00 00 00 02 28 00
			05 01 00 00 78 00 02 10 00
			];
		qcom,mdss-dsi-on-command-state = "dsi_lp_mode";
		qcom,mdss-dsi-off-command-state = "dsi_hs_mode";

		qcom,mdss-dsi-idle-on-command = [
			05 01 00 00 00 00 01 39 /* Idle-Mode On */
			];
		qcom,mdss-dsi-idle-on-command-state = "dsi_hs_mode";
		qcom,mdss-dsi-idle-off-command = [
			05 01 00 00 00 00 01 38 /* Idle-Mode Off  */
			/* Reset column start address*/
			29 01 00 00 00 00 05 2a 00 04 01 89
			/* Reset row start address */
			29 01 00 00 00 00 05 2b 00 00 01 85
			15 01 00 00 00 00 02 fe 01
			15 01 00 00 00 00 02 04 00
			15 01 00 00 00 00 02 fe 00
			15 01 00 00 00 00 02 3a 77
			];
		
		qcom,mdss-dsi-hbm0-on-command = [
			15 01 00 00 00 00 02 fe 06
			15 01 00 00 00 00 02 ac 02
			15 01 00 00 00 00 02 ab 6a
			15 01 00 00 00 00 02 b6 01
			15 01 00 00 00 00 02 fe 00
			/* Wait 101 ms: 0x65*/
			15 01 00 00 65 00 02 55 01
			15 01 00 00 00 00 02 fe 01
			15 01 00 00 00 00 02 29 42
			15 01 00 00 00 00 02 fe 05
			15 01 00 00 00 00 02 00 12
			15 01 00 00 00 00 02 2a 08
			15 01 00 00 00 00 02 2f 04
			15 01 00 00 00 00 02 36 33
			15 01 00 00 00 00 02 fe 00
			15 01 00 00 65 00 02 55 01
			/* Wait 31 ms: 0x1f */
			15 01 00 00 1f 00 02 b0 06
			15 01 00 00 00 00 02 fe 01
			15 01 00 00 00 00 02 29 40
			15 01 00 00 00 00 02 11 93
			15 01 00 00 00 00 02 19 44
			15 01 00 00 00 00 02 fe 00
			];
		qcom,mdss-dsi-hbm1-on-command = [
			15 01 00 00 00 00 02 FE 00
			15 01 00 00 65 00 02 55 00
			15 01 00 00 00 00 02 FE 01
			15 01 00 00 00 00 02 29 42
			15 01 00 00 00 00 02 FE 05
			15 01 00 00 00 00 02 00 12
			15 01 00 00 00 00 02 2A 08
			15 01 00 00 00 00 02 2F 04
			15 01 00 00 00 00 02 36 33
			15 01 00 00 00 00 02 FE 00
			15 01 00 00 1F 00 02 B0 06
			15 01 00 00 00 00 02 FE 01
			15 01 00 00 00 00 02 29 40
			15 01 00 00 00 00 02 11 93
			15 01 00 00 1F 00 02 19 44
			15 01 00 00 00 00 02 FE 00
		];

		qcom,mdss-dsi-hbm-off-command = [
			15 01 00 00 00 00 02 FE 01
			15 01 00 00 00 00 02 29 42
			15 01 00 00 00 00 02 FE 00
			15 01 00 00 1F 00 02 B0 04
			15 01 00 00 00 00 02 FE 05
			15 01 00 00 00 00 02 00 12
			15 01 00 00 00 00 02 2A 08
			15 01 00 00 00 00 02 2F 04
			15 01 00 00 00 00 02 36 41
			15 01 00 00 00 00 02 FE 01
			15 01 00 00 00 00 02 29 40
			15 01 00 00 00 00 02 11 80
			15 01 00 00 00 00 02 19 33
			15 01 00 00 00 00 02 FE 00
			15 01 00 00 00 00 02 55 00
		];
		qcom,mdss-dsi-traffic-mode = "burst_mode";
		qcom,mdss-dsi-lane-map = "lane_map_0123";
		qcom,mdss-dsi-bllp-eof-power-mode;
		qcom,mdss-dsi-bllp-power-mode;
		qcom,mdss-dsi-lane-0-state;
		qcom,mdss-dsi-te-pin-select = <1>;
		qcom,mdss-dsi-te-dcs-command = <1>;
		qcom,mdss-dsi-te-using-te-pin;
		qcom,mdss-dsi-idle-fps = <10>;
		qcom,mdss-dsi-te-check-enable;
		qcom,mdss-dsi-panel-timings = 
			[
			5f 12 0a 00 32 34 10 16 0f 03 04 00
			];
		qcom,mdss-dsi-t-clk-post = <0x05>;
		qcom,mdss-dsi-t-clk-pre = <0x11>;
		qcom,mdss-dsi-bl-min-level = <1>;
		qcom,mdss-dsi-bl-max-level = <255>;
		qcom,mdss-dsi-dma-trigger = "trigger_sw";
		qcom,mdss-dsi-mdp-trigger = "none";
		qcom,mdss-dsi-bl-pmic-control-type = "bl_ctrl_dcs";
		qcom,mdss-dsi-reset-sequence = <0 10>, <1 15>;
		/* clk = totlaH * totalV * bpp* 66fps */
		//qcom,mdss-dsi-panel-clockrate = <276705792>;
		qcom,mdss-dsi-panel-clockrate = <229213440>;
		qcom,esd-check-enabled;
		qcom,mdss-dsi-panel-status-check-mode = "te_signal_check";
	};
};
