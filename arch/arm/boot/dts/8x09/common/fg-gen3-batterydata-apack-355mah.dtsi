
qcom,3452922_compal_ffwa_355mah_averaged_masterslave_jun18th2018 {
	qcom, = <24>;
	/* #3452922_Compal_FFWA_355mAh_averaged_MasterSlave_Jun18th2018*/
	qcom,max-voltage-uv = <4395000>;
	qcom,fastchg-current-ma = <350>;
	qcom,nom-batt-capacity-mah = <355>;
	qcom,batt-id-kohm = <60>;
	qcom,battery-beta = <3435>;
	qcom,fg-cc-cv-threshold-mv = <4385>;
	qcom,battery-type = "darter_355mah_jun18th2018";
	qcom,checksum = <0x0130>;
	qcom,gui-version = "PM660GUI - 0.0.0.45";
	qcom,fg-profile-data = [
		 83 21 C0 0D
		 DF 0B 21 05
		 CC 1C C8 01
		 91 04 C0 03
		 02 19 DC 1B
		 A6 3D FD 43
		 90 00 00 00
		 19 00 00 00
		 00 00 78 C5
		 F1 CD 19 C3
		 44 00 08 00
		 CA DB 99 F5
		 41 ED FC 07
		 D4 E2 8A 03
		 C6 F5 18 3A
		 22 06 09 20
		 27 00 14 00
		 E2 1F 5A 05
		 AE 0A 25 FC
		 C9 1C BC 02
		 72 0C DA 0B
		 9F 18 4C 23
		 DA 44 17 5A
		 6E 00 00 00
		 10 00 00 00
		 00 00 52 D5
		 E5 AB 8C CB
		 40 00 00 00
		 16 01 99 F5
		 DF 07 F5 ED
		 9E F2 15 02
		 D4 02 1A 13
		 C0 33 CC FF
		 07 10 00 00
		 62 01 51 46
		 40 00 40 00
		 5E 06 0A FA
		 FF 00 00 00
		 00 00 00 00
		 00 00 00 00
		 00 00 00 00
		 00 00 00 00
		 00 00 00 00
		 00 00 00 00
		 00 00 00 00
		 00 00 00 00
		 00 00 00 00
		 00 00 00 00
		 00 00 00 00
		 00 00 00 00
		 00 00 00 00
		 00 00 00 00
		 00 00 00 00
		 00 00 00 00
		 00 00 00 00
		 00 00 00 00
	];
};
