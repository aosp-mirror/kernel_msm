/* Copyright (c) 2017-2018 The Linux Foundation. All rights reserved.
 *
 * This program is free software; you can redistribute it and/or modify
 * it under the terms of the GNU General Public License version 2 and
 * only version 2 as published by the Free Software Foundation.
 *
 * This program is distributed in the hope that it will be useful,
 * but WITHOUT ANY WARRANTY; without even the implied warranty of
 * MERCHANTABILITY or FITNESS FOR A PARTICULAR PURPOSE.  See the
 * GNU General Public License for more details.
 */
#include "../../../../../arm64/boot/dts/qcom/msm8909-audio-bg_codec.dtsi"
&soc {
	audio_codec_bg: sound {
		/delete-property/ status;
		status = "okay";
	};

	bg_cdc: bg_codec {
		/delete-property/ status;
		status = "okay";
	};
};
