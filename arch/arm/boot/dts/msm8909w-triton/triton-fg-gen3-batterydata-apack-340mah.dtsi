
qcom,3326775_compal_dbw2_340mah_averaged_masterslave_mar23rd2018 {
	qcom, = <24>;
	/* #3326775_Compal_DBW2_340mAh_averaged_MasterSlave_Mar23rd2018*/
	qcom,max-voltage-uv = <4350000>;
	qcom,fastchg-current-ma = <340>;
	qcom,nom-batt-capacity-mah = <340>;
	qcom,batt-id-kohm = <60>;
	qcom,battery-beta = <4250>;
	qcom,fg-cc-cv-threshold-mv = <4340>;
	qcom,battery-type = "triton_340mah_mar23rd2018";
	qcom,checksum = <0x2A69>;
	qcom,gui-version = "PM660GUI - 0.0.0.45";
	qcom,fg-profile-data = [
		 98 1F A5 05
		 51 0A F9 FC
		 CA 1C 06 02
		 C3 0D 68 0A
		 00 19 4B 22
		 AB 3C 5D 4B
		 7B 00 00 00
		 15 00 00 00
		 00 00 9F C5
		 AF CD 01 00
		 32 00 08 00
		 B3 ED DF E5
		 F9 ED 32 E5
		 E6 05 29 01
		 02 05 B3 4A
		 0F 06 09 20
		 27 00 14 00
		 E1 1F 76 05
		 78 0A 4E 06
		 D4 1C 9F 02
		 A6 0C 88 0B
		 A4 18 4E 23
		 D6 44 19 5A
		 71 00 00 00
		 10 00 00 00
		 00 00 62 D5
		 89 BB 72 CB
		 30 00 00 00
		 39 F2 DF E5
		 E2 ED 39 E5
		 34 EA EB FB
		 4A 00 35 12
		 99 33 CC FF
		 07 10 00 00
		 60 01 99 45
		 30 00 40 00
		 FD 05 0A FA
		 FF 00 00 00
		 00 00 00 00
		 00 00 00 00
		 00 00 00 00
		 00 00 00 00
		 00 00 00 00
		 00 00 00 00
		 00 00 00 00
		 00 00 00 00
		 00 00 00 00
		 00 00 00 00
		 00 00 00 00
		 00 00 00 00
		 00 00 00 00
		 00 00 00 00
		 00 00 00 00
		 00 00 00 00
		 00 00 00 00
		 00 00 00 00
	];
};
