/*
 * Copyright (c) 2016, HUAWEI TECHNOLOGIES CO., LTD. All rights reserved.
 *
 * This program is free software; you can redistribute it and/or modify
 * it under the terms of the GNU General Public License version 2 and
 * only version 2 as published by the Free Software Foundation.
 *
 * This program is distributed in the hope that it will be useful,
 * but WITHOUT ANY WARRANTY; without even the implied warranty of
 * MERCHANTABILITY or FITNESS FOR A PARTICULAR PURPOSE.  See the
 * GNU General Public License for more details.
 */

/dts-v1/;

#include "qcom/msm8909-mtp.dtsi"
#include "qcom/msm8909w-gpu.dtsi"
#include "qcom/msm8909-pm8916.dtsi"
#include "qcom/msm8909-pm8916-mtp.dtsi"
#include "qcom/msm8909w.dtsi"

#include "apq8009w-sawshark/apq8009w-common.dtsi"
#include "apq8009w-sawshark/apq8009w-dispaly.dtsi"
#include "apq8009w-sawshark/apq8009w-pinctrl.dtsi"
#include "apq8009w-sawshark/apq8009w-pm.dtsi"
#include "apq8009w-sawshark/apq8009w-touch.dtsi"
#include "apq8009w-sawshark/apq8009w-bt.dtsi"
#include "apq8009w-sawshark/apq8009w-wifi.dtsi"
#include "apq8009w-sawshark/apq8009w-mcu.dtsi"
#include "apq8009w-sawshark/apq8009w-sound.dtsi"
#include "apq8009w-sawshark/apq8009w-nfc.dtsi"
/ {
	model = "Qualcomm Technologies, Inc. APQ8009W-PM8916 MTP";
	compatible = "qcom,apq8009-mtp", "qcom,apq8009", "qcom,mtp";
	qcom,msm-id = <300 0>,
		      <301 0>;
	qcom,board-id= <8 5>;
};
