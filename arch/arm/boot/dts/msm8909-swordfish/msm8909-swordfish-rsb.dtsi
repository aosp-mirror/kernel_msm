 /*
 * This program is free software; you can redistribute it and/or modify
 * it under the terms of the GNU General Public License version 2 and
 * only version 2 as published by the Free Software Foundation.
 *
 * This program is distributed in the hope that it will be useful,
 * but WITHOUT ANY WARRANTY; without even the implied warranty of
 * MERCHANTABILITY or FITNESS FOR A PARTICULAR PURPOSE.  See the
 * GNU General Public License for more details.
 */

/*
 * msm8909-swordfish-rsb: rotating side button config
 */

&spi_0  {
	pinctrl-names = "spi_default", "spi_sleep";
	pinctrl-0 = <&spi0_default>;
	pinctrl-1 = <&spi0_sleep>;
	rsb: rsb@0 {
		compatible = "rsb";
		reg = <0>;
		interrupt-parent = <&msm_gpio>;
		interrupts = <95 0x00>;
		spi-max-frequency = <2000000>;
		rsb,vld-supply = <&haptic_ext_vreg>;
		rsb,vdd-supply = <&pm8916_l16>;
		pinctrl-names = "default";
		pinctrl-0 = <&rsb_motion_gpio>;
	};
};
