/* Copyright (c) 2016, LGE Inc. All rights reserved.
 *
 * This program is free software; you can redistribute it and/or modify
 * it under the terms of the GNU General Public License version 2 and
 * only version 2 as published by the Free Software Foundation.
 *
 * This program is distributed in the hope that it will be useful,
 * but WITHOUT ANY WARRANTY; without even the implied warranty of
 * MERCHANTABILITY or FITNESS FOR A PARTICULAR PURPOSE.  See the
 * GNU General Public License for more details.
 */

#include "dsi-panel-anx7805-720p-video.dtsi"

&mdss_mdp {
	qcom,mdss-pref-prim-intf = "dsi";
};

&mdss_dsi0 {
	qcom,dsi-pref-prim-pan = <&dsi_anx7805_720p_video>;
	/delete-property/vdd-supply;
	/delete-property/vddio-supply;
	/delete-property/pinctrl-names;
	/delete-property/pinctrl-0;
	/delete-property/pinctrl-1;
	/delete-property/qcom,platform-te-gpio;
	/delete-property/qcom,platform-reset-gpio;
	/delete-property/qcom,platform-enable-gpio;
};

&mdss_dsi0_pll {
	vddio-supply = <&pm8916_l6>;
};

&dsi_anx7805_720p_video {
	qcom,cont-splash-enabled;
};
