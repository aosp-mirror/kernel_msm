/* Copyright (c) 2016, LGE Inc. All rights reserved.
 *
 * This program is free software; you can redistribute it and/or modify
 * it under the terms of the GNU General Public License version 2 and
 * only version 2 as published by the Free Software Foundation.
 *
 * This program is distributed in the hope that it will be useful,
 * but WITHOUT ANY WARRANTY; without even the implied warranty of
 * MERCHANTABILITY or FITNESS FOR A PARTICULAR PURPOSE.  See the
 * GNU General Public License for more details.
 */

&soc {
	haptic_ext_vreg: haptic_ext_vreg {
		compatible = "regulator-fixed";
		regulator-name = "haptic_ext_vreg";
		startup-delay-us = <250>;
		enable-active-high;
		gpio = <&msm_gpio 26 0x00>;
	 };
};
