/* Copyright (c) 2016, LGE Inc. All rights reserved.
 *
 * This program is free software; you can redistribute it and/or modify
 * it under the terms of the GNU General Public License version 2 and
 * only version 2 as published by the Free Software Foundation.
 *
 * This program is distributed in the hope that it will be useful,
 * but WITHOUT ANY WARRANTY; without even the implied warranty of
 * MERCHANTABILITY or FITNESS FOR A PARTICULAR PURPOSE.  See the
 * GNU General Public License for more details.
 */

#include "msm8909-swordfish.dtsi"
#include "../qcom/msm8909w-gpu.dtsi"
#include "../qcom/msm8909-pm8916.dtsi"
#include "../qcom/msm8909w.dtsi"
#include "msm8909-swordfish-panel.dtsi"
#include "msm8909-pm8916-swordfish.dtsi"
#include "msm8909-swordfish-sound.dtsi"
#include "msm8909-swordfish-nanohub.dtsi"
#include "msm8909-swordfish-paj9124u1.dtsi"

&paj9124u1 {
	pixart,vld-supply = <&pm8916_l17>;
	/delete-property/pixart,vdd-supply;
};

&rpm_bus {
	rpm-regulator-ldoa17 {
		status = "okay";
		pm8916_l17: regulator-l17 {
			regulator-min-microvolt = <3300000>;
			regulator-max-microvolt = <3300000>;
			qcom,init-voltage = <3300000>;
			status = "okay";
		};
	};
};
