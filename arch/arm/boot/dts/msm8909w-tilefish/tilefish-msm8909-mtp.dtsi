/* Copyright (c) 2014-2018, The Linux Foundation. All rights reserved.
 *
 * This program is free software; you can redistribute it and/or modify
 * it under the terms of the GNU General Public License version 2 and
 * only version 2 as published by the Free Software Foundation.
 *
 * This program is distributed in the hope that it will be useful,
 * but WITHOUT ANY WARRANTY; without even the implied warranty of
 * MERCHANTABILITY or FITNESS FOR A PARTICULAR PURPOSE.  See the
 * GNU General Public License for more details.
 */

#include "tilefish-msm8909-mdss.dtsi"

&soc {
	i2c@78b9000 { /* BLSP1 QUP5 */
		/delete-node/ synaptics@20;
	};

	gpio_keys {
		label = "gpio-keys";
		/delete-node/ camera_focus;
		/delete-node/ camera_snapshot;
		/delete-node/ vol_up;
		stem_1 {
			label = "STEM_1";
			gpios = <&msm_gpio 90 0x1>;
			linux,input-type = <1>;
			linux,code = <265>;
			gpio-key,wakeup;
			debounce-interval = <15>;
		};
	};
};
