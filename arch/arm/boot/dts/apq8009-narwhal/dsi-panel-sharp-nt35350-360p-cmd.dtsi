/* Copyright (c) 2017, LGE Inc. All rights reserved.
 *
 * This program is free software; you can redistribute it and/or modify
 * it under the terms of the GNU General Public License version 2 and
 * only version 2 as published by the Free Software Foundation.
 *
 * This program is distributed in the hope that it will be useful,
 * but WITHOUT ANY WARRANTY; without even the implied warranty of
 * MERCHANTABILITY or FITNESS FOR A PARTICULAR PURPOSE.  See the
 * GNU General Public License for more details.
 */

&mdss_mdp {
	dsi_sharp_nt35350_cmd: qcom,mdss_dsi_sharp_nt35350_360p_cmd {
		qcom,mdss-dsi-panel-name = "NT35350 360p command mode dsi panel";
		qcom,mdss-dsi-panel-controller = <&mdss_dsi0>;
		qcom,mdss-dsi-panel-type = "dsi_cmd_mode";
		qcom,mdss-dsi-panel-destination = "display_1";
		qcom,mdss-dsi-panel-framerate = <60>;
		qcom,mdss-dsi-virtual-channel-id = <0>;
		qcom,mdss-dsi-stream = <0>;
		qcom,mdss-dsi-panel-width = <360>;
		qcom,mdss-dsi-panel-height = <360>;
		qcom,mdss-dsi-h-front-porch = <5>;
		qcom,mdss-dsi-h-back-porch = <5>;
		qcom,mdss-dsi-h-pulse-width = <5>;
		qcom,mdss-dsi-h-sync-skew = <0>;
		qcom,mdss-dsi-v-back-porch = <5>;
		qcom,mdss-dsi-v-front-porch = <5>;
		qcom,mdss-dsi-v-pulse-width = <5>;
		qcom,mdss-dsi-h-left-border = <0>;
		qcom,mdss-dsi-h-right-border = <0>;
		qcom,mdss-dsi-v-top-border = <0>;
		qcom,mdss-dsi-v-bottom-border = <0>;
		qcom,mdss-dsi-bpp = <24>;
		qcom,mdss-dsi-color-order = "rgb_swap_rgb";
		qcom,mdss-dsi-underflow-color = <0xff>;
		qcom,mdss-dsi-border-color = <0>;
		qcom,mdss-dsi-on-command = [
			15 01 00 00 00 00 02 FF 10
			15 01 00 00 00 00 02 B3 00
			15 01 00 00 00 00 02 BB 10
			15 01 00 00 00 00 02 FF 24
			15 01 00 00 00 00 02 FB 01
			15 01 00 00 00 00 02 66 D5
			15 01 00 00 00 00 02 6E 00
			15 01 00 00 00 00 02 99 D8
			15 01 00 00 00 00 02 FF E0
			15 01 00 00 00 00 02 FB 01
			15 01 00 00 00 00 02 01 AA
			15 01 00 00 00 00 02 FF 10
			15 01 00 00 00 00 02 35 00
			05 01 00 00 3C 00 01 11 /* Sleep out */
			];
		qcom,mdss-dsi-panel-on-command = [
			05 01 00 00 00 00 01 29 /* Display On */
			];
		qcom,mdss-dsi-post-panel-on-command = [
			39 01 00 00 00 00 01 2C
			39 01 00 00 00 00 01 3C
			];
		qcom,mdss-dsi-off-command = [
			15 01 00 00 00 00 02 FF 20
			15 01 00 00 00 00 02 FB 01
			15 01 00 00 00 00 02 61 00
			15 01 00 00 00 00 02 62 00
			15 01 00 00 00 00 02 FF 10
			05 01 00 00 64 00 01 28
			05 01 00 00 5A 00 01 10
			];
		qcom,mdss-dsi-on-command-state = "dsi_lp_mode";
		qcom,mdss-dsi-panel-on-command-state = "dsi_lp_mode";
		qcom,mdss-dsi-post-panel-on-command-state = "dsi_hs_mode";
		qcom,mdss-dsi-off-command-state = "dsi_lp_mode";
		qcom,mdss-dsi-h-sync-pulse = <1>;
		qcom,mdss-dsi-traffic-mode = "burst_mode";
		qcom,mdss-dsi-lane-map = "lane_map_0123";
		qcom,mdss-dsi-bllp-eof-power-mode;
		qcom,mdss-dsi-bllp-power-mode;
		qcom,mdss-dsi-lane-0-state;
		qcom,mdss-dsi-te-pin-select = <1>;
		qcom,mdss-dsi-te-dcs-command = <1>;
		qcom,mdss-dsi-te-check-enable;
		qcom,mdss-dsi-te-using-te-pin;
		qcom,mdss-tear-check-sync-cfg-height = <375>;
		qcom,esd-check-enabled;
		qcom,ulps-enabled;
		qcom,mdss-dsi-panel-status-check-mode ="te_signal_check";
		qcom,mdss-dsi-panel-timings = [48 0C 08 00 2A 2E 0C 10 08 03 04 00];
		qcom,mdss-dsi-t-clk-post = <0x05>;
		qcom,mdss-dsi-t-clk-pre = <0x12>;
		qcom,mdss-dsi-bl-min-level = <1>;
		qcom,mdss-dsi-bl-max-level = <255>;
		qcom,mdss-dsi-dma-trigger = "trigger_sw";
		qcom,mdss-dsi-mdp-trigger = "none";
		qcom,mdss-dsi-reset-sequence = <1 1>, <0 1>, <1 5>;
		qcom,mdss-dsi-lp11-init;
		qcom,mdss-pan-physical-width-dimension = <30>;
		qcom,mdss-pan-physical-height-dimension = <30>;
	};

	dsi_sharp_nt35350_cmd_gamma: qcom,mdss_dsi_sharp_nt35350_360p_cmd_gamma {
		qcom,mdss-dsi-panel-name = "NT35350 360p command mode dsi panel gamma";
		qcom,mdss-dsi-panel-controller = <&mdss_dsi0>;
		qcom,mdss-dsi-panel-type = "dsi_cmd_mode";
		qcom,mdss-dsi-panel-destination = "display_1";
		qcom,mdss-dsi-panel-framerate = <60>;
		qcom,mdss-dsi-virtual-channel-id = <0>;
		qcom,mdss-dsi-stream = <0>;
		qcom,mdss-dsi-panel-width = <360>;
		qcom,mdss-dsi-panel-height = <360>;
		qcom,mdss-dsi-h-front-porch = <5>;
		qcom,mdss-dsi-h-back-porch = <5>;
		qcom,mdss-dsi-h-pulse-width = <5>;
		qcom,mdss-dsi-h-sync-skew = <0>;
		qcom,mdss-dsi-v-back-porch = <5>;
		qcom,mdss-dsi-v-front-porch = <5>;
		qcom,mdss-dsi-v-pulse-width = <5>;
		qcom,mdss-dsi-h-left-border = <0>;
		qcom,mdss-dsi-h-right-border = <0>;
		qcom,mdss-dsi-v-top-border = <0>;
		qcom,mdss-dsi-v-bottom-border = <0>;
		qcom,mdss-dsi-bpp = <24>;
		qcom,mdss-dsi-color-order = "rgb_swap_rgb";
		qcom,mdss-dsi-underflow-color = <0xff>;
		qcom,mdss-dsi-border-color = <0>;
		qcom,mdss-dsi-on-command = [
			15 01 00 00 00 00 02 FF 10
			15 01 00 00 00 00 02 B3 00
			15 01 00 00 00 00 02 BB 10
			15 01 00 00 00 00 02 FF 24
			15 01 00 00 00 00 02 FB 01
			15 01 00 00 00 00 02 66 D5
			15 01 00 00 00 00 02 6E 00
			15 01 00 00 00 00 02 99 D8
			15 01 00 00 00 00 02 FF E0
			15 01 00 00 00 00 02 FB 01
			15 01 00 00 00 00 02 01 AA
			15 01 00 00 00 00 02 FF 10
			15 01 00 00 00 00 02 35 00
			15 01 00 00 00 00 02 FF 20 /* Gamma Setting */
			15 01 00 00 00 00 02 75 00 /* R gamma positive */
			15 01 00 00 00 00 02 76 17
			15 01 00 00 00 00 02 77 00
			15 01 00 00 00 00 02 78 18
			15 01 00 00 00 00 02 79 00
			15 01 00 00 00 00 02 7A 28
			15 01 00 00 00 00 02 7B 00
			15 01 00 00 00 00 02 7C 51
			15 01 00 00 00 00 02 7D 00
			15 01 00 00 00 00 02 7E 61
			15 01 00 00 00 00 02 7F 00
			15 01 00 00 00 00 02 80 76
			15 01 00 00 00 00 02 81 00
			15 01 00 00 00 00 02 82 83
			15 01 00 00 00 00 02 83 00
			15 01 00 00 00 00 02 84 8F
			15 01 00 00 00 00 02 85 00
			15 01 00 00 00 00 02 86 9B
			15 01 00 00 00 00 02 87 00
			15 01 00 00 00 00 02 88 C3
			15 01 00 00 00 00 02 89 00
			15 01 00 00 00 00 02 8A E2
			15 01 00 00 00 00 02 8B 01
			15 01 00 00 00 00 02 8C 10
			15 01 00 00 00 00 02 8D 01
			15 01 00 00 00 00 02 8E 32
			15 01 00 00 00 00 02 8F 01
			15 01 00 00 00 00 02 90 65
			15 01 00 00 00 00 02 91 01
			15 01 00 00 00 00 02 92 93
			15 01 00 00 00 00 02 93 01
			15 01 00 00 00 00 02 94 93
			15 01 00 00 00 00 02 95 01
			15 01 00 00 00 00 02 96 D1
			15 01 00 00 00 00 02 97 02
			15 01 00 00 00 00 02 98 18
			15 01 00 00 00 00 02 99 02
			15 01 00 00 00 00 02 9A 44
			15 01 00 00 00 00 02 9B 02
			15 01 00 00 00 00 02 9C 7A
			15 01 00 00 00 00 02 9D 02
			15 01 00 00 00 00 02 9E 9B
			15 01 00 00 00 00 02 9F 02
			15 01 00 00 00 00 02 A0 C3
			15 01 00 00 00 00 02 A2 02
			15 01 00 00 00 00 02 A3 CE
			15 01 00 00 00 00 02 A4 02
			15 01 00 00 00 00 02 A5 DC
			15 01 00 00 00 00 02 A6 02
			15 01 00 00 00 00 02 A7 EA
			15 01 00 00 00 00 02 A9 02
			15 01 00 00 00 00 02 AA FA
			15 01 00 00 00 00 02 AB 03
			15 01 00 00 00 00 02 AC 0A
			15 01 00 00 00 00 02 AD 03
			15 01 00 00 00 00 02 AE 1E
			15 01 00 00 00 00 02 AF 03
			15 01 00 00 00 00 02 B0 39
			15 01 00 00 00 00 02 B1 03
			15 01 00 00 00 00 02 B2 46
			15 01 00 00 00 00 02 B3 00 /* R gamma negative */
			15 01 00 00 00 00 02 B4 00
			15 01 00 00 00 00 02 B5 00
			15 01 00 00 00 00 02 B6 01
			15 01 00 00 00 00 02 B7 00
			15 01 00 00 00 00 02 B8 11
			15 01 00 00 00 00 02 B9 00
			15 01 00 00 00 00 02 BA 3B
			15 01 00 00 00 00 02 BB 00
			15 01 00 00 00 00 02 BC 4C
			15 01 00 00 00 00 02 BD 00
			15 01 00 00 00 00 02 BE 61
			15 01 00 00 00 00 02 BF 00
			15 01 00 00 00 00 02 C0 6E
			15 01 00 00 00 00 02 C1 00
			15 01 00 00 00 00 02 C2 7A
			15 01 00 00 00 00 02 C3 00
			15 01 00 00 00 00 02 C4 86
			15 01 00 00 00 00 02 C5 00
			15 01 00 00 00 00 02 C6 B0
			15 01 00 00 00 00 02 C7 00
			15 01 00 00 00 00 02 C8 D1
			15 01 00 00 00 00 02 C9 01
			15 01 00 00 00 00 02 CA 01
			15 01 00 00 00 00 02 CB 01
			15 01 00 00 00 00 02 CC 27
			15 01 00 00 00 00 02 CD 01
			15 01 00 00 00 00 02 CE 60
			15 01 00 00 00 00 02 CF 01
			15 01 00 00 00 00 02 D0 92
			15 01 00 00 00 00 02 D1 01
			15 01 00 00 00 00 02 D2 93
			15 01 00 00 00 00 02 D3 01
			15 01 00 00 00 00 02 D4 C0
			15 01 00 00 00 00 02 D5 01
			15 01 00 00 00 00 02 D6 F7
			15 01 00 00 00 00 02 D7 02
			15 01 00 00 00 00 02 D8 1B
			15 01 00 00 00 00 02 D9 02
			15 01 00 00 00 00 02 DA 47
			15 01 00 00 00 00 02 DB 02
			15 01 00 00 00 00 02 DC 64
			15 01 00 00 00 00 02 DD 02
			15 01 00 00 00 00 02 DE 88
			15 01 00 00 00 00 02 DF 02
			15 01 00 00 00 00 02 E0 93
			15 01 00 00 00 00 02 E1 02
			15 01 00 00 00 00 02 E2 9F
			15 01 00 00 00 00 02 E3 02
			15 01 00 00 00 00 02 E4 AD
			15 01 00 00 00 00 02 E5 02
			15 01 00 00 00 00 02 E6 BB
			15 01 00 00 00 00 02 E7 02
			15 01 00 00 00 00 02 E8 CB
			15 01 00 00 00 00 02 E9 02
			15 01 00 00 00 00 02 EA DD
			15 01 00 00 00 00 02 EB 02
			15 01 00 00 00 00 02 EC F8
			15 01 00 00 00 00 02 ED 03
			15 01 00 00 00 00 02 EE 04
			15 01 00 00 00 00 02 EF 00 /* G gamma postive */
			15 01 00 00 00 00 02 F0 17
			15 01 00 00 00 00 02 F1 00
			15 01 00 00 00 00 02 F2 18
			15 01 00 00 00 00 02 F3 00
			15 01 00 00 00 00 02 F4 27
			15 01 00 00 00 00 02 F5 00
			15 01 00 00 00 00 02 F6 51
			15 01 00 00 00 00 02 F7 00
			15 01 00 00 00 00 02 F8 61
			15 01 00 00 00 00 02 F9 00
			15 01 00 00 00 00 02 FA 75
			15 01 00 00 00 00 02 FB 01 /* MTP No Reload CMD2 Page0 */
			15 01 00 00 00 00 02 FF 21 /* Switch to CMD2 Page1 */
			15 01 00 00 00 00 02 00 00 /* G gamma positive */
			15 01 00 00 00 00 02 01 83
			15 01 00 00 00 00 02 02 00
			15 01 00 00 00 00 02 03 90
			15 01 00 00 00 00 02 04 00
			15 01 00 00 00 00 02 05 9D
			15 01 00 00 00 00 02 06 00
			15 01 00 00 00 00 02 07 C4
			15 01 00 00 00 00 02 08 00
			15 01 00 00 00 00 02 09 E4
			15 01 00 00 00 00 02 0A 01
			15 01 00 00 00 00 02 0B 15
			15 01 00 00 00 00 02 0C 01
			15 01 00 00 00 00 02 0D 37
			15 01 00 00 00 00 02 0E 01
			15 01 00 00 00 00 02 0F 6A
			15 01 00 00 00 00 02 10 01
			15 01 00 00 00 00 02 11 97
			15 01 00 00 00 00 02 12 01
			15 01 00 00 00 00 02 13 98
			15 01 00 00 00 00 02 14 01
			15 01 00 00 00 00 02 15 D3
			15 01 00 00 00 00 02 16 02
			15 01 00 00 00 00 02 17 1D
			15 01 00 00 00 00 02 18 02
			15 01 00 00 00 00 02 19 46
			15 01 00 00 00 00 02 1A 02
			15 01 00 00 00 00 02 1B 80
			15 01 00 00 00 00 02 1C 02
			15 01 00 00 00 00 02 1D A5
			15 01 00 00 00 00 02 1E 02
			15 01 00 00 00 00 02 1F D3
			15 01 00 00 00 00 02 20 02
			15 01 00 00 00 00 02 21 E0
			15 01 00 00 00 00 02 22 02
			15 01 00 00 00 00 02 23 EF
			15 01 00 00 00 00 02 24 02
			15 01 00 00 00 00 02 25 FF
			15 01 00 00 00 00 02 26 03
			15 01 00 00 00 00 02 27 13
			15 01 00 00 00 00 02 28 03
			15 01 00 00 00 00 02 29 2B
			15 01 00 00 00 00 02 2A 03
			15 01 00 00 00 00 02 2B 47
			15 01 00 00 00 00 02 2D 03
			15 01 00 00 00 00 02 2F 6F
			15 01 00 00 00 00 02 30 03
			15 01 00 00 00 00 02 31 96
			15 01 00 00 00 00 02 32 00 /* G gamma negative */
			15 01 00 00 00 00 02 33 00
			15 01 00 00 00 00 02 34 00
			15 01 00 00 00 00 02 35 01
			15 01 00 00 00 00 02 36 00
			15 01 00 00 00 00 02 37 10
			15 01 00 00 00 00 02 38 00
			15 01 00 00 00 00 02 39 3B
			15 01 00 00 00 00 02 3A 00
			15 01 00 00 00 00 02 3B 4C
			15 01 00 00 00 00 02 3D 00
			15 01 00 00 00 00 02 3F 60
			15 01 00 00 00 00 02 40 00
			15 01 00 00 00 00 02 41 6E
			15 01 00 00 00 00 02 42 00
			15 01 00 00 00 00 02 43 7B
			15 01 00 00 00 00 02 44 00
			15 01 00 00 00 00 02 45 88
			15 01 00 00 00 00 02 46 00
			15 01 00 00 00 00 02 47 B1
			15 01 00 00 00 00 02 48 00
			15 01 00 00 00 00 02 49 D3
			15 01 00 00 00 00 02 4A 01
			15 01 00 00 00 00 02 4B 06
			15 01 00 00 00 00 02 4C 01
			15 01 00 00 00 00 02 4D 2C
			15 01 00 00 00 00 02 4E 01
			15 01 00 00 00 00 02 4F 65
			15 01 00 00 00 00 02 50 01
			15 01 00 00 00 00 02 51 96
			15 01 00 00 00 00 02 52 01
			15 01 00 00 00 00 02 53 98
			15 01 00 00 00 00 02 54 01
			15 01 00 00 00 00 02 55 C2
			15 01 00 00 00 00 02 56 01
			15 01 00 00 00 00 02 58 FC
			15 01 00 00 00 00 02 59 02
			15 01 00 00 00 00 02 5A 1D
			15 01 00 00 00 00 02 5B 02
			15 01 00 00 00 00 02 5C 4E
			15 01 00 00 00 00 02 5D 02
			15 01 00 00 00 00 02 5E 6E
			15 01 00 00 00 00 02 5F 02
			15 01 00 00 00 00 02 60 98
			15 01 00 00 00 00 02 61 02
			15 01 00 00 00 00 02 62 A5
			15 01 00 00 00 00 02 63 02
			15 01 00 00 00 00 02 64 B2
			15 01 00 00 00 00 02 65 02
			15 01 00 00 00 00 02 66 C2
			15 01 00 00 00 00 02 67 02
			15 01 00 00 00 00 02 68 D4
			15 01 00 00 00 00 02 69 02
			15 01 00 00 00 00 02 6A EC
			15 01 00 00 00 00 02 6B 03
			15 01 00 00 00 00 02 6C 06
			15 01 00 00 00 00 02 6D 03
			15 01 00 00 00 00 02 6E 2E
			15 01 00 00 00 00 02 6F 03
			15 01 00 00 00 00 02 70 54
			15 01 00 00 00 00 02 71 00 /* B gamma positive */
			15 01 00 00 00 00 02 72 17
			15 01 00 00 00 00 02 73 00
			15 01 00 00 00 00 02 74 18
			15 01 00 00 00 00 02 75 00
			15 01 00 00 00 00 02 76 24
			15 01 00 00 00 00 02 77 00
			15 01 00 00 00 00 02 78 4F
			15 01 00 00 00 00 02 79 00
			15 01 00 00 00 00 02 7A 5D
			15 01 00 00 00 00 02 7B 00
			15 01 00 00 00 00 02 7C 71
			15 01 00 00 00 00 02 7D 00
			15 01 00 00 00 00 02 7E 7F
			15 01 00 00 00 00 02 7F 00
			15 01 00 00 00 00 02 80 8D
			15 01 00 00 00 00 02 81 00
			15 01 00 00 00 00 02 82 99
			15 01 00 00 00 00 02 83 00
			15 01 00 00 00 00 02 84 C0
			15 01 00 00 00 00 02 85 00
			15 01 00 00 00 00 02 86 E0
			15 01 00 00 00 00 02 87 01
			15 01 00 00 00 00 02 88 0F
			15 01 00 00 00 00 02 89 01
			15 01 00 00 00 00 02 8A 31
			15 01 00 00 00 00 02 8B 01
			15 01 00 00 00 00 02 8C 65
			15 01 00 00 00 00 02 8D 01
			15 01 00 00 00 00 02 8E 92
			15 01 00 00 00 00 02 8F 01
			15 01 00 00 00 00 02 90 92
			15 01 00 00 00 00 02 91 01
			15 01 00 00 00 00 02 92 CF
			15 01 00 00 00 00 02 93 02
			15 01 00 00 00 00 02 94 16
			15 01 00 00 00 00 02 95 02
			15 01 00 00 00 00 02 96 3F
			15 01 00 00 00 00 02 97 02
			15 01 00 00 00 00 02 98 74
			15 01 00 00 00 00 02 99 02
			15 01 00 00 00 00 02 9A 93
			15 01 00 00 00 00 02 9B 02
			15 01 00 00 00 00 02 9C B8
			15 01 00 00 00 00 02 9D 02
			15 01 00 00 00 00 02 9E C1
			15 01 00 00 00 00 02 9F 02
			15 01 00 00 00 00 02 A0 CD
			15 01 00 00 00 00 02 A2 02
			15 01 00 00 00 00 02 A3 D9
			15 01 00 00 00 00 02 A4 02
			15 01 00 00 00 00 02 A5 E6
			15 01 00 00 00 00 02 A6 02
			15 01 00 00 00 00 02 A7 F3
			15 01 00 00 00 00 02 A9 03
			15 01 00 00 00 00 02 AA 02
			15 01 00 00 00 00 02 AB 03
			15 01 00 00 00 00 02 AC 14
			15 01 00 00 00 00 02 AB 03
			15 01 00 00 00 00 02 AC 14
			15 01 00 00 00 00 02 AD 03
			15 01 00 00 00 00 02 AE 1E
			15 01 00 00 00 00 02 AF 00 /* B gamma negative */
			15 01 00 00 00 00 02 B0 00
			15 01 00 00 00 00 02 B1 00
			15 01 00 00 00 00 02 B2 01
			15 01 00 00 00 00 02 B3 00
			15 01 00 00 00 00 02 B4 0D
			15 01 00 00 00 00 02 B5 00
			15 01 00 00 00 00 02 B6 39
			15 01 00 00 00 00 02 B7 00
			15 01 00 00 00 00 02 B8 48
			15 01 00 00 00 00 02 B9 00
			15 01 00 00 00 00 02 BA 5C
			15 01 00 00 00 00 02 BB 00
			15 01 00 00 00 00 02 BC 6A
			15 01 00 00 00 00 02 BD 00
			15 01 00 00 00 00 02 BE 78
			15 01 00 00 00 00 02 BF 00
			15 01 00 00 00 00 02 C0 84
			15 01 00 00 00 00 02 C1 00
			15 01 00 00 00 00 02 C2 AD
			15 01 00 00 00 00 02 C3 00
			15 01 00 00 00 00 02 C4 CF
			15 01 00 00 00 00 02 C5 01
			15 01 00 00 00 00 02 C6 00
			15 01 00 00 00 00 02 C7 01
			15 01 00 00 00 00 02 C8 26
			15 01 00 00 00 00 02 C9 01
			15 01 00 00 00 00 02 CA 5F
			15 01 00 00 00 00 02 CB 01
			15 01 00 00 00 00 02 CC 91
			15 01 00 00 00 00 02 CD 01
			15 01 00 00 00 00 02 CE 92
			15 01 00 00 00 00 02 CF 01
			15 01 00 00 00 00 02 D0 BE
			15 01 00 00 00 00 02 D1 01
			15 01 00 00 00 00 02 D2 F5
			15 01 00 00 00 00 02 D3 02
			15 01 00 00 00 00 02 D4 16
			15 01 00 00 00 00 02 D5 02
			15 01 00 00 00 00 02 D6 41
			15 01 00 00 00 00 02 D7 02
			15 01 00 00 00 00 02 D8 5C
			15 01 00 00 00 00 02 D9 02
			15 01 00 00 00 00 02 DA 7D
			15 01 00 00 00 00 02 DB 02
			15 01 00 00 00 00 02 DC 86
			15 01 00 00 00 00 02 DD 02
			15 01 00 00 00 00 02 DE 90
			15 01 00 00 00 00 02 DF 02
			15 01 00 00 00 00 02 E0 9C
			15 01 00 00 00 00 02 E1 02
			15 01 00 00 00 00 02 E2 A7
			15 01 00 00 00 00 02 E3 02
			15 01 00 00 00 00 02 E4 B4
			15 01 00 00 00 00 02 E5 02
			15 01 00 00 00 00 02 E6 C1
			15 01 00 00 00 00 02 E7 02
			15 01 00 00 00 00 02 E8 D3
			15 01 00 00 00 00 02 E9 02
			15 01 00 00 00 00 02 EA DB
			15 01 00 00 00 00 02 FB 01 /* MTP No Reload CMD2 Page1 */
			15 01 00 00 00 00 02 FF 10
			05 01 00 00 3C 00 01 11 /* Sleep out */
			];
		qcom,mdss-dsi-panel-on-command = [
			05 01 00 00 00 00 01 29 /* Display On */
			];
		qcom,mdss-dsi-post-panel-on-command = [
			39 01 00 00 00 00 01 2C
			39 01 00 00 00 00 01 3C
			];
		qcom,mdss-dsi-off-command = [
			15 01 00 00 00 00 02 FF 20
			15 01 00 00 00 00 02 FB 01
			15 01 00 00 00 00 02 61 00
			15 01 00 00 00 00 02 62 00
			15 01 00 00 00 00 02 FF 10
			05 01 00 00 64 00 01 28
			05 01 00 00 5A 00 01 10
			];
		qcom,mdss-dsi-on-command-state = "dsi_lp_mode";
		qcom,mdss-dsi-panel-on-command-state = "dsi_lp_mode";
		qcom,mdss-dsi-post-panel-on-command-state = "dsi_hs_mode";
		qcom,mdss-dsi-off-command-state = "dsi_lp_mode";
		qcom,mdss-dsi-h-sync-pulse = <1>;
		qcom,mdss-dsi-traffic-mode = "burst_mode";
		qcom,mdss-dsi-lane-map = "lane_map_0123";
		qcom,mdss-dsi-bllp-eof-power-mode;
		qcom,mdss-dsi-bllp-power-mode;
		qcom,mdss-dsi-lane-0-state;
		qcom,mdss-dsi-te-pin-select = <1>;
		qcom,mdss-dsi-te-dcs-command = <1>;
		qcom,mdss-dsi-te-check-enable;
		qcom,mdss-dsi-te-using-te-pin;
		qcom,mdss-tear-check-sync-cfg-height = <375>;
		qcom,esd-check-enabled;
		qcom,ulps-enabled;
		qcom,mdss-dsi-panel-status-check-mode ="te_signal_check";
		qcom,mdss-dsi-panel-timings = [48 0C 08 00 2A 2E 0C 10 08 03 04 00];
		qcom,mdss-dsi-t-clk-post = <0x05>;
		qcom,mdss-dsi-t-clk-pre = <0x12>;
		qcom,mdss-dsi-bl-min-level = <1>;
		qcom,mdss-dsi-bl-max-level = <255>;
		qcom,mdss-dsi-dma-trigger = "trigger_sw";
		qcom,mdss-dsi-mdp-trigger = "none";
		qcom,mdss-dsi-reset-sequence = <1 1>, <0 1>, <1 5>;
		qcom,mdss-dsi-lp11-init;
		qcom,mdss-pan-physical-width-dimension = <30>;
		qcom,mdss-pan-physical-height-dimension = <30>;
	};
};
