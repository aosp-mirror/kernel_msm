/* Copyright (c) 2017, LGE Inc. All rights reserved.
 *
 * This program is free software; you can redistribute it and/or modify
 * it under the terms of the GNU General Public License version 2 and
 * only version 2 as published by the Free Software Foundation.
 *
 * This program is distributed in the hope that it will be useful,
 * but WITHOUT ANY WARRANTY; without even the implied warranty of
 * MERCHANTABILITY or FITNESS FOR A PARTICULAR PURPOSE.  See the
 * GNU General Public License for more details.
 */

&soc {
	load_sw_control: load_sw_control {
		compatible = "lge,load-sw-control";
		status = "okay";
		pinctrl-names = "default","suspend";
		pinctrl-0 = <&load_sw_active>;
		pinctrl-1 = <&load_sw_suspend>;
		load-sw-gpio = <&msm_gpio 28 0>;
		load-sw-force-high;
	};
};
