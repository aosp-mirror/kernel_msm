/* Copyright (c) 2017, LGE Inc. All rights reserved.
 *
 * This program is free software; you can redistribute it and/or modify
 * it under the terms of the GNU General Public License version 2 and
 * only version 2 as published by the Free Software Foundation.
 *
 * This program is distributed in the hope that it will be useful,
 * but WITHOUT ANY WARRANTY; without even the implied warranty of
 * MERCHANTABILITY or FITNESS FOR A PARTICULAR PURPOSE.  See the
 * GNU General Public License for more details.
 */

&i2c_6 {
	movement_on_i2c6: lge,soprod_movement@48 {
		compatible = "lge,soprod_movement";
		reg = <0x48>;
		status = "disabled";
		lge,gpio-reset = <&msm_gpio 33 0x0>;
		lge,gpio-interrupt = <&msm_gpio 34 0x0>;
		lge,gpio-bslen = <&msm_gpio 16 0x0>;
		lge,gpio-temp-1 = <&msm_gpio 22 0x0>;
		lge,reset-delay-ms = <1000>;
		lge,hctosys-pre-delay-ms = <0>;
		lge,hctosys-post-delay-ms = <0>;
		lge,fw-ver-check-delay-ms = <0>;
		lge,hands-settle-time-ms = <2000>;
		lge,eol-limit-mv = <3300>;
		lge,eol-threshold-mv = <3600>;
		lge,update-syslock-on-boot;
	};
};

&i2c_4 {
	movement_on_i2c4: lge,soprod_movement@48 {
		compatible = "lge,soprod_movement";
		reg = <0x48>;
		status = "okay";
		lge,gpio-reset = <&msm_gpio 33 0x0>;
		lge,gpio-interrupt = <&msm_gpio 34 0x0>;
		lge,gpio-bslen = <&msm_gpio 16 0x0>;
		lge,gpio-temp-1 = <&msm_gpio 22 0x0>;
		lge,reset-delay-ms = <1000>;
		lge,hctosys-pre-delay-ms = <0>;
		lge,hctosys-post-delay-ms = <0>;
		lge,fw-ver-check-delay-ms = <0>;
		lge,hands-settle-time-ms = <2000>;
		lge,eol-limit-mv = <3300>;
		lge,eol-threshold-mv = <3600>;
		lge,update-syslock-on-boot;
	};
};
