/* Copyright (c) 2017, LGE Inc. All rights reserved.
 *
 * This program is free software; you can redistribute it and/or modify
 * it under the terms of the GNU General Public License version 2 and
 * only version 2 as published by the Free Software Foundation.
 *
 * This program is distributed in the hope that it will be useful,
 * but WITHOUT ANY WARRANTY; without even the implied warranty of
 * MERCHANTABILITY or FITNESS FOR A PARTICULAR PURPOSE.  See the
 * GNU General Public License for more details.
 */

&soc {
	i2c@78b8000 { /* BLSP1 QUP4 */
		backlight_dsv: lm36272@11 {
			compatible = "leds,lm36272";
			status = "okay";
			reg = <0x11>;
			lm36272,gpio-dsv-p-en = <&msm_gpio 95 0x00>;
			lm36272,gpio-dsv-n-en = <&msm_gpio 83 0x00>;
			lm36272,min-brightness = <0>;
			lm36272,default-brightness = <178>;
			lm36272,max-brightness = <255>;
			lm36272,dim-brightness = <1>;
			lm36272,dim-enabled;
			lm36272,blmap-size = <256>;
			lm36272,blmap = <
				0 553 553 553 553 553 553 553 553 553               /* 0-9 */
				553 553 558 564 569 574 580 585 590 596             /* 10-19 */
				601 606 612 617 622 628 633 638 644 649             /* 20-29 */
				654 660 665 670 676 681 686 692 697 702             /* 30-39 */
				708 713 718 724 729 734 740 745 750 756             /* 40-49 */
				761 766 772 777 782 788 793 798 804 809             /* 50-59 */
				814 820 825 830 836 841 846 852 857 862             /* 60-69 */
				868 873 878 884 889 894 900 905 910 916             /* 70-79 */
				921 926 932 937 942 948 953 958 964 969             /* 80-89 */
				974 980 985 990 996 1001 1006 1012 1017 1022        /* 90-99 */
				1028 1033 1038 1044 1049 1054 1060 1065 1070 1076   /* 100-109 */
				1081 1086 1092 1097 1102 1108 1113 1118 1124 1129   /* 110-119 */
				1134 1140 1145 1150 1156 1161 1166 1172 1177 1182   /* 120-129 */
				1188 1193 1198 1204 1209 1214 1220 1225 1230 1236   /* 130-139 */
				1241 1246 1252 1257 1262 1268 1273 1278 1284 1289   /* 140-149 */
				1294 1300 1305 1310 1316 1321 1326 1332 1337 1342   /* 150-159 */
				1348 1353 1358 1364 1369 1374 1380 1385 1390 1396   /* 160-169 */
				1401 1406 1412 1417 1422 1428 1433 1438 1444 1449   /* 170-179 */
				1454 1460 1465 1470 1476 1481 1486 1492 1497 1502   /* 180-189 */
				1508 1513 1518 1524 1529 1534 1540 1545 1550 1556   /* 190-199 */
				1561 1566 1572 1577 1582 1588 1593 1598 1604 1609   /* 200-209 */
				1614 1620 1625 1630 1636 1641 1646 1652 1657 1662   /* 210-219 */
				1668 1673 1678 1684 1689 1694 1700 1705 1710 1716   /* 220-229 */
				1721 1726 1732 1737 1742 1748 1753 1758 1764 1769   /* 230-239 */
				1774 1780 1785 1790 1796 1801 1806 1812 1817 1822   /* 240-249 */
				1828 1833 1838 1844 1849 1885                       /* 250-255 */
			>;
		};
	};
};
