
qcom,3374443_compal_dlw2lv_300mah_averaged_masterslave_mar20th2018 {
	qcom, = <24>;
	/* #3374443_Compal_DLW2lv_300mAh_averaged_MasterSlave_Mar20th2018*/
	qcom,max-voltage-uv = <4350000>;
	qcom,fastchg-current-ma = <125>;
	qcom,nom-batt-capacity-mah = <300>;
	qcom,batt-id-kohm = <60>;
	qcom,battery-beta = <4250>;
	qcom,fg-cc-cv-threshold-mv = <4340>;
	qcom,battery-type = "ling_300mah_mar20th2018";
	qcom,checksum = <0xE019>;
	qcom,gui-version = "PM660GUI - 0.0.0.45";
	qcom,fg-profile-data = [
		 0C 1F 5B FC
		 FD 03 75 FD
		 8A 1C CB 02
		 58 0C FB 0B
		 B1 19 24 1B
		 3F 34 34 43
		 68 00 00 00
		 18 00 00 00
		 00 00 B0 A3
		 F1 CD 00 8C
		 26 00 08 00
		 5C ED 6E ED
		 D3 F5 7D DB
		 9A 00 61 03
		 C8 05 E2 43
		 10 06 09 20
		 27 00 14 00
		 E1 1F 78 05
		 75 0A 50 06
		 D1 1C A6 02
		 9E 0C 8C 0B
		 AC 18 60 23
		 AA 44 49 5A
		 71 00 00 00
		 0F 00 00 00
		 00 00 F3 D5
		 FF 07 A0 CA
		 2A 00 00 00
		 E6 F3 6E ED
		 0C E4 99 E4
		 D9 F2 09 03
		 1E EB A0 12
		 9C 33 CC FF
		 07 10 00 00
		 31 01 99 45
		 2A 00 40 00
		 66 07 0A FA
		 FF 00 00 00
		 00 00 00 00
		 00 00 00 00
		 00 00 00 00
		 00 00 00 00
		 00 00 00 00
		 00 00 00 00
		 00 00 00 00
		 00 00 00 00
		 00 00 00 00
		 00 00 00 00
		 00 00 00 00
		 00 00 00 00
		 00 00 00 00
		 00 00 00 00
		 00 00 00 00
		 00 00 00 00
		 00 00 00 00
		 00 00 00 00
	];
};
