/* Copyright (c) 2013, The Linux Foundation. All rights reserved.
 *
 * This program is free software; you can redistribute it and/or modify
 * it under the terms of the GNU General Public License version 2 and
 * only version 2 as published by the Free Software Foundation.
 *
 * This program is distributed in the hope that it will be useful,
 * but WITHOUT ANY WARRANTY; without even the implied warranty of
 * MERCHANTABILITY or FITNESS FOR A PARTICULAR PURPOSE.  See the
 * GNU General Public License for more details.
 */

/*---------------------------------------------------------------------------
 * This file is autogenerated file using gcdb parser. Please do not edit it.
 * Update input XML file to add a new entry or update variable in this file
 * VERSION = "1.0"
 *---------------------------------------------------------------------------*/
&mdss_mdp {
	dsi_rm67162_wqvga_cmd: qcom,mdss_dsi_rm67162_wqvga_cmd {
		qcom,mdss-dsi-panel-name = "rm67162 wqvga cmd mode dsi panel";
		qcom,mdss-dsi-panel-controller = <&mdss_dsi0>;
		qcom,mdss-dsi-panel-type = "dsi_cmd_mode";
		qcom,mdss-dsi-panel-destination = "display_1";
		qcom,mdss-dsi-panel-framerate = <60>;
		qcom,mdss-dsi-virtual-channel-id = <0>;
		qcom,mdss-dsi-stream = <0>;
		qcom,mdss-dsi-panel-width = <400>;
		qcom,mdss-dsi-panel-height = <400>;
		qcom,mdss-pan-physical-height-dimension = <35>;
		qcom,mdss-pan-physical-width-dimension = <35>;
		qcom,mdss-dsi-bpp = <24>;
		qcom,mdss-dsi-color-order = "rgb_swap_rgb";
		qcom,mdss-dsi-underflow-color = <0xff>;
		qcom,mdss-dsi-border-color = <0>;
		qcom,mdss-dsi-on-command = [
			15 01 00 00 00 00 02 FE 0A
			15 01 00 00 00 00 02 29 10
			15 01 00 00 00 00 02 FE 05
			15 01 00 00 00 00 02 05 00
			15 01 00 00 00 00 02 51 01
			15 01 00 00 00 00 02 52 82
			15 01 00 00 00 00 02 53 04
			15 01 00 00 00 00 02 54 82
			15 01 00 00 00 00 02 55 EE
			15 01 00 00 00 00 02 56 10
			15 01 00 00 00 00 02 57 86
			15 01 00 00 00 00 02 58 41
			15 01 00 00 00 00 02 59 04
			15 01 00 00 00 00 02 5A 08
			15 01 00 00 00 00 02 5B 02
			15 01 00 00 00 00 02 5C 26
			15 01 00 00 00 00 02 5D 00
			15 01 00 00 00 00 02 5E 80
			15 01 00 00 00 00 02 5F 04
			15 01 00 00 00 00 02 60 90
			15 01 00 00 00 00 02 61 E0
			15 01 00 00 00 00 02 62 02
			15 01 00 00 00 00 02 63 04
			15 01 00 00 00 00 02 64 04
			15 01 00 00 00 00 02 65 03
			15 01 00 00 00 00 02 66 86
			15 01 00 00 00 00 02 67 02
			15 01 00 00 00 00 02 68 20
			15 01 00 00 00 00 02 69 4E
			15 01 00 00 00 00 02 6A 04
			15 01 00 00 00 00 02 6B 02
			15 01 00 00 00 00 02 6C C8
			15 01 00 00 00 00 02 6D 44
			15 01 00 00 00 00 02 6E 02
			15 01 00 00 00 00 02 6F 90
			15 01 00 00 00 00 02 70 44
			15 01 00 00 00 00 02 71 4A
			15 01 00 00 00 00 02 72 A0
			15 01 00 00 00 00 02 73 0A
			15 01 00 00 00 00 02 74 02
			15 01 00 00 00 00 02 75 07
			15 01 00 00 00 00 02 76 90
			15 01 00 00 00 00 02 77 04
			15 01 00 00 00 00 02 78 10
			15 01 00 00 00 00 02 79 20
			15 01 00 00 00 00 02 7A 00
			15 01 00 00 00 00 02 7B 00
			15 01 00 00 00 00 02 7C A6
			15 01 00 00 00 00 02 7D 02
			15 01 00 00 00 00 02 7E 86
			15 01 00 00 00 00 02 7F 04
			15 01 00 00 00 00 02 80 01
			15 01 00 00 00 00 02 81 86
			15 01 00 00 00 00 02 82 00
			15 01 00 00 00 00 02 83 26
			15 01 00 00 00 00 02 84 48
			15 01 00 00 00 00 02 85 04
			15 01 00 00 00 00 02 86 02
			15 01 00 00 00 00 02 87 02
			15 01 00 00 00 00 02 88 49
			15 01 00 00 00 00 02 89 02
			15 01 00 00 00 00 02 8A 10
			15 01 00 00 00 00 02 8B 10
			15 01 00 00 00 00 02 8C 60
			15 01 00 00 00 00 02 8D 88
			15 01 00 00 00 00 02 8E 02
			15 01 00 00 00 00 02 AC 01
			15 01 00 00 00 00 02 AD 04
			15 01 00 00 00 00 02 AE 10
			15 01 00 00 00 00 02 AF 90
			15 01 00 00 00 00 02 B0 18
			15 01 00 00 00 00 02 B1 88
			15 01 00 00 00 00 02 B2 00
			15 01 00 00 00 00 02 B3 10
			15 01 00 00 00 00 02 B4 A0
			15 01 00 00 00 00 02 B5 08
			15 01 00 00 00 00 02 B6 04
			15 01 00 00 00 00 02 B7 02
			15 01 00 00 00 00 02 B8 00
			15 01 00 00 00 00 02 B9 00
			15 01 00 00 00 00 02 BA 90
			15 01 00 00 00 00 02 BB 20
			15 01 00 00 00 00 02 BC 08
			15 01 00 00 00 00 02 BD 04
			15 01 00 00 00 00 02 BE 0A
			15 01 00 00 00 00 02 BF 00
			15 01 00 00 00 00 02 C1 00
			15 01 00 00 00 00 02 C2 03
			15 01 00 00 00 00 02 FE 00
			15 01 00 00 00 00 02 35 00
			05 01 00 00 96 00 02 11 00
			05 01 00 00 00 00 02 29 00];
		qcom,mdss-dsi-off-command = [15 01 00 00 00 00 02 28 00
					15 01 00 00 78 00 02 10 00
					15 01 00 00 00 00 02 4F 01];
		qcom,mdss-dsi-on-command-state = "dsi_lp_mode";
		qcom,mdss-dsi-off-command-state = "dsi_hs_mode";
		qcom,mdss-dsi-traffic-mode = "burst_mode";
		qcom,mdss-dsi-lane-map = "lane_map_0123";
		qcom,mdss-dsi-bllp-eof-power-mode;
		qcom,mdss-dsi-bllp-power-mode;
		qcom,mdss-dsi-lane-0-state;
		qcom,mdss-dsi-te-pin-select = <1>;
		qcom,mdss-dsi-te-dcs-command = <1>;
		qcom,mdss-dsi-te-using-te-pin;
		qcom,mdss-dsi-te-check-enable;
		qcom,mdss-dsi-panel-timings = [5F 12 0A 00 32 34 10 16 0F 03 04 00];
		qcom,mdss-dsi-t-clk-post = <0x05>;
		qcom,mdss-dsi-t-clk-pre = <0x11>;
		qcom,mdss-dsi-bl-min-level = <1>;
		qcom,mdss-dsi-bl-max-level = <255>;
		qcom,mdss-dsi-dma-trigger = "trigger_sw";
		qcom,mdss-dsi-mdp-trigger = "none";
		qcom,mdss-dsi-bl-pmic-control-type = "bl_ctrl_dcs";
		qcom,mdss-dsi-reset-sequence = <1 20>, <0 20>, <1 20>;
	};
};
