/* Copyright (c) 2015-2016, The Linux Foundation. All rights reserved.
 *
 * This program is free software; you can redistribute it and/or modify
 * it under the terms of the GNU General Public License version 2 and
 * only version 2 as published by the Free Software Foundation.
 *
 * This program is distributed in the hope that it will be useful,
 * but WITHOUT ANY WARRANTY; without even the implied warranty of
 * MERCHANTABILITY or FITNESS FOR A PARTICULAR PURPOSE.  See the
 * GNU General Public License for more details.
 */

&mdss_mdp {
	dsi_jdi_novatek_nt36860: qcom,mdss_dsi_jdi_novatek_nt36860 {
		qcom,mdss-dsi-panel-name = "JDI Novatek NT36860 Panel";
		qcom,mdss-dsi-panel-type = "dsi_video_mode";
		qcom,mdss-dsi-panel-framerate = <90>;
		qcom,mdss-dsi-virtual-channel-id = <0>;
		qcom,mdss-dsi-stream = <0>;
		qcom,mdss-dsi-panel-width = <1440>;
		qcom,mdss-dsi-panel-height = <1704>;
		qcom,mdss-pan-physical-width-dimension = <114>;
		qcom,mdss-pan-physical-height-dimension = <67>;
		qcom,mdss-dsi-h-front-porch = <14>;
		qcom,mdss-dsi-h-back-porch = <16>;
		qcom,mdss-dsi-h-pulse-width = <16>;
		qcom,mdss-dsi-h-sync-skew = <0>;
		qcom,mdss-dsi-v-back-porch = <200>;
		qcom,mdss-dsi-v-front-porch = <200>;
		qcom,mdss-dsi-v-pulse-width = <4>;
		qcom,mdss-dsi-bpp = <24>;
		qcom,mdss-dsi-underflow-color = <0xff>;
		qcom,mdss-dsi-border-color = <0>;

		qcom,mdss-dsi-on-command = [39 01 00 00 00 00 05 2A 00 00 05 9F
			39 01 00 00 00 00 05 2B 00 00 06 A7
			15 01 00 00 00 00 02 35 00
			15 01 00 00 00 00 02 E5 00
			15 01 00 00 00 00 02 FF 25
			15 01 00 00 00 00 02 FB 01
			15 01 00 00 00 00 02 C4 10
			15 01 00 00 00 00 02 FF F0
			15 01 00 00 00 00 02 FB 01
			15 01 00 00 00 00 02 8D 00
			15 01 00 00 00 00 02 FF D0
			15 01 00 00 00 00 02 FB 01
			15 01 00 00 00 00 02 C3 03
			15 01 00 00 00 00 02 AE 03
			15 01 00 00 00 00 02 AB 70
			15 01 00 00 00 00 02 C0 70
			15 01 00 00 00 00 02 C1 31
			15 01 00 00 00 00 02 FF 20
			15 01 00 00 00 00 02 FB 01
			15 01 00 00 00 00 02 8A DD
			15 01 00 00 00 00 02 FF 26
			15 01 00 00 00 00 02 FB 01
			15 01 00 00 00 00 02 02 E0
			15 01 00 00 00 00 02 03 00
			15 01 00 00 00 00 02 FF 23
			15 01 00 00 00 00 02 FB 01
			15 01 00 00 00 00 02 AC 05
			15 01 00 00 00 00 02 AD 70
			15 01 00 00 00 00 02 AE A0
			15 01 00 00 00 00 02 AF 96
			15 01 00 00 00 00 02 FF 29
			15 01 00 00 00 00 02 FB 01
			15 01 00 00 00 00 02 47 00
			15 01 00 00 00 00 02 48 FF
			15 01 00 00 00 00 02 49 00
			15 01 00 00 00 00 02 4A FF
			15 01 00 00 28 00 02 FF 10
			05 01 00 00 78 00 01 11
			15 01 00 00 00 00 02 BA 07
			15 01 00 00 00 00 02 C0 83
			39 01 00 00 00 00 05 BE 00 96 0F 39];
		qcom,mdss-dsi-post-panel-on-command = [15 01 00 00 00 00 02 BB 13
		05 01 00 00 28 00 01 29];
		qcom,mdss-dsi-off-command = [15 01 00 00 28 00 02 28 00
				 15 01 00 00 78 00 02 10 00];
		qcom,mdss-dsi-on-command-state = "dsi_lp_mode";
		qcom,mdss-dsi-off-command-state = "dsi_hs_mode";
		qcom,mdss-dsi-h-sync-pulse = <0>;
		qcom,mdss-dsi-traffic-mode = "non_burst_sync_event";
		qcom,mdss-dsi-bllp-eof-power-mode;
		qcom,mdss-dsi-bllp-power-mode;
		qcom,mdss-dsi-lane-0-state;
		qcom,mdss-dsi-lane-1-state;
		qcom,mdss-dsi-lane-2-state;
		qcom,mdss-dsi-lane-3-state;
		qcom,mdss-dsi-panel-timings = [00 12 04 04 07 0d 04 05 03 03 04 00];
		qcom,mdss-dsi-t-clk-post = <0x05>;
		qcom,mdss-dsi-t-clk-pre = <0x1c>;
		qcom,mdss-dsi-dma-trigger = "trigger_sw";
		qcom,mdss-dsi-mdp-trigger = "none";
		qcom,mdss-dsi-lp11-init;
		qcom,mdss-dsi-reset-sequence = <0 15>, <1 15>, <0 2>, <1 20>;
		//qcom,cmd-sync-wait-broadcast;

		qcom,compression-mode = "dsc";
		qcom,config-select = <&dsi_jdi_novatek_nt36860_video_config0>;

		dsi_jdi_novatek_nt36860_video_config0: config0 {
			qcom,split-mode = "dualctrl-split";
			qcom,mdss-dsc-encoders = <1>;
			qcom,mdss-dsc-slice-height = <8>;
			qcom,mdss-dsc-slice-width = <720>;
			qcom,mdss-dsc-slice-per-pkt = <2>;

			qcom,mdss-dsc-bit-per-component = <8>;
			qcom,mdss-dsc-bit-per-pixel = <8>;
			qcom,mdss-dsc-block-prediction-enable;
			qcom,mdss-dsc-config-by-manufacture-cmd;
		};
	};
};
