/* Copyright (c) 2013, The Linux Foundation. All rights reserved.
 *
 * This program is free software; you can redistribute it and/or modify
 * it under the terms of the GNU General Public License version 2 and
 * only version 2 as published by the Free Software Foundation.
 *
 * This program is distributed in the hope that it will be useful,
 * but WITHOUT ANY WARRANTY; without even the implied warranty of
 * MERCHANTABILITY or FITNESS FOR A PARTICULAR PURPOSE.  See the
 * GNU General Public License for more details.
 */

/*---------------------------------------------------------------------------
 * This file is autogenerated file using gcdb parser. Please do not edit it.
 * Update input XML file to add a new entry or update variable in this file
 * VERSION = "1.0"
 *---------------------------------------------------------------------------*/
&mdss_mdp {
	dsi_truly_R61350_720p_vid: qcom,mdss_dsi_TRULY_R61350_720p_video {
		qcom,mdss-dsi-panel-name = "truly R61350 720p video mode dsi panel";
		qcom,mdss-dsi-panel-controller = <&mdss_dsi0>;
		qcom,mdss-dsi-panel-type = "dsi_video_mode";
		qcom,mdss-dsi-panel-destination = "display_1";
		qcom,cont-splash-enabled;
		qcom,mdss-dsi-panel-framerate = <60>;
		qcom,mdss-dsi-virtual-channel-id = <0>;
		qcom,mdss-dsi-stream = <0>;
		qcom,mdss-dsi-panel-width = <720>;
		qcom,mdss-dsi-panel-height = <1280>;
		qcom,mdss-dsi-h-front-porch = <90>;
		qcom,mdss-dsi-h-back-porch = <90>;
		qcom,mdss-dsi-h-pulse-width = <10>;
		qcom,mdss-dsi-h-sync-skew = <0>;
		qcom,mdss-dsi-v-front-porch = <20>;
		qcom,mdss-dsi-v-back-porch = <16>;
		qcom,mdss-dsi-v-pulse-width = <4>;
		qcom,mdss-dsi-h-left-border = <0>;
		qcom,mdss-dsi-h-right-border = <0>;
		qcom,mdss-dsi-v-top-border = <0>;
		qcom,mdss-dsi-v-bottom-border = <0>;
		qcom,mdss-dsi-bpp = <24>;
		qcom,mdss-dsi-color-order = "rgb_swap_rgb";
		qcom,mdss-dsi-underflow-color = <0xff>;
		qcom,mdss-dsi-border-color = <0>;
		qcom,mdss-pan-physical-width-dimension = <62>;
		qcom,mdss-pan-physical-height-dimension = <110>;
		qcom,mdss-dsi-on-command = [
			29 01 00 00 00 00 02
			B0 04
			29 01 00 00 00 00 02
			E3 01
			29 01 00 00 00 00 03
			B6 61 2C
			29 01 00 00 00 00 07
			C0 23 B2 10 10 02 7F
			29 01 00 00 00 00 17
			C1 0B 8A A0 8A 00 00
			00 00 00 03 00 00 00
			00 00 00 00 00 00 00
			00 00
			29 01 00 00 00 00 1d
			C5 07 04 40 04 00 00
			03 01 80 07 00 00 00
			00 00 00 00 00 00 00
			00 00 00 00 00 00 00
			0E
			29 01 00 00 00 00 03
			C6 01 02
			29 01 00 00 00 00 3b
			C8 01 20 22 24 26 00
			00 1D 1D 00 00 00 1D
			1D 1D 00 00 00 00 11
			13 09 02 21 23 25 27
			00 00 1D 1D 00 00 00
			1D 1D 1D 00 00 00 00
			11 13 0A 89 00 00 00
			01 00 00 00 02 00 00
			00 03 00
			29 01 00 00 00 00 27
			CA 1B 29 33 42 4D 57
			6E 7F 8D 9A 4D 5A 68
			7C 85 92 A2 AE BF 1B
			29 33 42 4D 57 6E 7F
			8D 9A 4D 5A 68 7C 85
			92 A2 AE BF
			29 01 00 00 00 00 07
			D0 02 4B 1F 00 28 91
			29 01 00 00 00 00 02
			D1 03
			29 01 00 00 00 00 03
			D2 8E 0B
			29 01 00 00 00 00 02
			E5 02
			29 01 00 00 00 00 03
			D4 00 9E
			29 01 00 00 00 00 03
			D5 28 28
			//modify by Sam
			29 01 00 00 00 00 02
			B0 04
			29 01 00 00 00 00 04
			F3 02 00 22
			05 01 00 00 78 00 02
			11 00
			05 01 00 00 0a 00 02
			29 00
			];
		qcom,mdss-dsi-off-command = [
			05 01 00 00 32 00 02
			28 00
			05 01 00 00 78 00 02
			10 00
			];
		qcom,mdss-dsi-on-command-state = "dsi_lp_mode";
		qcom,mdss-dsi-off-command-state = "dsi_lp_mode";
		qcom,mdss-dsi-h-sync-pulse = <0>;
		qcom,mdss-dsi-traffic-mode = "non_burst_sync_pulse";
		qcom,mdss-dsi-lane-map = "lane_map_0123";
		qcom,mdss-dsi-bllp-eof-power-mode;
		qcom,mdss-dsi-bllp-power-mode;
		qcom,mdss-dsi-lane-0-state;
		qcom,mdss-dsi-lane-1-state;
		qcom,mdss-dsi-lane-2-state;
		qcom,mdss-dsi-lane-3-state;
		//qcom,mdss-dsi-panel-timings = [75 18 10 00 3a 3e 14 1a 13 03 04 00];
		qcom,mdss-dsi-panel-timings = [7a 1a 12 00 40 42 16 1e 14 03 04 00];
		qcom,mdss-dsi-t-clk-post = <0x04>;
		qcom,mdss-dsi-t-clk-pre = <0x1b>;
		qcom,mdss-dsi-bl-min-level = <1>;
		qcom,mdss-dsi-bl-max-level = <4095>;
		qcom,mdss-dsi-dma-trigger = "trigger_sw";
		qcom,mdss-dsi-mdp-trigger = "none";
		qcom,mdss-dsi-bl-pmic-control-type = "bl_ctrl_pwm";
		qcom,mdss-dsi-bl-pmic-pwm-frequency = <100>;
		qcom,mdss-dsi-bl-pmic-bank-select = <0>;
		qcom,mdss-dsi-pwm-gpio = <&pm8916_mpps 4 0>;
		qcom,mdss-dsi-reset-sequence = <1 20>, <0 10>, <1 20>;
                qcom,mdss-dsi-lp11-init;

		//add lcd esd
		qcom,mdss-dsi-panel-status-command = [06 01 00 01 05 00 02 0A 08];
		qcom,mdss-dsi-panel-status-command-state = "dsi_hs_mode";
		qcom,mdss-dsi-panel-status-check-mode = "reg_read";
		qcom,mdss-dsi-panel-status-value = <0x9c>;
		qcom,esd-check-enabled;
		//esd end
	};
};

