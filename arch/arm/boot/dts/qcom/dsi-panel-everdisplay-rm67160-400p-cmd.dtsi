/* Copyright (c) 2013-2014, The Linux Foundation. All rights reserved.
 *
 * This program is free software; you can redistribute it and/or modify
 * it under the terms of the GNU General Public License version 2 and
 * only version 2 as published by the Free Software Foundation.
 *
 * This program is distributed in the hope that it will be useful,
 * but WITHOUT ANY WARRANTY; without even the implied warranty of
 * MERCHANTABILITY or FITNESS FOR A PARTICULAR PURPOSE.  See the
 * GNU General Public License for more details.
 */

/*---------------------------------------------------------------------------
 * This file is autogenerated file using gcdb parser. Please do not edit it.
 * Update input XML file to add a new entry or update variable in this file
 * VERSION = "1.0"
 *---------------------------------------------------------------------------*/
 
/*  This dtsi is for EverDisplay 1.4" E1392AM1.B 400P command mode panel */ 
 
 
&mdss_mdp {
	dsi_everdisp_rm67160_400_cmd: qcom,mdss_dsi_everdisp_rm67160_400p_cmd {
		qcom,mdss-dsi-panel-name = "EverDisplay rm67160 400p command mode dsi panel";
		qcom,mdss-dsi-panel-controller = <&mdss_dsi0>;
		qcom,mdss-dsi-panel-type = "dsi_cmd_mode";
		qcom,mdss-dsi-panel-destination = "display_1";
		qcom,mdss-dsi-panel-framerate = <60>;
		qcom,mdss-dsi-virtual-channel-id = <0>;
		qcom,mdss-dsi-stream = <0>;
		qcom,mdss-dsi-panel-width = <400>;
		qcom,mdss-dsi-panel-height = <400>;
		qcom,mdss-dsi-h-front-porch = <20>;
		qcom,mdss-dsi-h-back-porch = <40>;
		qcom,mdss-dsi-h-pulse-width = <20>;
		qcom,mdss-dsi-h-sync-skew = <0>;
		qcom,mdss-dsi-v-back-porch = <12>;
		qcom,mdss-dsi-v-front-porch = <20>;
		qcom,mdss-dsi-v-pulse-width = <4>;
		qcom,mdss-dsi-h-left-border = <0>;
		qcom,mdss-dsi-h-right-border = <0>;
		qcom,mdss-dsi-v-top-border = <0>;
		qcom,mdss-dsi-v-bottom-border = <0>;
		qcom,mdss-dsi-bpp = <24>;
		qcom,mdss-dsi-underflow-color = <0xff>;
		qcom,mdss-dsi-border-color = <0>;
		qcom,mdss-dsi-on-command = [15 01 00 00 00 00 02 FE 04
					15 01 00 00 00 00 02 00 dc
					15 01 00 00 00 00 02 01 00
					15 01 00 00 00 00 02 02 02
					15 01 00 00 00 00 02 03 00
					15 01 00 00 00 00 02 04 00
					15 01 00 00 00 00 02 05 03
					15 01 00 00 00 00 02 06 16
					15 01 00 00 00 00 02 07 13
					15 01 00 00 00 00 02 08 08
					15 01 00 00 00 00 02 09 dc
					15 01 00 00 00 00 02 0a 00
					15 01 00 00 00 00 02 0b 02
					15 01 00 00 00 00 02 0c 00
					15 01 00 00 00 00 02 0d 00
					15 01 00 00 00 00 02 0e 02
					15 01 00 00 00 00 02 0f 16
					15 01 00 00 00 00 02 10 18
					15 01 00 00 00 00 02 11 08
					15 01 00 00 00 00 02 12 92
					15 01 00 00 00 00 02 13 00
					15 01 00 00 00 00 02 14 02
					15 01 00 00 00 00 02 15 05
					15 01 00 00 00 00 02 16 40
					15 01 00 00 00 00 02 17 03
					15 01 00 00 00 00 02 18 16
					15 01 00 00 00 00 02 19 d7
					15 01 00 00 00 00 02 1a 01
					15 01 00 00 00 00 02 1b dc
					15 01 00 00 00 00 02 1c 00
					15 01 00 00 00 00 02 1d 04
					15 01 00 00 00 00 02 1e 00
					15 01 00 00 00 00 02 1f 00
					15 01 00 00 00 00 02 20 03
					15 01 00 00 00 00 02 21 16
					15 01 00 00 00 00 02 22 18
					15 01 00 00 00 00 02 23 08
					15 01 00 00 00 00 02 24 dc
					15 01 00 00 00 00 02 25 00
					15 01 00 00 00 00 02 26 04
					15 01 00 00 00 00 02 27 00
					15 01 00 00 00 00 02 28 00
					15 01 00 00 00 00 02 29 01
					15 01 00 00 00 00 02 2a 16
					15 01 00 00 00 00 02 2b 18
					15 01 00 00 00 00 02 2d 08
					15 01 00 00 00 00 02 4c 99
					15 01 00 00 00 00 02 4d 00
					15 01 00 00 00 00 02 4e 00
					15 01 00 00 00 00 02 4f 00
					15 01 00 00 00 00 02 50 01
					15 01 00 00 00 00 02 51 0A
					15 01 00 00 00 00 02 52 00
					15 01 00 00 00 00 02 5a e4
					15 01 00 00 00 00 02 5e 77
					15 01 00 00 00 00 02 5f 77
					15 01 00 00 00 00 02 60 34
					15 01 00 00 00 00 02 61 02
					15 01 00 00 00 00 02 62 81
					15 01 00 00 00 00 02 FE 07
					15 01 00 00 00 00 02 07 4F
					15 01 00 00 00 00 02 FE 01
					15 01 00 00 00 00 02 05 15
					15 01 00 00 00 00 02 0E 8B
					15 01 00 00 00 00 02 0F 8B
					15 01 00 00 00 00 02 10 11
					15 01 00 00 00 00 02 11 A2
					15 01 00 00 00 00 02 12 A0
					15 01 00 00 00 00 02 14 A1
					15 01 00 00 00 00 02 15 82
					15 01 00 00 00 00 02 18 47
					15 01 00 00 00 00 02 19 36
					15 01 00 00 00 00 02 1A 10
					15 01 00 00 00 00 02 1C 57
					15 01 00 00 00 00 02 1D 02
					15 01 00 00 00 00 02 21 F8
					15 01 00 00 00 00 02 22 90
					15 01 00 00 00 00 02 23 00
					15 01 00 00 00 00 02 25 03
					15 01 00 00 00 00 02 26 4a
					15 01 00 00 00 00 02 2A 03
					15 01 00 00 00 00 02 2B 4A
					15 01 00 00 00 00 02 2D 12
					15 01 00 00 00 00 02 2F 12
                                        15 01 00 00 00 00 02 30 45
					15 01 00 00 00 00 02 37 0C
					15 01 00 00 00 00 02 3a 00
					15 01 00 00 00 00 02 3b 20
					15 01 00 00 00 00 02 3d 0B
					15 01 00 00 00 00 02 3f 38
					15 01 00 00 00 00 02 40 0B
					15 01 00 00 00 00 02 41 0B
					15 01 00 00 00 00 02 42 33
					15 01 00 00 00 00 02 43 66
					15 01 00 00 00 00 02 44 11
					15 01 00 00 00 00 02 45 44
					15 01 00 00 00 00 02 46 22
					15 01 00 00 00 00 02 47 55
					15 01 00 00 00 00 02 4c 33
					15 01 00 00 00 00 02 4d 66
					15 01 00 00 00 00 02 4e 11
					15 01 00 00 00 00 02 4f 44
					15 01 00 00 00 00 02 50 22
					15 01 00 00 00 00 02 51 55
					15 01 00 00 00 00 02 56 11
					15 01 00 00 00 00 02 58 44
					15 01 00 00 00 00 02 59 22
					15 01 00 00 00 00 02 5a 55
					15 01 00 00 00 00 02 5b 33
					15 01 00 00 00 00 02 5c 66
					15 01 00 00 00 00 02 61 11
					15 01 00 00 00 00 02 62 44
					15 01 00 00 00 00 02 63 22
					15 01 00 00 00 00 02 64 55
					15 01 00 00 00 00 02 65 33
					15 01 00 00 00 00 02 66 66
					15 01 00 00 00 00 02 6d 90
					15 01 00 00 00 00 02 6e 40
					15 01 00 00 00 00 02 70 A5
					15 01 00 00 00 00 02 72 04
					15 01 00 00 00 00 02 73 15
					15 01 00 00 00 00 02 FE 0A
					15 01 00 00 00 00 02 29 10
					15 01 00 00 00 00 02 FE 05
					15 01 00 00 00 00 02 05 01
					15 01 00 00 00 00 02 FE 00
					15 01 00 00 00 00 02 35 00
					15 01 00 00 78 00 02 11 00
					15 01 00 00 00 00 02 29 00];
		qcom,mdss-dsi-off-command = [15 01 00 00 00 00 02 28 00
					05 01 00 00 78 00 02 10 00];
		qcom,mdss-dsi-panel-idle-in-command = [ 15 01 00 00 00 00 02 FE 05
                                                        15 01 00 00 00 00 02 8F 00
                                                        15 01 00 00 00 00 02 91 00
                                                        15 01 00 00 00 00 02 FE 00
                                                        15 01 00 00 00 00 02 39 00];
		qcom,mdss-dsi-panel-idle-out-command = [15 01 00 00 00 00 02 FE 05
                                                        15 01 00 00 00 00 02 8F 00
                                                        15 01 00 00 00 00 02 91 00
                                                        15 01 00 00 00 00 02 FE 00
                                                        15 01 00 00 00 00 02 38 00];
		qcom,mdss-dsi-on-command-state = "dsi_lp_mode";
		qcom,mdss-dsi-off-command-state = "dsi_hs_mode";
		qcom,mdss-dsi-h-sync-pulse = <1>;
		qcom,mdss-dsi-traffic-mode = "burst_mode";
		qcom,mdss-dsi-bllp-eof-power-mode;
		qcom,mdss-dsi-bllp-power-mode;
		qcom,mdss-dsi-lane-0-state;
		qcom,mdss-dsi-te-pin-select = <1>;
		qcom,mdss-dsi-wr-mem-start = <0x2c>;
		qcom,mdss-dsi-te-dcs-command = <1>;
		qcom,mdss-dsi-te-check-enable;
		qcom,mdss-dsi-te-using-te-pin;
		//qcom,mdss-dsi-panel-timings = [5d 12 0c 00 34 36 10 16 0f 03 04 00];
		//qcom,mdss-dsi-t-clk-post = <0x05>;
		//qcom,mdss-dsi-t-clk-pre = <0x21>;
		qcom,mdss-dsi-panel-timings = [3d 12 0c 00 34 36 10 16 0f 03 04 00];
		qcom,mdss-dsi-t-clk-post = <0x05>;
		qcom,mdss-dsi-t-clk-pre = <0x18>;
		qcom,mdss-dsi-bl-min-level = <1>;
		/* Quanta_BU10SW, Stanley Tsao, 2015.11.06, AMOLED backlight control by DSI command { */
		/* If backlight control is by DCS command, max is 255 */
		qcom,mdss-dsi-bl-max-level = <255>;
		/* Quanta_BU10SW, Stanley Tsao, 2015.11.06, AMOLED backlight control by DSI command } */
		qcom,mdss-dsi-dma-trigger = "trigger_sw";
		qcom,mdss-dsi-mdp-trigger = "none";
		/* Quanta_BU10SW, Stanley Tsao, 2015.10.30, AMOLED needs no additional backlight unit { */
		qcom,mdss-dsi-bl-pmic-control-type = "bl_ctrl_dcs";
		/* Quanta_BU10SW, Stanley Tsao, 2015.10.30, AMOLED needs no additional backlight unit } */
		qcom,mdss-dsi-reset-sequence = <0 20>, <1 10>;
		qcom,mdss-pan-physical-width-dimension = <36>;
		qcom,mdss-pan-physical-height-dimension = <36>;

	};
};
