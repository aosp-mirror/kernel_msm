&pm8916_gpios {
	gpio@c300 { /* GPIO 4 */
		/* External regulator control for APC */
		qcom,mode = <1>; /* Output */
		qcom,pull = <5>; /* No Pull */
		qcom,vin-sel = <3>; /* VIN0 GPIO_LV */
		qcom,src-sel = <2>; /* Special Function 1 */
		qcom,invert = <0>; /* Invert */
		qcom,master-en = <1>; /* Enable GPIO */
		status = "okay";
	};
};

//for BCM wifi
&sdhc_2  {
	 #address-cells = <0>;
	interrupt-parent = <&sdhc_2>;
	interrupts = <0 1 2>;
	#interrupt-cells = <1>;
	interrupt-map-mask = <0xffffffff>;
	interrupt-map = <0 &intc 0 125 0
			1 &intc 0 221 0>;
	interrupt-names = "hc_irq", "pwr_irq";
	qcom,bus-width = <4>;
	/delete-property/ cd-gpios;
	/delete-property/ vdd-supply;
	/delete-property/ qcom,vdd-voltage-level;
	/delete-property/ qcom,vdd-current-level;

	vdd-io-supply = <&pm8916_l12>;
	qcom,vdd-io-always-on;
	qcom,vdd-io-lpm-sup;
	qcom,vdd-io-voltage-level = <1800000 1800000>;
	qcom,vdd-io-current-level = <200 50000>;
	qcom,wifi-control-func;
	qcom,nonremovable;

	pinctrl-names = "active", "sleep";
	pinctrl-0 = <&sdc2_clk_on &sdc2_cmd_on &sdc2_data_on &sdc2_cd_on>;
	pinctrl-1 = <&sdc2_clk_off &sdc2_cmd_off &sdc2_data_off &sdc2_cd_off>;

	status = "ok";
};

