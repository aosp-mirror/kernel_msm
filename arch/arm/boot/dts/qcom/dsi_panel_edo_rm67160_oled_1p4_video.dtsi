/* Copyright (c) 2012, Code Aurora Forum. All rights reserved.
 *
 * This program is free software; you can redistribute it and/or modify
 * it under the terms of the GNU General Public License version 2 and
 * only version 2 as published by the Free Software Foundation.
 *
 * This program is distributed in the hope that it will be useful,
 * but WITHOUT ANY WARRANTY; without even the implied warranty of
 * MERCHANTABILITY or FITNESS FOR A PARTICULAR PURPOSE.  See the
 * GNU General Public License for more details.
 */

/*---------------------------------------------------------------------------
 * This file is autogenerated file using gcdb parser. Please do not edit it.
 * Update input XML file to add a new entry or update variable in this file
 * VERSION = "1.0"
 *---------------------------------------------------------------------------*/
&mdss_mdp {

       dsi_edo_rm67160_1p4_vid: qcom,mdss_dsi_edo_rm67160_1p4_video{

		qcom,mdss-dsi-panel-name =  "EDO(RM67160)_400*400_1.4Inch";
		qcom,cont-splash-enabled;
		qcom,mdss-dsi-panel-controller = <&mdss_dsi0>;
		qcom,mdss-dsi-panel-type = "dsi_cmd_mode";
		qcom,mdss-dsi-panel-destination = "display_1";
		qcom,mdss-dsi-panel-framerate = <60>;
		qcom,mdss-dsi-virtual-channel-id = <0>;
		qcom,mdss-dsi-stream = <0>;
		qcom,mdss-dsi-panel-width = <400>;
		qcom,mdss-dsi-panel-height = <400>;
		qcom,mdss-dsi-h-front-porch = <20>;
		qcom,mdss-dsi-h-back-porch = <40>;
		qcom,mdss-dsi-h-pulse-width =  <20>;
		qcom,mdss-dsi-h-sync-skew = <0>;
		qcom,mdss-dsi-v-front-porch = <20>;
		qcom,mdss-dsi-v-back-porch = <12>;
		qcom,mdss-dsi-v-pulse-width = <4>;
		qcom,mdss-dsi-h-left-border = <0>;
		qcom,mdss-dsi-h-right-border = <0>;
		qcom,mdss-dsi-v-top-border = <0>;
		qcom,mdss-dsi-v-bottom-border = <0>;
		qcom,mdss-dsi-bpp = <24>;
		qcom,mdss-dsi-color-order = <0>;
		qcom,mdss-dsi-underflow-color = <0xff>;
		qcom,mdss-dsi-border-color = <0>;
		qcom,ulps-enabled;
		qcom,mdss-dsi-h-sync-pulse = <0>;
		qcom,mdss-dsi-traffic-mode = "non_burst_sync_event";
		qcom,mdss-dsi-lane-map = <0>;
		qcom,mdss-dsi-bllp-eof-power-mode;
		qcom,mdss-dsi-bllp-power-mode;
		qcom,mdss-dsi-lane-0-state;
		qcom,mdss-dsi-panel-timings =[5D 12 0C 00 34 36 10 16 0F 03 04 a0];

		qcom,mdss-dsi-te-pin-select = <1>;
		qcom,mdss-dsi-te-v-sync-rd-ptr-irq-line = <0x2c>;
		qcom,mdss-dsi-te-dcs-command = <1>;
		qcom,mdss-dsi-te-check-enable;
		qcom,mdss-dsi-te-using-te-pin;

		qcom,mdss-dsi-t-clk-post = <0x05>;
		qcom,mdss-dsi-t-clk-pre = <0x15>;
		qcom,mdss-dsi-bl-min-level = <1>;
		qcom,mdss-dsi-bl-max-level = <255>;
		qcom,mdss-dsi-dma-trigger = <0x04>;
		qcom,mdss-dsi-mdp-trigger = <0x0>;
		qcom,mdss-dsi-bl-pmic-control-type = "bl_ctrl_dcs";
		qcom,mdss-dsi-reset-sequence = <1 20>, <0 10>, <1 20>;
		qcom,mdss-pan-physical-width-dimension = <39>;
		qcom,mdss-pan-physical-height-dimension = <40>;

		qcom,mdss-dsi-on-command= [

			39 01 00 00 00 00 02 fe 04
			39 01 00 00 00 00 02 fe 04
			39 01 00 00 00 00 02 00 dc
			39 01 00 00 00 00 02 01 00
			39 01 00 00 00 00 02 02 02
			39 01 00 00 00 00 02 03 00
			39 01 00 00 00 00 02 04 00
			39 01 00 00 00 00 02 05 03
			39 01 00 00 00 00 02 06 16
			39 01 00 00 00 00 02 07 13
			39 01 00 00 00 00 02 08 08
			39 01 00 00 00 00 02 09 dc
			39 01 00 00 00 00 02 0a 00
			39 01 00 00 00 00 02 0b 02
			39 01 00 00 00 00 02 0c 00
			39 01 00 00 00 00 02 0d 00
			39 01 00 00 00 00 02 0e 02
			39 01 00 00 00 00 02 0f 16
			39 01 00 00 00 00 02 10 18
			39 01 00 00 00 00 02 11 08
			39 01 00 00 00 00 02 12 92
			39 01 00 00 00 00 02 13 00
			39 01 00 00 00 00 02 14 02
			39 01 00 00 00 00 02 15 05
			39 01 00 00 00 00 02 16 40
			39 01 00 00 00 00 02 17 03
			39 01 00 00 00 00 02 18 16
			39 01 00 00 00 00 02 19 d7
			39 01 00 00 00 00 02 1a 01
			39 01 00 00 00 00 02 1b dc
			39 01 00 00 00 00 02 1c 00
			39 01 00 00 00 00 02 1d 04
			39 01 00 00 00 00 02 1e 00
			39 01 00 00 00 00 02 1f 00
			39 01 00 00 00 00 02 20 03
			39 01 00 00 00 00 02 21 16
			39 01 00 00 00 00 02 22 18
			39 01 00 00 00 00 02 23 08
			39 01 00 00 00 00 02 24 dc
			39 01 00 00 00 00 02 25 00
			39 01 00 00 00 00 02 26 04
			39 01 00 00 00 00 02 27 00
			39 01 00 00 00 00 02 28 00
			39 01 00 00 00 00 02 29 01
			39 01 00 00 00 00 02 2a 16
			39 01 00 00 00 00 02 2b 18
			39 01 00 00 00 00 02 2d 08
			39 01 00 00 00 00 02 4c 99
			39 01 00 00 00 00 02 4d 00
			39 01 00 00 00 00 02 4e 00
			39 01 00 00 00 00 02 4f 00
			39 01 00 00 00 00 02 50 01
			39 01 00 00 00 00 02 51 0a
			39 01 00 00 00 00 02 52 00
			39 01 00 00 00 00 02 5a e4
			39 01 00 00 00 00 02 5e 77
			39 01 00 00 00 00 02 5f 77
			39 01 00 00 00 00 02 60 34
			39 01 00 00 00 00 02 61 02
			39 01 00 00 00 00 02 62 81
			39 01 00 00 00 00 02 fe 07
			39 01 00 00 00 00 02 07 4f
			39 01 00 00 00 00 02 fe 01
			39 01 00 00 00 00 02 05 15
			39 01 00 00 00 00 02 0e 8b
			39 01 00 00 00 00 02 0f 8b
			39 01 00 00 00 00 02 10 11
			39 01 00 00 00 00 02 11 a2
			39 01 00 00 00 00 02 12 80
			39 01 00 00 00 00 02 14 81
			39 01 00 00 00 00 02 15 82
			39 01 00 00 00 00 02 18 47
			39 01 00 00 00 00 02 19 36
			39 01 00 00 00 00 02 1a 10
			39 01 00 00 00 00 02 1c 57
			39 01 00 00 00 00 02 1d 02
			39 01 00 00 00 00 02 21 f8
			39 01 00 00 00 00 02 22 90
			39 01 00 00 00 00 02 23 00
			39 01 00 00 00 00 02 25 03
			39 01 00 00 00 00 02 26 4a
			39 01 00 00 00 00 02 2a 47
			39 01 00 00 00 00 02 2b ff
			39 01 00 00 00 00 02 2d ff
			39 01 00 00 00 00 02 2f ae
			39 01 00 00 00 00 02 37 0c
			39 01 00 00 00 00 02 3a 00
			39 01 00 00 00 00 02 3b 20
			39 01 00 00 00 00 02 3d 0b
			39 01 00 00 00 00 02 3f 38
			39 01 00 00 00 00 02 40 0b
			39 01 00 00 00 00 02 41 0b
			39 01 00 00 00 00 02 42 33
			39 01 00 00 00 00 02 43 66
			39 01 00 00 00 00 02 44 11
			39 01 00 00 00 00 02 45 44
			39 01 00 00 00 00 02 46 22
			39 01 00 00 00 00 02 47 55
			39 01 00 00 00 00 02 4c 33
			39 01 00 00 00 00 02 4d 66
			39 01 00 00 00 00 02 4e 11
			39 01 00 00 00 00 02 4f 44
			39 01 00 00 00 00 02 50 22
			39 01 00 00 00 00 02 51 55
			39 01 00 00 00 00 02 56 11
			39 01 00 00 00 00 02 58 44
			39 01 00 00 00 00 02 59 22
			39 01 00 00 00 00 02 5a 55
			39 01 00 00 00 00 02 5b 33
			39 01 00 00 00 00 02 5c 66
			39 01 00 00 00 00 02 61 11
			39 01 00 00 00 00 02 62 44
			39 01 00 00 00 00 02 63 22
			39 01 00 00 00 00 02 64 55
			39 01 00 00 00 00 02 65 33
			39 01 00 00 00 00 02 66 66
			39 01 00 00 00 00 02 6d 90
			39 01 00 00 00 00 02 6e 40
			39 01 00 00 00 00 02 70 a5
			39 01 00 00 00 00 02 72 04
			39 01 00 00 00 00 02 73 15
			39 01 00 00 00 00 02 fe 0a
			39 01 00 00 00 00 02 29 10
			39 01 00 00 00 00 02 fe 05
			39 01 00 00 00 00 02 05 01
			39 01 00 00 00 00 02 fe 0a
			39 01 00 00 00 00 02 15 c8
			39 01 00 00 00 00 02 fe 00
			39 01 00 00 00 00 02 35 00
			39 01 00 00 00 00 02 53 20
			39 01 00 00 00 00 02 51 00

			05 01 00 00 78 00 02 11 00
			05 01 00 00 0a 00 02 29 00

                               ];

               qcom,mdss-dsi-on-command-state = "dsi_lp_mode";
               qcom,mdss-dsi-off-command = [
			   15 01 00 00 78 00 02 01 00
			   05 01 00 00 32 00 02 28 00
                           05 01 00 00 32 00 02 10 00
                           15 01 00 00 32 00 02 4f 01
			   ];
               qcom,mdss-dsi-off-command-state = "dsi_hs_mode";
       };
};
