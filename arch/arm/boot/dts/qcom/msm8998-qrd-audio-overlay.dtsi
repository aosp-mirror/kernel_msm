/*
 * Copyright (c) 2017, The Linux Foundation. All rights reserved.
 *
 * This program is free software; you can redistribute it and/or modify
 * it under the terms of the GNU General Public License version 2 and
 * only version 2 as published by the Free Software Foundation.
 *
 * This program is distributed in the hope that it will be useful,
 * but WITHOUT ANY WARRANTY; without even the implied warranty of
 * MERCHANTABILITY or FITNESS FOR A PARTICULAR PURPOSE.  See the
 * GNU General Public License for more details.
 */

#include "msm8998-audio-overlay.dtsi"

&snd_934x {
	qcom,wsa-max-devs = <1>;
	qcom,wsa-devs = <&wsa881x_0211>, <&wsa881x_0213>;
	qcom,wsa-aux-dev-prefix = "SpkrLeft", "SpkrLeft";
};

&snd_9335 {
	qcom,wsa-max-devs = <1>;
	qcom,wsa-devs = <&wsa881x_0211>, <&wsa881x_0213>;
	qcom,wsa-aux-dev-prefix = "SpkrLeft", "SpkrLeft";
};
