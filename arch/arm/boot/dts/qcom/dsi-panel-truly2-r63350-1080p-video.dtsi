/* Copyright (c) 2015, The Linux Foundation. All rights reserved.
 *
 * This program is free software; you can redistribute it and/or modify
 * it under the terms of the GNU General Public License version 2 and
 * only version 2 as published by the Free Software Foundation.
 *
 * This program is distributed in the hope that it will be useful,
 * but WITHOUT ANY WARRANTY; without even the implied warranty of
 * MERCHANTABILITY or FITNESS FOR A PARTICULAR PURPOSE.  See the
 * GNU General Public License for more details.
 */

&mdss_mdp {
	dsi_truly2_r63350_1080_vid: qcom,mdss_dsi_truly2_r63350_1080p_video {
		qcom,mdss-dsi-panel-name = "truly R63350 1080p video mode dsi
									panel";
		qcom,mdss-dsi-panel-type = "dsi_video_mode";
		qcom,cont-splash-enabled;
		qcom,mdss-dsi-panel-framerate = <60>;
		qcom,mdss-dsi-virtual-channel-id = <0>;
		qcom,mdss-dsi-stream = <0>;
		qcom,mdss-dsi-panel-width = <1080>;
		qcom,mdss-dsi-panel-height = <1920>;
		qcom,mdss-dsi-h-front-porch = <234>;
		qcom,mdss-dsi-h-back-porch = <76>;
		qcom,mdss-dsi-h-pulse-width = <14>;
		qcom,mdss-dsi-h-sync-skew = <0>;
		qcom,mdss-dsi-v-front-porch = <8>;
		qcom,mdss-dsi-v-back-porch = <4>;
		qcom,mdss-dsi-v-pulse-width = <4>;
		qcom,mdss-dsi-h-left-border = <0>;
		qcom,mdss-dsi-h-right-border = <0>;
		qcom,mdss-dsi-v-top-border = <0>;
		qcom,mdss-dsi-v-bottom-border = <0>;
		qcom,mdss-dsi-bpp = <24>;
		qcom,mdss-dsi-underflow-color = <0xff>;
		qcom,mdss-dsi-border-color = <0>;
		qcom,mdss-dsi-h-sync-pulse = <0>;
		qcom,mdss-dsi-traffic-mode = "burst_mode";
		qcom,mdss-dsi-bllp-eof-power-mode;
		qcom,mdss-dsi-bllp-power-mode;
		qcom,mdss-dsi-hfp-power-mode;
		qcom,mdss-dsi-lane-0-state;
		qcom,mdss-dsi-lane-1-state;
		qcom,mdss-dsi-lane-2-state;
		qcom,mdss-dsi-lane-3-state;
		qcom,mdss-dsi-panel-timings = [fe 3c 2a 00 70 74 2e 40 30 03
									04 00];
		qcom,mdss-dsi-t-clk-post = <0x02>;
		qcom,mdss-dsi-t-clk-pre = <0x2e>;
		qcom,mdss-dsi-bl-min-level = <10>;
		qcom,mdss-dsi-bl-max-level = <225>;
		qcom,mdss-pan-physical-width-dimension = <69>;
		qcom,mdss-pan-physical-height-dimension = <122>;
		qcom,mdss-dsi-dma-trigger = "trigger_sw";
		qcom,mdss-dsi-mdp-trigger = "none";
		qcom,mdss-dsi-on-command = [
			29 01 00 00 00 00 02
			B0 00
			29 01 00 00 00 00 02
			D6 01
			29 01 00 00 00 00 07
			B3 14 00 00 00 00 00
			29 01 00 00 00 00 03
			B4 0C 00
			29 01 00 00 00 00 04
			B6 4B DB 16
			29 01 00 00 00 00 03
			BE 00 04
			29 01 00 00 00 00 02
			C0 00
			29 01 00 00 00 00 23
			C1 04 60 00 20 A9
			30 20 63 F0 FF FF
			9B 7B CF B5 FF FF
			87 8C 41 22 54 02
			00 00 00 00 00 22
			33 03 22 00 FF
			29 01 00 00 00 00 09
			C2 31 f7 80 06 04 00
			00 08
			29 01 00 00 00 00 04
			C3 00 00 00
			29 01 00 00 00 00 0C
			C4 70 00 00 00 00 00
			00 00 00 00 02
			29 01 00 00 00 00 02
			C5 00
			29 01 00 00 00 00 16
			C6 C8 3C 3C 07 01 07
			01 00 00 00 00 00 00
			00 00 00 00 0E 1A 07
			C8
			29 01 00 00 00 00 1F
			C7 03 15 1F 2A 39 46
			4E 5B 3D 45 52 5F 68
			6D 72 01 15 1F 2A 39
			46 4E 5B 3D 45 52 5F
			68 6D 78
			29 01 00 00 00 00 10
			CB FF E1 87 FF 00 00
			00 00 FF E1 87 FF E8
			00 00
			29 01 00 00 00 00 02
			CC 34
			29 01 00 00 00 00 0B
			D0 11 00 00 56 D5 40
			19 19 09 00
			29 01 00 00 00 00 05
			D1 00 48 16 0F
			29 01 00 00 00 00 04
			D2 5C 00 00
			29 01 00 00 00 00 1B
			D3 1B 33 BB BB B3 33
			33 33 33 00 01 00 00
			D8 A0 0C 4D 4D 33 33
			72 12 8A 57 3D BC
			29 01 00 00 00 00 04
			D8 00 00 00
			29 01 00 00 00 00 04
			D9 00 00 00
			29 01 00 00 00 00 05
			FD 00 00 00 30
			15 01 00 00 00 00 02
			35 00
			15 01 00 00 00 00 02
			51 00
			15 01 00 00 00 00 02
			53 24
			15 01 00 00 00 00 02
			55 00
			05 01 00 00 32 00 02
			29 00
			05 01 00 00 78 00 02
			11 00
		];
		qcom,mdss-dsi-off-command = [
			05 01 00 00 32 00 02
			28 00
			29 01 00 00 00 00 02
			B0 04
			29 01 00 00 00 00 1B
			D3 13 33 BB B3 B3 33
			33 33 33 00 01 00 00
			D8 A0 0C 4D 4D 33 33
			72 12 8A 57 3D BC
			05 01 00 00 78 00 02
			10 00
			29 01 00 00 00 00 02
			B1 01
		];

		qcom,mdss-dsi-on-command-state = "dsi_lp_mode";
		qcom,mdss-dsi-off-command-state = "dsi_hs_mode";

		qcom,mdss-dsi-bl-pmic-control-type = "bl_ctrl_dcs";
		qcom,mdss-dsi-reset-sequence = <1 20>, <0 10>, <1 20>;
		qcom,mdss-dsi-tx-eot-append;
		qcom,panel-supply-entries = <&dsi_panel_pwr_supply>;

		qcom,mdss-dsi-panel-status-command = [06 01 00 01 05 00 02
									0A 08];
		qcom,mdss-dsi-panel-status-command-state = "dsi_hs_mode";
		qcom,mdss-dsi-panel-status-check-mode = "reg_read";
		qcom,mdss-dsi-panel-status-value = <0x1C>;
		qcom,esd-check-enabled;
	};
};
