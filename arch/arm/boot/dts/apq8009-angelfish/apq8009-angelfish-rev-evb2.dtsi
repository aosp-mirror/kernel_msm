/* Copyright (c) 2016, LGE Inc. All rights reserved.
 *
 * This program is free software; you can redistribute it and/or modify
 * it under the terms of the GNU General Public License version 2 and
 * only version 2 as published by the Free Software Foundation.
 *
 * This program is distributed in the hope that it will be useful,
 * but WITHOUT ANY WARRANTY; without even the implied warranty of
 * MERCHANTABILITY or FITNESS FOR A PARTICULAR PURPOSE.  See the
 * GNU General Public License for more details.
 */

#include "apq8009-angelfish.dtsi"
#include "apq8009-angelfish-panel.dtsi"
#include "apq8009-pm8916-angelfish.dtsi"
#include "apq8009-angelfish-sound.dtsi"
#include "apq8009-angelfish-paj9124u1.dtsi"

&atmel_u114 {
	/delete-property/atmel,palm-enabled;
	atmel,fw_name = "atmel_touch_w3.fw";
};

&mdss_dsi0 {
	qcom,dsi-pref-prim-pan = <&dsi_lgd_lg4262_cmd>;
};
