/* Copyright (c) 2017, LGE Inc. All rights reserved.
 *
 * This program is free software; you can redistribute it and/or modify
 * it under the terms of the GNU General Public License version 2 and
 * only version 2 as published by the Free Software Foundation.
 *
 * This program is distributed in the hope that it will be useful,
 * but WITHOUT ANY WARRANTY; without even the implied warranty of
 * MERCHANTABILITY or FITNESS FOR A PARTICULAR PURPOSE.  See the
 * GNU General Public License for more details.
 */

&mdss_mdp {
	dsi_sw43402_dsc_qhd_cmd: qcom,mdss_dsi_sw43402_dsc_qhd_cmd {
		qcom,mdss-dsi-panel-name = "SW43402 cmd mode dsc dsi panel";
		qcom,mdss-dsi-panel-type = "dsi_cmd_mode";
		qcom,mdss-dsi-panel-framerate = <60>;
		qcom,mdss-dsi-virtual-channel-id = <0>;
		qcom,mdss-dsi-stream = <0>;
		qcom,mdss-dsi-panel-width = <1440>;
		qcom,mdss-dsi-panel-height = <2880>;
		qcom,mdss-dsi-h-front-porch = <20>;
		qcom,mdss-dsi-h-back-porch = <20>;
		qcom,mdss-dsi-h-pulse-width = <32>;
		qcom,mdss-dsi-h-sync-skew = <0>;
		qcom,mdss-dsi-v-back-porch = <20>;
		qcom,mdss-dsi-v-front-porch = <20>; //180 -> 100
		qcom,mdss-dsi-v-pulse-width = <4>;
		qcom,mdss-dsi-h-left-border = <0>;
		qcom,mdss-dsi-h-right-border = <0>;
		qcom,mdss-dsi-v-top-border = <0>;
		qcom,mdss-dsi-v-bottom-border = <0>;
		qcom,mdss-dsi-bpp = <24>;
		qcom,mdss-dsi-color-order = "rgb_swap_rgb";
		qcom,mdss-dsi-underflow-color = <0xff>;
		qcom,mdss-dsi-border-color = <0>;
		qcom,mdss-dsi-h-sync-pulse = <0>;
		qcom,mdss-dsi-traffic-mode = "burst_mode";
		qcom,mdss-dsi-lane-map = "lane_map_0123";
		qcom,mdss-dsi-bllp-eof-power-mode;
		qcom,mdss-dsi-bllp-power-mode;
		/* qcom,partial-update-enabled;
		/* qcom,panel-roi-alignment = <1440 16 1440 16 1440 16>; */
		qcom,mdss-dsi-lane-0-state;
		qcom,mdss-dsi-lane-1-state;
		qcom,mdss-dsi-lane-2-state;
		qcom,mdss-dsi-lane-3-state;
		qcom,mdss-dsi-reset-sequence = <1 10>, <0 10>, <1 10>;
		qcom,mdss-dsi-dma-trigger = "trigger_sw";
		qcom,mdss-dsi-mdp-trigger = "none";
		qcom,mdss-dsi-te-pin-select = <1>;
		qcom,mdss-dsi-wr-mem-start = <0x2c>;
		qcom,mdss-dsi-wr-mem-continue = <0x3c>;
		qcom,mdss-dsi-te-dcs-command = <1>;
		qcom,mdss-dsi-te-check-enable;
		qcom,mdss-dsi-te-using-te-pin;
		qcom,mdss-dsi-lp11-init;
		qcom,mdss-dsi-tx-eot-append;
		qcom,mdss-mdp-transfer-time-us = <15000>;
		qcom,ulps-enabled;
		qcom,mdss-dsi-force-clock-lane-hs = <1>;

		qcom,mdss-dsi-on-command = [
			39 01 00 00 00 00 03 B0 20 43
			39 01 00 00 00 00 03 DF 0B 00
			15 01 00 00 00 00 02 F2 00
			39 01 00 00 01 00 03 FF 03 00
			05 01 00 00 14 00 01 11
			05 01 00 00 64 00 01 35
			15 01 00 00 00 00 02 53 80
			15 01 00 00 00 00 02 55 0C
			39 01 00 00 00 00 0A CF
			03 05 AF 03 05 AF
			03 01 6B
			39 01 00 00 00 00 1C D0
			00 FF 85 0B 98 15
			92 13 85 00 EC 81
			05 90 0A 86 03 77
			00 B8 77 EE 65 DC
			54 CB 42
			39 01 00 00 00 00 16 D4
			10 00 FF A8 80 54
			80 20 20 20 20 56
			00 56 00 56 00 15
			55 56 55
			39 01 00 00 00 00 1D D6
			70 56 5E 4A 18 18
			F0 C8 88 88 E0 12
			10 02 FC 10 78 78
			78 6C 74 5C 34 52
			64 60 58 64
			39 01 00 00 00 00 1D D7
			70 5A 54 50 38 08
			D8 E8 06 10 18 EC
			A0 C8 10 30 7C 74
			6C 64 68 60 64 64
			74 48 40 5A
			39 01 00 00 00 00 1D D8
			70 4C 4C 48 30 14
			F0 C8 82 82 E0 30
			14 F0 E0 1C 6A 62
			54 50 58 44 28 44
			62 5A 44 52
			39 01 00 00 00 00 1D D9
			70 5A 5A 4C 32 08
			F4 F8 00 EE F4 02
			14 00 10 3A 6A 64
			5C 5C 62 62 50 56
			60 52 48 56
			05 01 00 00 00 00 01 29
			];
		qcom,mdss-dsi-on-command-state = "dsi_lp_mode";

		qcom,mdss-dsi-off-command = [
			/* Display Off */
			05 01 00 00 00 00 01 28
			/* Sleep In + min 90ms */
			05 01 00 00 5A 00 01 10
		];
		qcom,mdss-dsi-off-command-state = "dsi_lp_mode";
		qcom,mode-control-dsi-state = "dsi_lp_mode";
		qcom,mdss-pan-physical-width-dimension = <68>;
		qcom,mdss-pan-physical-height-dimension = <121>;

		qcom,compression-mode = "dsc";
		qcom,config-select = <&dsi_sw43402_dsc_cmd_config0>;

		qcom,mdss-dsc-version = <0x11>;
		qcom,mdss-dsc-scr-version = <0x1>;

		dsi_sw43402_dsc_cmd_config0: config0 {
		        qcom,lm-split = <720 720>;
		        qcom,mdss-dsc-encoders = <2>;
		        qcom,mdss-dsc-slice-height = <16>;
		        qcom,mdss-dsc-slice-width = <720>;
		        qcom,mdss-dsc-slice-per-pkt = <1>;

		        qcom,mdss-dsc-bit-per-component = <8>;
		        qcom,mdss-dsc-bit-per-pixel = <8>;
		        qcom,mdss-dsc-block-prediction-enable;
		};
	};
};

&mdss_fb0 {
	/delete-node/ qcom,cont-splash-memory;
};
