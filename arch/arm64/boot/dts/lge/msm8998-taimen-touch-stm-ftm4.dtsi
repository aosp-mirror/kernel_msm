/* Copyright (c) 2014, The Linux Foundation. All rights reserved.
 *
 * This program is free software; you can redistribute it and/or modify
 * it under the terms of the GNU General Public License version 2 and
 * only version 2 as published by the Free Software Foundation.
 *
 * This program is distributed in the hope that it will be useful,
 * but WITHOUT ANY WARRANTY; without even the implied warranty of
 * MERCHANTABILITY or FITNESS FOR A PARTICULAR PURPOSE.  See the
 * GNU General Public License for more details.
 */

&pm8998_l28 {
        regulator-min-microvolt = <3300000>;
        regulator-max-microvolt = <3300000>;
        qcom,init-voltage = <3300000>;
        status = "okay";
};

&pm8998_l6 {
        regulator-min-microvolt = <1800000>;
        regulator-max-microvolt = <1800000>;
        qcom,init-voltage = <1800000>;
        status = "okay";
};

&i2c_5 {
	status = "disabled";
	qcom,clk-freq-out = <400000>;
	qcom,i2c-clk = <&tlmm 88 0>;
	qcom,i2c-dat = <&tlmm 87 0>;

	pinctrl-names = "i2c_active", "i2c_sleep", "i2c_bitbang";
	pinctrl-0 = <&i2c_5_active>;
	pinctrl-1 = <&i2c_5_sleep>;
	pinctrl-2 = <&i2c_5_bitbang>;

	ftm4_fts@49 {
		status = "ok";
		compatible = "stm,ftm4_fts";
		reg = <0x49>;

		interrupt-names = "tp_direct_interrupt";
		interrupts = <0 216 0>;

		pinctrl-names = "on_state","off_state";
		pinctrl-0 = <&ts_active>;
		pinctrl-1 = <&ts_suspend>;

		stm,switch_gpio= <&tlmm 75 0>;
		stm,irq_gpio = <&tlmm 125 0>;
		stm,irq_type = <0x2004>;
		stm,num_lines = <32 16>;
		stm,max_coords = <1439 2879>;
		stm,regulator_dvdd = "pm8998_l6";
		stm,regulator_avdd = "pm8998_l28";
		//stm,tspid_gpio = <&gpg1 4 0>;
		//stm,tspid2_gpio = <&gpr3 2 0>;

		//stm,vdd-gpio = <&tlmm 85 0x0>;
		//stm,vio-gpio = <&tlmm 86 0x0>;
		stm,reset-gpio = <&tlmm 89 0x0>;
		stm,ta_detect_gpio = <&tlmm 50 0x0>;

		stm,firmware_name = "ftm4_fw.ftb";

		power-supplies = <&pmi8998_charger>;
	};
};

