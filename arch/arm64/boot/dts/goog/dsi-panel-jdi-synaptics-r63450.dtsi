/* Copyright (c) 2015-2016, The Linux Foundation. All rights reserved.
 *
 * This program is free software; you can redistribute it and/or modify
 * it under the terms of the GNU General Public License version 2 and
 * only version 2 as published by the Free Software Foundation.
 *
 * This program is distributed in the hope that it will be useful,
 * but WITHOUT ANY WARRANTY; without even the implied warranty of
 * MERCHANTABILITY or FITNESS FOR A PARTICULAR PURPOSE.  See the
 * GNU General Public License for more details.
 */

&mdss_mdp {
	dsi_jdi_synaptics_r63450: qcom,mdss_dsi_jdi_synaptics_r63450 {
		qcom,mdss-dsi-panel-name = "JDI Synaptics R63450 Panel";
		qcom,mdss-dsi-panel-type = "dsi_video_mode";
		qcom,mdss-dsi-panel-framerate = <90>;
		qcom,mdss-dsi-virtual-channel-id = <0>;
		qcom,mdss-dsi-stream = <0>;
		qcom,mdss-dsi-panel-width = <1440>;
		qcom,mdss-dsi-panel-height = <1700>;
		qcom,mdss-dsi-h-front-porch = <148>;
		qcom,mdss-dsi-h-back-porch = <56>;
		qcom,mdss-dsi-h-pulse-width = <16>;
		qcom,mdss-dsi-h-sync-skew = <0>;
		qcom,mdss-dsi-v-back-porch = <30>;
		qcom,mdss-dsi-v-front-porch = <16>;
		qcom,mdss-dsi-v-pulse-width = <4>;
		qcom,mdss-dsi-bpp = <24>;
		qcom,mdss-dsi-underflow-color = <0xff>;
		qcom,mdss-dsi-border-color = <0>;

		qcom,mdss-dsi-on-command = [39 01 00 00 00 00 05 2a 00 00 05 9f
			39 01 00 00 00 00 05 2b 00 00 06 a3
			39 01 00 00 00 00 03 44 00 00
			15 01 00 00 00 00 02 35 00
			23 01 00 00 00 00 02 b0 04
			23 01 00 00 00 00 02 d6 01
			29 01 00 00 00 00 04 b3 31 00 82
			29 01 00 00 00 00 04 b6 3a c3 00
			23 01 00 00 2a 00 02 b0 03];
		qcom,mdss-dsi-post-panel-on-command = [15 01 00 00 78 00 02 11 00
			15 01 00 00 00 00 02 36 00
			15 01 00 00 00 00 02 3a 77
			07 01 00 00 00 00 02 01 00
			15 01 00 00 28 00 02 29 00];
		qcom,mdss-dsi-off-command = [15 01 00 00 28 00 02 28 00
				 15 01 00 00 78 00 02 10 00];
		qcom,mdss-dsi-on-command-state = "dsi_lp_mode";
		qcom,mdss-dsi-off-command-state = "dsi_hs_mode";
		qcom,mdss-dsi-h-sync-pulse = <0>;
		qcom,mdss-dsi-traffic-mode = "non_burst_sync_event";
		qcom,mdss-dsi-bllp-eof-power-mode;
		qcom,mdss-dsi-bllp-power-mode;
		qcom,mdss-dsi-lane-0-state;
		qcom,mdss-dsi-lane-1-state;
		qcom,mdss-dsi-lane-2-state;
		qcom,mdss-dsi-lane-3-state;
		qcom,mdss-dsi-panel-timings = [00 13 05 04 08 0e 04 05 04 03 04 00];
		qcom,mdss-dsi-t-clk-post = <0x06>;
		qcom,mdss-dsi-t-clk-pre = <0x1f>;
		qcom,mdss-dsi-dma-trigger = "trigger_sw";
		qcom,mdss-dsi-mdp-trigger = "none";
		qcom,mdss-dsi-lp11-init;
		qcom,mdss-dsi-reset-sequence = <0 15>, <1 15>, <0 2>, <1 20>;
		qcom,cmd-sync-wait-broadcast;

		qcom,compression-mode = "dsc";
		qcom,config-select = <&dsi_jdi_synaptics_r63450_video_config0>;

		dsi_jdi_synaptics_r63450_video_config0: config0 {
			qcom,split-mode = "dualctrl-split";
			qcom,mdss-dsc-encoders = <1>;
			qcom,mdss-dsc-slice-height = <20>;
			qcom,mdss-dsc-slice-width = <720>;
			qcom,mdss-dsc-slice-per-pkt = <2>;

			qcom,mdss-dsc-bit-per-component = <8>;
			qcom,mdss-dsc-bit-per-pixel = <8>;
			qcom,mdss-dsc-block-prediction-enable;
		};
	};
};
