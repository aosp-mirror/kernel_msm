/* Copyright (c) 2015-2016, The Linux Foundation. All rights reserved.
 *
 * This program is free software; you can redistribute it and/or modify
 * it under the terms of the GNU General Public License version 2 and
 * only version 2 as published by the Free Software Foundation.
 *
 * This program is distributed in the hope that it will be useful,
 * but WITHOUT ANY WARRANTY; without even the implied warranty of
 * MERCHANTABILITY or FITNESS FOR A PARTICULAR PURPOSE.  See the
 * GNU General Public License for more details.
*/

qcom,m1s1-prototype-id2-batterydata {
	qcom,max-voltage-uv = <4400000>;
	qcom,v-cutoff-uv = <3250000>;
	qcom,nom-batt-capacity-mah = <3450>;
	qcom,batt-id-kohm = <33>;
	qcom,battery-beta = <4360>;
	qcom,battery-type = "2";
	qcom,chg-rslow-comp-c1 = <2378826>;
	qcom,chg-rslow-comp-c2 = <2172944>;
	qcom,chg-rs-to-rslow = <1144693>;
	qcom,chg-rslow-comp-thr = <0x99>;
	qcom,checksum = <0x8D52>;
	qcom,gui-version = "PMI8996GUI - 1.0.1.4";
	qcom,fastchg-current-ma = <3400>;
	htc,batt_id = <2>;
	htc,id_raw_min = <16001>;
	htc,id_raw_max = <40000>;
	htc,bat-ful-chg-criteria-ma = <345>;
	htc,fcc-half-capacity-ma = <1600>;
	qcom,fg-profile-data = [
		 95 83 76 75
		 0D 80 F0 75
		 56 83 C0 54
		 25 80 3D 85
		 00 82 B7 98
		 6E B5 32 C0
		 77 17 0A 88
		 9C 7E B2 82
		 5B 7D 70 83
		 A2 75 6E 8A
		 37 95 4F 82
		 3B 98 79 B5
		 BE C0 58 17
		 13 0C AE 5A
		 14 70 B8 FE
		 30 45 09 45
		 0B 48 00 00
		 15 47 66 39
		 1D 2E 00 00
		 00 00 00 00
		 00 00 00 00
		 15 71 FA 6B
		 05 63 A2 88
		 73 75 68 68
		 62 46 D7 7B
		 12 74 83 60
		 00 81 82 C2
		 12 CB 62 C2
		 64 A0 71 0C
		 28 00 FF 36
		 F0 11 30 03
		 00 00 00 0C
	];
};
