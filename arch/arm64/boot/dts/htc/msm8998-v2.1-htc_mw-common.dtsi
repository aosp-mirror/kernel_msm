/* Copyright (c) 2016, The Linux Foundation. All rights reserved.
 *
 * This program is free software; you can redistribute it and/or modify
 * it under the terms of the GNU General Public License version 2 and
 * only version 2 as published by the Free Software Foundation.
 *
 * This program is distributed in the hope that it will be useful,
 * but WITHOUT ANY WARRANTY; without even the implied warranty of
 * MERCHANTABILITY or FITNESS FOR A PARTICULAR PURPOSE.  See the
 * GNU General Public License for more details.
 */


#include "../qcom/msm8998-v2.1.dtsi"
#include "../qcom/msm8998-mtp.dtsi"
#include "msm8998-htc_muskie.dtsi"
#include "msm8998-htc-nfc.dtsi"
#include "msm8998-htc-usb-xa.dtsi"
#include "msm8998-htc-easel.dtsi"
#include "msm8998-camera-sensor-muskie-xa.dtsi"
#include "msm8998-htc-fingerprint-muskie-xa.dtsi"
#include "msm8998-htc-haptics-xa.dtsi"
#include "msm8998-htc-led-xa.dtsi"

/ {
	compatible = "qcom,msm8998-mtp", "qcom,msm8998", "qcom,mtp";
};
