/* Copyright (c) 2016, The Linux Foundation. All rights reserved.
 *
 * This program is free software; you can redistribute it and/or modify
 * it under the terms of the GNU General Public License version 2 and
 * only version 2 as published by the Free Software Foundation.
 *
 * This program is distributed in the hope that it will be useful,
 * but WITHOUT ANY WARRANTY; without even the implied warranty of
 * MERCHANTABILITY or FITNESS FOR A PARTICULAR PURPOSE.  See the
 * GNU General Public License for more details.
 */


#include "../qcom/msmcobalt-mtp.dtsi"
#include "msmcobalt-htc_muskie.dtsi"
#include "msmcobalt-camera-sensor.dtsi"
#include "msmcobalt-htc-easel.dtsi"

&i2c_9 {
	tca6418_i2c: tca6418-i2c@34 {
		compatible = "ti,tca6418-i2c";
		reg = <0x34>;
		pinctrl = <&tca6418>;
	};
};

&soc {
	tca6418: tca6418-pinctrl {
		compatible = "ti,tca6418-pinctrl";
		#gpio-cells = <2>;
		label = "tca6418-gpio";
		i2c-client = <&tca6418_i2c>;
	 };
};
