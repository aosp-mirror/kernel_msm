/* Copyright (c) 2015-2016, The Linux Foundation. All rights reserved.
*
* This program is free software; you can redistribute it and/or modify
* it under the terms of the GNU General Public License version 2 and
* only version 2 as published by the Free Software Foundation.
*
* This program is distributed in the hope that it will be useful,
* but WITHOUT ANY WARRANTY; without even the implied warranty of
* MERCHANTABILITY or FITNESS FOR A PARTICULAR PURPOSE.  See the
* GNU General Public License for more details.
*/

qcom,s1-id2-batterydata {
	qcom,max-voltage-uv = <4400000>;
	qcom,v-cutoff-uv = <3250000>;
	qcom,nom-batt-capacity-mah = <2770>;
	qcom,batt-id-kohm = <10>;
	qcom,battery-beta = <4360>;
	qcom,battery-type = "2";
	qcom,chg-rslow-comp-c1 = <3538198>;
	qcom,chg-rslow-comp-c2 = <5411244>;
	qcom,chg-rs-to-rslow = <1036471>;
	qcom,chg-rslow-comp-thr = <0xAC>;
	qcom,checksum = <0x497A>;
	qcom,gui-version = "PMI8996GUI - 1.1.0.0";
	qcom,fastchg-current-ma = <2800>;
	htc,batt_id = <2>;
	htc,id_raw_min = <0>;
	htc,id_raw_max = <16000>;
	htc,bat-ful-chg-criteria-ma = <277>;
	qcom,fg-profile-data = [
		DE 83 B1 7C
		07 81 29 77
		64 83 1F 74
		46 89 55 94
		22 82 A3 99
		57 BC 84 C8
		56 11 F8 83
		23 7D 3A 81
		65 77 51 83
		57 70 49 6B
		1D 84 57 82
		6B 99 A7 BC
		66 C9 58 0E
		FC 0A 1D 5B
		14 70 15 FC
		E8 35 AA 44
		AF 39 00 00
		5F 47 A4 31
		5F 28 00 00
		00 00 00 00
		00 00 00 00
		44 70 EB 6A
		60 68 24 8A
		E9 75 95 6A
		93 67 53 7A
		0A 74 4E 63
		7F 55 39 AA
		1D 44 63 0E
		65 A0 71 0C
		28 00 FF 36
		F0 11 30 03
		00 00 00 0C
	];
};
