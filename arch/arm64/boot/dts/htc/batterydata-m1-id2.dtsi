/* Copyright (c) 2015-2016, The Linux Foundation. All rights reserved.
 *
 * This program is free software; you can redistribute it and/or modify
 * it under the terms of the GNU General Public License version 2 and
 * only version 2 as published by the Free Software Foundation.
 *
 * This program is distributed in the hope that it will be useful,
 * but WITHOUT ANY WARRANTY; without even the implied warranty of
 * MERCHANTABILITY or FITNESS FOR A PARTICULAR PURPOSE.  See the
 * GNU General Public License for more details.
*/

qcom,m1-id2-batterydata {
	qcom,max-voltage-uv = <4400000>;
	qcom,v-cutoff-uv = <3250000>;
	qcom,nom-batt-capacity-mah = <3450>;
	qcom,batt-id-kohm = <33>;
	qcom,battery-beta = <4360>;
	qcom,battery-type = "2";
	qcom,chg-rslow-comp-c1 = <3538882>;
	qcom,chg-rslow-comp-c2 = <5504896>;
	qcom,chg-rs-to-rslow = <1135551>;
	qcom,chg-rslow-comp-thr = <0xAE>;
	qcom,checksum = <0x9B41>;
	qcom,gui-version = "PMI8996GUI - 1.1.0.0";
	qcom,fastchg-current-ma = <3400>;
	htc,batt_id = <2>;
	htc,id_raw_min = <27501>;
	htc,id_raw_max = <40000>;
	htc,bat-ful-chg-criteria-ma = <345>;
	htc,fcc-half-capacity-ma = <1600>;
	qcom,fg-profile-data = [
		E0 83 DB 7C
		2B 81 6B 77
		61 83 3A 6F
		0D 89 40 94
		48 82 4B 98
		AF B5 0F C1
		52 15 F6 83
		13 7D 29 81
		2D 77 5E 83
		FF 54 7F 83
		81 8F 53 82
		A5 99 FC BC
		F0 C9 54 0E
		F7 0D EF 59
		14 70 B8 FE
		B2 36 38 46
		AF 41 00 00
		78 46 56 23
		3F 21 00 00
		00 00 00 00
		00 00 00 00
		B5 70 B7 6B
		F2 61 50 89
		AE 75 09 6A
		D6 5E FF 7A
		F7 6F 7A 62
		9B 7F 7D AB
		1B 85 63 A8
		65 A0 71 0C
		28 00 FF 36
		F0 11 30 03
		00 00 00 0C
	];
};
