/* Copyright (c) 2016, The Linux Foundation. All rights reserved.
 *
 * This program is free software; you can redistribute it and/or modify
 * it under the terms of the GNU General Public License version 2 and
 * only version 2 as published by the Free Software Foundation.
 *
 * This program is distributed in the hope that it will be useful,
 * but WITHOUT ANY WARRANTY; without even the implied warranty of
 * MERCHANTABILITY or FITNESS FOR A PARTICULAR PURPOSE.  See the
 * GNU General Public License for more details.
 */

/dts-v1/;

/* WIP: Device tree overlay: SoC dtbo */
#include "msm8998-v2.1-htc_mw-common-soc.dtsi"

/*
 * TODO: Device tree overlay:
 * below part is to be removed and the information will be
 * provided through DTB/DTBO partition dt_table_entry.
 */

/ {
	model = "HTC Corporation. MSM8998 v2.1 Walleye XA";
	qcom,board-id = <444 0>;
};

/* WIP: Device tree overlay: overlay dtbo */
#include "msm8998-v2.1-htc_mw-common-overlay.dtsi"
#include "batterydata-walleye.dtsi"
#include "msm8998-touch-walleye-xa.dtsi"
#include "msm8998-htc-led-xa.dtsi"
