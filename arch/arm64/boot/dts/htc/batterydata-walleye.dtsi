&soc {
	walleye_batterydata: qcom,battery-data {
		qcom,batt-id-range-pct = <20>;
		#include "batterydata-walleye-id1.dtsi"
		#include "batterydata-walleye-id2.dtsi"
		#include "batterydata-walleye-unknown.dtsi"
	};
};

&pmi8998_fg {
	qcom,battery-data = <&walleye_batterydata>;
	qcom,fg-force-load-profile;
	qcom,fg-jeita-thresholds = <0 15 48 55>;
	qcom,fg-jeita-hyst-temp = <2>;
	qcom,fg-recharge-soc-thr = <97>;
	qcom,fg-chg-term-current = <50>;
	qcom,fg-cutoff-voltage = <3400>;
};

&pmi8998_charger {
	qcom,auto-recharge-soc;
};
