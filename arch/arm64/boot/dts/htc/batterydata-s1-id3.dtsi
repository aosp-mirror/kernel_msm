/* Copyright (c) 2015-2016, The Linux Foundation. All rights reserved.
*
* This program is free software; you can redistribute it and/or modify
* it under the terms of the GNU General Public License version 2 and
* only version 2 as published by the Free Software Foundation.
*
* This program is distributed in the hope that it will be useful,
* but WITHOUT ANY WARRANTY; without even the implied warranty of
* MERCHANTABILITY or FITNESS FOR A PARTICULAR PURPOSE.  See the
* GNU General Public License for more details.
*/

qcom,s1-id3-batterydata {
	qcom,max-voltage-uv = <4400000>;
	qcom,v-cutoff-uv = <3250000>;
	qcom,nom-batt-capacity-mah = <2770>;
	qcom,batt-id-kohm = <22>;
	qcom,battery-beta = <4360>;
	qcom,battery-type = "3";
	qcom,chg-rslow-comp-c1 = <4072226>;
	qcom,chg-rslow-comp-c2 = <6809143>;
	qcom,chg-rs-to-rslow = <1837234>;
	qcom,chg-rslow-comp-thr = <0xB4>;
	qcom,checksum = <0xC89F>;
	qcom,gui-version = "PMI8996GUI - 1.1.0.0";
	qcom,fastchg-current-ma = <2800>;
	htc,batt_id = <3>;
	htc,id_raw_min = <16001>;
	htc,id_raw_max = <27500>;
	htc,bat-ful-chg-criteria-ma = <277>;
	qcom,fg-profile-data = [
		AC 83 A6 74
		37 79 79 65
		7E 83 DB 7D
		3C 91 61 9C
		43 82 80 98
		0F B6 72 C1
		4C 17 84 83
		ED 66 FB 72
		8C 4D 34 83
		77 79 64 86
		8B 81 82 82
		C0 93 BE B5
		CB C1 6B 16
		16 0B F1 59
		14 70 B8 FE
		35 44 DC 44
		97 40 00 00
		BE 47 F0 43
		3E 3D 00 00
		00 00 00 00
		00 00 00 00
		97 71 B8 70
		05 6A 8D 82
		6E 74 D3 5A
		E5 63 85 80
		1A 74 80 59
		02 6C 93 B1
		18 6D 63 F0
		64 A0 71 0C
		28 00 FF 36
		F0 11 30 03
		00 00 00 0C
	];
};
