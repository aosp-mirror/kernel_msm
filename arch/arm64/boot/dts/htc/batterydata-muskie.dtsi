&soc {
	muskie_batterydata: qcom,battery-data {
		qcom,batt-id-range-pct = <20>;
		#include "batterydata-muskie-id1.dtsi"
		#include "batterydata-muskie-id2.dtsi"
		#include "batterydata-muskie-unknown.dtsi"
	};
};

&pmi8998_fg {
	qcom,battery-data = <&muskie_batterydata>;
	qcom,fg-force-load-profile;
	qcom,fg-jeita-thresholds = <0 15 48 55>;
	qcom,fg-jeita-hyst-temp = <2>;
	qcom,fg-auto-recharge-soc;
	qcom,fg-recharge-soc-thr = <97>;
	qcom,fg-rsense-sel = <0>;
	qcom,fg-chg-term-current = <50>;
	qcom,fg-sys-term-current = <(-575)>;
	qcom,fg-cutoff-voltage = <3400>;
	qcom,hold-soc-while-full;
	qcom,linearize-soc;
	qcom,cl-max-decrement = <5>;
};

&pmi8998_charger {
	qcom,auto-recharge-soc;
};
