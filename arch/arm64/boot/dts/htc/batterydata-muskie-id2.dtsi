qcom,muskie-id2-batterydata {
	qcom, = <24>;
	qcom,max-voltage-uv = <4400000>;
	qcom,nom-batt-capacity-mah = <3830>;
	qcom,batt-id-kohm = <47>;
	qcom,battery-beta = <4360>;
	qcom,battery-type = "muskie 2";
	qcom,checksum = <0x13D4>;
	qcom,gui-version = "PMI8998GUI - 2.0.0.55";
	/*
	 * a conservative value used to limit charge current in case the
	 * charging module is not loaded. The charging module would change
	 * the value to allow faster charging.
	 */
	qcom,fastchg-current-ma = <500>;
	qcom,fg-cc-cv-threshold-mv = <4390>;
	qcom,fcc-mah = <3830>;
	qcom,batt-thermal-limit-vol = <4200>;
	htc,fastchg-current-ma = <3825>;
	qcom,fg-profile-data = [
		 6D 1F BB 05
		 62 0A CF FC
		 7B 1D 19 F5
		 4D 12 15 14
		 9D 18 FB 22
		 84 45 D0 52
		 56 00 00 00
		 0E 00 00 00
		 00 00 6B C5
		 D7 CC 07 00
		 1D 00 08 00
		 8F DB 32 E5
		 F6 05 C7 FA
		 5B B2 A0 13
		 3B EC 22 33
		 21 06 09 20
		 27 00 14 00
		 A9 1F C7 05
		 3D 0A 41 FD
		 5D 1D 13 F2
		 23 0A 7F 15
		 4E 19 D3 22
		 81 45 FA 52
		 55 00 00 00
		 0E 00 00 00
		 00 00 96 CC
		 0A CA 29 C5
		 18 00 00 00
		 D5 E3 32 E5
		 93 06 A2 F3
		 68 06 EC 01
		 16 01 0E 23
		 C5 33 CC FF
		 07 10 00 00
		 71 0F 66 46
		 18 00 40 00
		 91 01 0A FA
		 FF 00 00 00
		 00 00 00 00
		 00 00 00 00
		 00 00 00 00
		 00 00 00 00
		 00 00 00 00
		 00 00 00 00
		 00 00 00 00
		 00 00 00 00
		 00 00 00 00
		 00 00 00 00
		 00 00 00 00
		 00 00 00 00
		 00 00 00 00
		 00 00 00 00
		 00 00 00 00
		 00 00 00 00
		 00 00 00 00
		 00 00 00 00
	];
};
