/* Copyright (c) 2016, The Linux Foundation. All rights reserved.
 *
 * This program is free software; you can redistribute it and/or modify
 * it under the terms of the GNU General Public License version 2 and
 * only version 2 as published by the Free Software Foundation.
 *
 * This program is distributed in the hope that it will be useful,
 * but WITHOUT ANY WARRANTY; without even the implied warranty of
 * MERCHANTABILITY or FITNESS FOR A PARTICULAR PURPOSE.  See the
 * GNU General Public License for more details.
 */


/dts-v1/;

#include "../qcom/msm8996pro-v1.1.dtsi"
#include "../qcom/msm-pmi8996.dtsi"
#include "../qcom/msm8996-mtp.dtsi"
#include "msm8996-nc-pins-htc_sailfish-xb.dtsi"
#include "msm8996-htc_sailfish.dtsi"

/ {
	model = "HTC Corporation. MSM8996pro v1.1 + PMI8996 Sailfish XC";
	qcom,msm-id = <420 0x10001>, <421 0x10001>;
	qcom,board-id = <2 0>;
};
