&pm8998_gpios {
	gpio@c100 { /* GPIO 2 - V_EG_3V_EN */
		qcom,mode = <1>;
		qcom,output-type = <0>;
		qcom,invert = <1>;
		qcom,pull = <5>;
		qcom,vin-sel = <0>;
		qcom,src-sel = <0>;
		qcom,out-strength = <1>;
		qcom,master-en = <1>;
		status = "okay";
	};
};

