/* Copyright (c) 2015-2016, The Linux Foundation. All rights reserved.
*
* This program is free software; you can redistribute it and/or modify
* it under the terms of the GNU General Public License version 2 and
* only version 2 as published by the Free Software Foundation.
*
* This program is distributed in the hope that it will be useful,
* but WITHOUT ANY WARRANTY; without even the implied warranty of
* MERCHANTABILITY or FITNESS FOR A PARTICULAR PURPOSE.  See the
* GNU General Public License for more details.
*/

qcom,s1-id1-batterydata {
	qcom,max-voltage-uv = <4400000>;
	qcom,v-cutoff-uv = <3250000>;
	qcom,nom-batt-capacity-mah = <2640>;
	qcom,batt-id-kohm = <33>;
	qcom,battery-beta = <4360>;
	qcom,battery-type = "1";
	qcom,chg-rslow-comp-c1 = <2974834>;
	qcom,chg-rslow-comp-c2 = <3566426>;
	qcom,chg-rs-to-rslow = <1134960>;
	qcom,chg-rslow-comp-thr = <0x99>;
	qcom,checksum = <0x42A0>;
	qcom,gui-version = "PMI8996GUI - 1.1.0.0";
	qcom,fastchg-current-ma = <2600>;
	htc,batt_id = <1>;
	htc,id_raw_min = <27501>;
	htc,id_raw_max = <40000>;
	htc,bat-ful-chg-criteria-ma = <264>;
	qcom,fg-profile-data = [
		6D 83 ED 6D
		5F 7A 58 74
		31 83 83 73
		8E 7E 55 7A
		CF 81 6D 9B
		B8 BE 7E D0
		7D 0E 12 88
		34 7F 14 83
		A4 7D 5F 83
		10 65 CD 83
		E3 8E 4E 82
		4E 98 AD B5
		07 C1 58 18
		2F 0B 12 5A
		14 70 B8 FE
		7A 45 61 46
		B3 48 00 00
		4D 47 E5 39
		FE 1A 00 00
		00 00 00 00
		00 00 00 00
		FE 70 C4 6B
		3D 61 25 88
		06 76 D1 68
		31 58 DD 7B
		3C 74 E0 59
		84 62 40 B3
		1B FE 60 66
		5E A0 71 0C
		28 00 FF 36
		F0 11 30 03
		00 00 00 0C
	];
};
