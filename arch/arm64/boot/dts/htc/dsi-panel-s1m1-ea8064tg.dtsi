/* Copyright (c) 2016, The Linux Foundation. All rights reserved.
 *
 * This program is free software; you can redistribute it and/or modify
 * it under the terms of the GNU General Public License version 2 and
 * only version 2 as published by the Free Software Foundation.
 *
 * This program is distributed in the hope that it will be useful,
 * but WITHOUT ANY WARRANTY; without even the implied warranty of
 * MERCHANTABILITY or FITNESS FOR A PARTICULAR PURPOSE.  See the
 * GNU General Public License for more details.
 */

&mdss_mdp {
	mdss_dsi_samsung_ea8064tg_1080p_cmd: qcom,mdss_dsi_samsung_ea8064tg_1080p_cmd {
		compatible = "qcom,mdss_dsi_samsung_ea8064tg_1080p_cmd";
		qcom,mdss-dsi-panel-name = "S1 FHD SAMSUNG EA8064TG 5.0 command mode panel";
		qcom,mdss-dsi-panel-type = "dsi_cmd_mode";
		qcom,mdss-dsi-panel-framerate = <60>;
		qcom,mdss-dsi-virtual-channel-id = <0>;
		qcom,mdss-dsi-stream = <0>;
		qcom,mdss-dsi-panel-width = <1080>;
		qcom,mdss-dsi-panel-height = <1920>;
		qcom,mdss-dsi-h-front-porch = <18>;
		qcom,mdss-dsi-h-back-porch = <18>;
		qcom,mdss-dsi-h-pulse-width = <10>;
		qcom,mdss-dsi-h-sync-skew = <0>;
		qcom,mdss-dsi-v-back-porch = <11>;
		qcom,mdss-dsi-v-front-porch = <5>;
		qcom,mdss-dsi-v-pulse-width = <2>;
		qcom,mdss-dsi-h-left-border = <0>;
		qcom,mdss-dsi-h-right-border = <0>;
		qcom,mdss-dsi-v-top-border = <0>;
		qcom,mdss-dsi-v-bottom-border = <0>;
		qcom,mdss-pan-physical-width-dimension  = <62>;
		qcom,mdss-pan-physical-height-dimension = <110>;
		qcom,mdss-dsi-bpp = <24>;
		qcom,mdss-dsi-color-order = "rgb_swap_rgb";
		qcom,mdss-dsi-underflow-color = <0xff>;
		qcom,mdss-dsi-border-color = <0>;
		qcom,mdss-dsi-h-sync-pulse = <0>;
		qcom,mdss-dsi-traffic-mode = "non_burst_sync_event";
		qcom,mdss-dsi-lane-map = "lane_map_0123";
		qcom,mdss-dsi-bllp-eof-power-mode;
		qcom,mdss-dsi-bllp-power-mode;
		qcom,mdss-dsi-panel-broadcast-mode;
		qcom,mdss-dsi-lane-0-state;
		qcom,mdss-dsi-lane-1-state;
		qcom,mdss-dsi-lane-2-state;
		qcom,mdss-dsi-lane-3-state;
		qcom,mdss-dsi-panel-timings = [D6 38 26 00 68 6E 2A 3C 2C 03 04 00];
		qcom,mdss-dsi-panel-timings-8996 = [
			22 1E 07 08 04 03 04 A0
			22 1E 07 08 04 03 04 A0
			22 1E 07 08 04 03 04 A0
			22 1E 07 08 04 03 04 A0
			22 18 07 08 04 03 04 A0
		];
		qcom,mdss-dsi-reset-sequence =  <1 2>, <0 1>, <1 10>;
		qcom,mdss-dsi-t-clk-post = <0x0D>;
		qcom,mdss-dsi-t-clk-pre = <0x2C>;
		qcom,mdss-dsi-bl-pmic-control-type = "bl_ctrl_dcs";
		qcom,mdss-dsi-bl-min-level = <1>;
		qcom,mdss-dsi-bl-max-level = <255>;
		qcom,mdss-dsi-dma-trigger = "trigger_sw";
		qcom,mdss-dsi-mdp-trigger = "none";
		qcom,mdss-dsi-wr-mem-start = <0x2c>;
		qcom,mdss-dsi-wr-mem-continue = <0x3c>;
		qcom,mdss-dsi-te-pin-select = <1>;
		qcom,mdss-dsi-te-dcs-command = <1>;
		qcom,mdss-dsi-te-check-enable;
		qcom,mdss-dsi-te-using-te-pin;
		qcom,mdss-dsi-on-command = [
			05 01 00 00 14 00 02 11 00 /* sleep out */
			05 01 00 00 00 00 02 35 00 /* TE on */
			29 01 00 00 00 00 03 FC 5A 5A /* key unlock */
			29 01 00 00 00 00 03 F4 00 01 /* clk setting */
			29 01 00 00 00 00 03 FC A5 A5 /* key lock */
			15 01 00 00 00 00 02 53 20 /* brightness control (dimming) */
			05 01 00 00 00 00 02 29 00 /* display on */
		];
		qcom,mdss-dsi-on-command-state = "dsi_lp_mode";
		qcom,mdss-dsi-off-command = [
			05 01 00 00 23 00 02 28 00
			05 01 00 00 96 00 02 10 00
		];
		qcom,mdss-dsi-off-command-state = "dsi_hs_mode";
		qcom,mdss-dsi-gain-on-command = [
			29 01 00 00 00 00 03 F0 5A 5A
			29 01 00 00 00 00 03 F1 5A 5A
			29 01 00 00 00 00 07 C8 00 00 00 00 00 00
			29 01 00 00 00 00 02 F7 03
			29 01 00 00 00 00 03 F0 A5 A5
			29 01 00 00 00 00 03 F1 A5 A5
		];
		qcom,mdss-dsi-rgb-gain-offset = <2 1 2>;
		qcom,mdss-dsi-lp-mode-on = [
			29 01 00 00 00 00 03 F0 5A 5A
			29 01 00 00 00 00 02 B0 0A
			29 01 00 00 00 00 03 CB 26 48
			29 01 00 00 00 00 02 B0 33
			29 01 00 00 00 00 06 CB 69 00 00 04 0D
			29 01 00 00 00 00 02 B0 3C
			29 01 00 00 00 00 0E CB 00 00 00 00 00 00 06 05 00 00 00 00 6D
			29 01 00 00 00 00 02 B0 4E
			29 01 00 00 00 00 06 CB 04 04 2C 2C 02
			29 01 00 00 00 00 02 B0 03
			29 01 00 00 00 00 03 C0 11 03
			29 01 00 00 00 00 02 B0 03
			29 01 00 00 00 00 02 B2 00
			29 01 00 00 00 00 02 B0 01
			29 01 00 00 00 00 03 B2 05 48
			29 01 00 00 00 00 02 F7 03
			29 01 00 00 00 00 03 F0 A5 A5
		];
		qcom,mdss-dsi-lp-mode-off = [
			29 01 00 00 00 00 03 F0 5A 5A
			29 01 00 00 00 00 02 B0 0A
			29 01 00 00 00 00 03 CB 66 88
			29 01 00 00 00 00 02 B0 33
			29 01 00 00 00 00 06 CB 74 00 00 06 05
			29 01 00 00 00 00 02 B0 3C
			29 01 00 00 00 00 0E CB 02 00 00 00 00 00 00 00 00 00 00 00 00
			29 01 00 00 00 00 02 B0 4E
			29 01 00 00 00 00 06 CB 00 00 00 00 00
			29 01 00 00 00 00 02 B0 03
			29 01 00 00 00 00 03 C0 0B 05
			29 01 00 00 00 00 02 B0 03
			29 01 00 00 00 00 02 B2 20
			29 01 00 00 00 00 02 B0 01
			29 01 00 00 00 00 03 B2 00 10
			29 01 00 00 00 00 02 F7 03
			29 01 00 00 00 00 03 F0 A5 A5
		];
		qcom,mdss-dsi-lp-off-offset = <16 1 0>;
		qcom,cont-splash-enabled;
		qcom,panel-supply-entries = <&dsi_panel_pwr_supply_ea8064tg>;
		qcom,mdss-dsi-lp11-init;
		qcom,esd-check-enabled;
		qcom,mdss-dsi-panel-status-check-mode = "te_signal_check";
		htc,mdss-dsi-bl-dim-check = <30>;
	};
};
