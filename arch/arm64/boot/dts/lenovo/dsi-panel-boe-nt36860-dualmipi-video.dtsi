/* Copyright (c) 2015-2017, The Linux Foundation. All rights reserved.
 *
 * This program is free software; you can redistribute it and/or modify
 * it under the terms of the GNU General Public License version 2 and
 * only version 2 as published by the Free Software Foundation.
 *
 * This program is distributed in the hope that it will be useful,
 * but WITHOUT ANY WARRANTY; without even the implied warranty of
 * MERCHANTABILITY or FITNESS FOR A PARTICULAR PURPOSE.  See the
 * GNU General Public License for more details.
 */

&mdss_mdp {
	dsi_dual_boe_nt36860_video: qcom,mdss_dsi_boe_nt36860_dualdsi_video {
		qcom,mdss-dsi-panel-name = "Dual DSI boe nt36860 75fps dsc 1440x2560";
		qcom,mdss-dsi-panel-type = "dsi_video_mode";
		qcom,mdss-dsi-panel-framerate = <75>;
		qcom,mdss-dsi-virtual-channel-id = <0>;
		qcom,mdss-dsi-stream = <0>;
		qcom,mdss-dsi-panel-width = <720>;
		qcom,mdss-dsi-panel-height = <2560>;
		qcom,mdss-dsi-h-front-porch = <120>;
		qcom,mdss-dsi-h-back-porch = <120>;
		qcom,mdss-dsi-h-pulse-width = <4>;
		qcom,mdss-dsi-h-sync-skew = <0>;
		qcom,mdss-dsi-v-back-porch = <10>;
		qcom,mdss-dsi-v-front-porch = <1328>;
		qcom,mdss-dsi-v-pulse-width = <2>;
		qcom,mdss-pan-physical-width-dimension = <68>;
		qcom,mdss-pan-physical-height-dimension = <121>;
		qcom,mdss-dsi-bpp = <24>;
		qcom,mdss-dsi-underflow-color = <0xff>;
		qcom,mdss-dsi-border-color = <0>;
		qcom,mdss-dsi-on-command = [
			15 01 00 00 01 00 02 FF 22
			15 01 00 00 00 00 02 00 5B
			15 01 00 00 00 00 02 01 5B
			15 01 00 00 00 00 02 02 5B
			15 01 00 00 00 00 02 03 5B
			15 01 00 00 00 00 02 04 5A
			15 01 00 00 00 00 02 05 5A
			15 01 00 00 00 00 02 06 5A
			15 01 00 00 00 00 02 07 5A
			15 01 00 00 00 00 02 08 5A
			15 01 00 00 00 00 02 09 58
			15 01 00 00 00 00 02 0A 55
			15 01 00 00 00 00 02 0B 53
			15 01 00 00 00 00 02 0C 50
			15 01 00 00 00 00 02 0D 4C
			15 01 00 00 00 00 02 0E 48
			15 01 00 00 00 00 02 0F 44
			15 01 00 00 00 00 02 10 40
			15 01 00 00 00 00 02 11 50
			15 01 00 00 00 00 02 12 60
			15 01 00 00 00 00 02 13 70
			15 01 00 00 00 00 02 14 58
			15 01 00 00 00 00 02 15 68
			15 01 00 00 00 00 02 16 78
			15 01 00 00 00 00 02 17 00
			15 01 00 00 00 00 02 18 40
			15 01 00 00 00 00 02 19 40
			15 01 00 00 00 00 02 1A 40
			15 01 00 00 00 00 02 1B 40
			15 01 00 00 00 00 02 1C 40
			15 01 00 00 00 00 02 1D 40
			15 01 00 00 00 00 02 1E 40
			15 01 00 00 00 00 02 1F 40
			15 01 00 00 00 00 02 20 40
			15 01 00 00 00 00 02 21 45
			15 01 00 00 00 00 02 22 49
			15 01 00 00 00 00 02 23 4C
			15 01 00 00 00 00 02 24 4B
			15 01 00 00 00 00 02 25 48
			15 01 00 00 00 00 02 26 44
			15 01 00 00 00 00 02 27 41
			15 01 00 00 00 00 02 28 40
			15 01 00 00 00 00 02 2D 00
			15 01 00 00 00 00 02 2F 40
			15 01 00 00 00 00 02 30 40
			15 01 00 00 00 00 02 31 40
			15 01 00 00 00 00 02 32 40
			15 01 00 00 00 00 02 33 40
			15 01 00 00 00 00 02 34 40
			15 01 00 00 00 00 02 35 40
			15 01 00 00 00 00 02 36 40
			15 01 00 00 00 00 02 37 40
			15 01 00 00 00 00 02 38 40
			15 01 00 00 00 00 02 39 40
			15 01 00 00 00 00 02 3A 40
			15 01 00 00 00 00 02 3B 40
			15 01 00 00 00 00 02 3D 40
			15 01 00 00 00 00 02 3F 40
			15 01 00 00 00 00 02 40 40
			15 01 00 00 00 00 02 41 40
			15 01 00 00 00 00 02 42 40
			15 01 00 00 00 00 02 43 40
			15 01 00 00 00 00 02 44 40
			15 01 00 00 00 00 02 45 40
			15 01 00 00 00 00 02 46 40
			15 01 00 00 00 00 02 47 40
			15 01 00 00 00 00 02 48 40
			15 01 00 00 00 00 02 49 40
			15 01 00 00 00 00 02 4A 40
			15 01 00 00 00 00 02 4B 40
			15 01 00 00 00 00 02 4C 40
			15 01 00 00 00 00 02 4D 40
			15 01 00 00 00 00 02 4E 40
			15 01 00 00 00 00 02 4F 40
			15 01 00 00 00 00 02 50 40
			15 01 00 00 00 00 02 51 40
			15 01 00 00 00 00 02 52 40
			15 01 00 00 00 00 02 53 01
			15 01 00 00 00 00 02 54 00
			15 01 00 00 00 00 02 55 88
			15 01 00 00 00 00 02 56 7E
			15 01 00 00 00 00 02 58 37
			15 01 00 00 00 00 02 59 37
			15 01 00 00 00 00 02 5A 37
			15 01 00 00 00 00 02 5B 37
			15 01 00 00 00 00 02 5C 37
			15 01 00 00 00 00 02 5D 37
			15 01 00 00 00 00 02 5E 37
			15 01 00 00 00 00 02 5F 37
			15 01 00 00 00 00 02 60 37
			15 01 00 00 00 00 02 61 37
			15 01 00 00 00 00 02 62 37
			15 01 00 00 00 00 02 63 37
			15 01 00 00 00 00 02 64 37
			15 01 00 00 00 00 02 65 37
			15 01 00 00 00 00 02 66 37
			15 01 00 00 00 00 02 67 37
			15 01 00 00 00 00 02 68 37
			15 01 00 00 00 00 02 69 37
			15 01 00 00 00 00 02 6A 37
			15 01 00 00 00 00 02 6B 37
			15 01 00 00 00 00 02 6C 37
			15 01 00 00 00 00 02 6D 37
			15 01 00 00 00 00 02 6E 37
			15 01 00 00 00 00 02 6F 37
			15 01 00 00 00 00 02 70 00
			15 01 00 00 00 00 02 71 00
			15 01 00 00 00 00 02 72 00
			15 01 00 00 00 00 02 73 12
			15 01 00 00 00 00 02 74 06
			15 01 00 00 00 00 02 75 0C
			15 01 00 00 00 00 02 76 03
			15 01 00 00 00 00 02 77 09
			15 01 00 00 00 00 02 78 0F
			15 01 00 00 00 00 02 79 68
			15 01 00 00 00 00 02 7A 88
			15 01 00 00 00 00 02 83 01
			15 01 00 00 00 00 02 84 38
			15 01 00 00 00 00 02 85 40
			15 01 00 00 00 00 02 86 40
			15 01 00 00 00 00 02 87 40
			15 01 00 00 00 00 02 88 40
			15 01 00 00 00 00 02 89 40
			15 01 00 00 00 00 02 8A 40
			15 01 00 00 00 00 02 8B 40
			15 01 00 00 00 00 02 8C 45
			15 01 00 00 00 00 02 8D 48
			15 01 00 00 00 00 02 8E 49
			15 01 00 00 00 00 02 8F 48
			15 01 00 00 00 00 02 90 45
			15 01 00 00 00 00 02 91 40
			15 01 00 00 00 00 02 92 40
			15 01 00 00 00 00 02 93 40
			15 01 00 00 00 00 02 94 40
			15 01 00 00 00 00 02 95 40
			15 01 00 00 00 00 02 96 40
			15 01 00 00 00 00 02 97 40
			15 01 00 00 00 00 02 98 40
			15 01 00 00 00 00 02 99 40
			15 01 00 00 00 00 02 9A 40
			15 01 00 00 00 00 02 9B 40
			15 01 00 00 00 00 02 9C 40
			15 01 00 00 00 00 02 9D 40
			15 01 00 00 00 00 02 9E 40
			15 01 00 00 00 00 02 9F 40
			15 01 00 00 00 00 02 A0 40
			15 01 00 00 00 00 02 A2 20
			15 01 00 00 00 00 02 B0 32
			15 01 00 00 00 00 02 B1 52
			15 01 00 00 00 00 02 B2 74
			15 01 00 00 00 00 02 B3 77
			15 01 00 00 00 00 02 B4 50
			15 01 00 00 00 00 02 B5 14
			15 01 00 00 00 00 02 B6 18
			15 01 00 00 00 00 02 B7 76
			15 01 00 00 00 00 02 B8 77
			15 01 00 00 00 00 02 B9 05
			15 01 00 00 00 00 02 BA 10
			15 01 00 00 00 00 02 BB 14
			15 01 00 00 00 00 02 BC 0F
			15 01 00 00 00 00 02 BD 18
			15 01 00 00 00 00 02 BE 1F
			15 01 00 00 00 00 02 BF 04
			15 01 00 00 00 00 02 C0 10
			15 01 00 00 00 00 02 C1 14
			15 01 00 00 00 00 02 C2 03
			15 01 00 00 00 00 02 C3 07
			15 01 00 00 00 00 02 C4 0A
			15 01 00 00 00 00 02 C5 60
			15 01 00 00 00 00 02 C6 55
			15 01 00 00 00 00 02 C7 FF
			15 01 00 00 00 00 02 C8 38
			15 01 00 00 00 00 02 C9 44
			15 01 00 00 00 00 02 CA 11
			15 01 00 00 00 00 02 CD C6
			15 01 00 00 00 00 02 FB 01

			15 01 00 00 00 00 02 FF D0
			15 01 00 00 00 00 02 FB 01
			15 01 00 00 00 00 02 05 88


			15 01 00 00 00 00 02 FF E0
			15 01 00 00 00 00 02 FB 01
			15 01 00 00 00 00 02 53 22

			15 01 00 00 00 00 02 FF 23
			15 01 00 00 00 00 02 FB 01
			15 01 00 00 00 00 02 A9 00
			15 01 00 00 00 00 02 AC 04
			15 01 00 00 00 00 02 AD 68
			15 01 00 00 00 00 02 AE A0
			15 01 00 00 00 00 02 AF C8

			15 01 00 00 00 00 02 FF 24
			15 01 00 00 00 00 02 FB 01
			15 01 00 00 00 00 02 30 03
			15 01 00 00 00 00 02 F5 8F

			15 01 00 00 00 00 02 FF 25
			15 01 00 00 00 00 02 FB 01
			15 01 00 00 00 00 02 C4 10
			15 01 00 00 00 00 02 61 20
			15 01 00 00 00 00 02 62 30

			15 01 00 00 00 00 02 FF 26
			15 01 00 00 00 00 02 FB 01
			15 01 00 00 00 00 02 4D 8B
			15 01 00 00 00 00 02 FF 10
			15 01 00 00 00 00 02 FB 01
			15 01 00 00 00 00 02 C0 83
			39 01 00 00 02 00 05 BE 00 0C 05 30
			15 01 00 00 00 00 02 53 24
			39 01 00 00 00 00 03 51 01 1E
			15 01 00 00 00 00 02 35 00
			15 01 00 00 00 00 02 BB 03
			15 01 00 00 00 00 02 36 00
			15 01 00 00 00 00 02 55 80
			05 01 00 00 78 00 02 11 00
			05 01 00 00 32 00 02 29 00
		];

		qcom,mdss-dsi-on-command-tianma = [
			15 01 00 00 00 00 02 FF E0
			15 01 00 00 00 00 02 FB 01
			15 01 00 00 00 00 02 53 22

			15 01 00 00 00 00 02 FF 20
			15 01 00 00 00 00 02 FB 01
			15 01 00 00 00 00 02 59 FF
			15 01 00 00 00 00 02 5D 0F
			15 01 00 00 00 00 02 61 FF

			15 01 00 00 00 00 02 FF 29
			15 01 00 00 00 00 02 FB 01
			15 01 00 00 00 00 02 42 00
			15 01 00 00 00 00 02 43 6C
			15 01 00 00 00 00 02 45 00
			15 01 00 00 00 00 02 46 6C
			15 01 00 00 00 00 02 47 00
			15 01 00 00 00 00 02 48 0C
			15 01 00 00 00 00 02 49 03
			15 01 00 00 00 00 02 4A 50

			15 01 00 00 00 00 02 58 00
			15 01 00 00 00 00 02 59 00
			15 01 00 00 00 00 02 5A 04
			15 01 00 00 00 00 02 5B 68
			15 01 00 00 00 00 02 5C 04
			15 01 00 00 00 00 02 5D 68

			15 01 00 00 00 00 02 64 00
			15 01 00 00 00 00 02 65 01
			15 01 00 00 00 00 02 66 5A
			15 01 00 00 00 00 02 67 01
			15 01 00 00 00 00 02 68 5A

			15 01 00 00 00 00 02 69 00
			15 01 00 00 00 00 02 6A 01
			15 01 00 00 00 00 02 6B 5A
			15 01 00 00 00 00 02 6C 01
			15 01 00 00 00 00 02 6D 5A

			15 01 00 00 00 00 02 A9 08
			15 01 00 00 00 00 02 AA 13
			15 01 00 00 00 00 02 AB 87
			15 01 00 00 00 00 02 AD 08
			15 01 00 00 00 00 02 AE 13
			15 01 00 00 00 00 02 AF 87

			15 01 00 00 00 00 02 FF 23
			15 01 00 00 00 00 02 FB 01
			15 01 00 00 00 00 02 A9 00
			15 01 00 00 00 00 02 AC 04
			15 01 00 00 00 00 02 AD 9B
			15 01 00 00 00 00 02 AE A0
			15 01 00 00 00 00 02 AF 95

			15 01 00 00 00 00 02 FF 24
			15 01 00 00 00 00 02 FB 01
			15 01 00 00 00 00 02 F5 8F

			15 01 00 00 00 00 02 FF 25
			15 01 00 00 00 00 02 FB 01
			15 01 00 00 00 00 02 C4 10
			15 01 00 00 00 00 02 61 20
			15 01 00 00 00 00 02 62 30

			15 01 00 00 00 00 02 FF 10
			15 01 00 00 00 00 02 FB 01
			15 01 00 00 00 00 02 C0 83
			39 01 00 00 02 00 05 BE 00 0C 05 30
			15 01 00 00 00 00 02 53 24
			39 01 00 00 00 00 03 51 08 1E
			15 01 00 00 00 00 02 35 00
			15 01 00 00 00 00 02 BB 03
			15 01 00 00 00 00 02 36 00
			05 01 00 00 78 00 02 11 00
			05 01 00 00 32 00 02 29 00
		];

		qcom,mdss-dsi-off-command = [05 01 00 00 0a 00 02 28 00
		];
		qcom,mdss-dsi-on-command-state = "dsi_lp_mode";
		qcom,mdss-dsi-off-command-state = "dsi_hs_mode";
		qcom,mdss-dsi-h-sync-pulse = <0>;
		qcom,mdss-dsi-traffic-mode = "burst_mode";
		qcom,mdss-dsi-bllp-eof-power-mode;
		qcom,mdss-dsi-bllp-power-mode;
		qcom,mdss-dsi-lane-0-state;
		qcom,mdss-dsi-lane-1-state;
		qcom,mdss-dsi-lane-2-state;
		qcom,mdss-dsi-lane-3-state;
		oem,display-select-gpio = <&tlmm 8 0>;
                qcom,mdss-dsi-panel-timings =  [00 1C 08 07 23 22 07 07 05 03 04 00];
                qcom,mdss-dsi-t-clk-post = <0x0D>;
                qcom,mdss-dsi-t-clk-pre = <0x2D>;

		qcom,mdss-dsi-dma-trigger = "trigger_sw";
		qcom,mdss-dsi-mdp-trigger = "none";
		qcom,mdss-dsi-reset-sequence = <1 10>, <0 10>, <1 10>;
		qcom,mdss-dsi-tx-eot-append;
		qcom,mdss-dsi-bl-pmic-control-type = "bl_ctrl_dcs";
		qcom,mdss-dsi-bl-min-level = <1>;
		qcom,mdss-dsi-bl-max-level = <255>;

		qcom,adjust-timer-wakeup-ms = <1>;
		qcom,compression-mode = "dsc";
		qcom,config-select = <&dsi_dual_boe_nt36860_video_config0>;

		dsi_dual_boe_nt36860_video_config0: config0 {
			qcom,mdss-dsc-encoders = <1>;
			qcom,mdss-dsc-slice-height = <8>;
			qcom,mdss-dsc-slice-width = <720>;
			qcom,mdss-dsc-slice-per-pkt = <1>;

			qcom,mdss-dsc-bit-per-component = <8>;
			qcom,mdss-dsc-bit-per-pixel = <8>;
			qcom,mdss-dsc-block-prediction-enable;
		};
	};
};
