/* Copyright (c) 2017, The Linux Foundation. All rights reserved.
 *
 * This program is free software; you can redistribute it and/or modify
 * it under the terms of the GNU General Public License version 2 and
 * only version 2 as published by the Free Software Foundation.
 *
 * This program is distributed in the hope that it will be useful,
 * but WITHOUT ANY WARRANTY; without even the implied warranty of
 * MERCHANTABILITY or FITNESS FOR A PARTICULAR PURPOSE.  See the
 * GNU General Public License for more details.
 */

/dts-v1/;

#include "msm8998-vega-common.dtsi"

/ {
	model = "Lenovo. Vega DVT";
	goog,board-revision = "vega-dvt";
	/* Board-Id GPIOs: 0: 100, 1: 99, 2: 119, 3: 118, and 4: 96. */
	goog,board-id = <100 0 99 0 119 0 118 1 96 1>;  /* 11000 */
};

&cci {
	qcom,camera@3 {
		pinctrl-0 = <&cam_sensor_mclk0_active
				&cam_sensor_6dofr_active>;
		pinctrl-1 = <&cam_sensor_mclk0_suspend
				 &cam_sensor_6dofr_suspend>;
	};
};
