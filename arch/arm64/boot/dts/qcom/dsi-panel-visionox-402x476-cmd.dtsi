/* Copyright (c) 2019-2020, The Linux Foundation. All rights reserved.
 *
 * This program is free software; you can redistribute it and/or modify
 * it under the terms of the GNU General Public License version 2 and
 * only version 2 as published by the Free Software Foundation.
 *
 * This program is distributed in the hope that it will be useful,
 * but WITHOUT ANY WARRANTY; without even the implied warranty of
 * MERCHANTABILITY or FITNESS FOR A PARTICULAR PURPOSE.  See the
 * GNU General Public License for more details.
 */

&mdss_mdp {
	dsi_visionox_402x476_cmd: qcom,mdss_dsi_visionox_402x476_cmd {
		qcom,mdss-dsi-panel-name = "Visionox 402x476 (RM69090) command mode dsi panel";
		qcom,mdss-dsi-panel-type = "dsi_cmd_mode";
		qcom,mdss-dsi-panel-framerate = <60>;
		qcom,mdss-dsi-virtual-channel-id = <0>;
		qcom,mdss-dsi-stream = <0>;
		qcom,mdss-dsi-panel-width = <402>;
		qcom,mdss-dsi-panel-height = <476>;
		qcom,mdss-dsi-h-front-porch = <10>;
		qcom,mdss-dsi-h-back-porch = <10>;
		qcom,mdss-dsi-h-pulse-width = <2>;
		qcom,mdss-dsi-h-sync-skew = <0>;
		qcom,mdss-dsi-v-back-porch = <10>;
		qcom,mdss-dsi-v-front-porch = <10>;
		qcom,mdss-dsi-v-pulse-width = <2>;
		qcom,mdss-dsi-h-left-border = <0>;
		qcom,mdss-dsi-h-right-border = <0>;
		qcom,mdss-dsi-v-top-border = <0>;
		qcom,mdss-dsi-v-bottom-border = <0>;
		qcom,mdss-dsi-bpp = <24>;
		qcom,mdss-dsi-color-order = "rgb_swap_rgb";
		qcom,mdss-dsi-underflow-color = <0xff>;
		qcom,mdss-dsi-border-color = <0>;
		qcom,mdss-tear-check-frame-rate = <6000>;
		qcom,mdss-dsi-idle-fps = <10>;
		qcom,mdss-dsi-on-command = [
			15 01 00 00 00 00 02 fe 00
			39 00 00 00 00 00 05 2a 00 28 01 B9
			39 01 00 00 00 00 05 2b 00 00 01 DB
			15 01 00 00 00 00 02 13 00
			15 01 00 00 00 00 02 35 00
			15 01 00 00 00 00 02 53 20
			05 01 00 00 50 00 01 11
			05 01 00 00 00 00 01 29
		];
		qcom,mdss-dsi-off-command = [
			05 01 00 00 00 00 01 28
			05 01 00 00 60 00 01 10
			15 01 00 00 00 00 02 4f 01
		];
		qcom,mdss-dsi-on-command-state = "dsi_lp_mode";
		qcom,mdss-dsi-off-command-state = "dsi_hs_mode";
		qcom,mdss-dsi-lane-map = "lane_map_0123";
		qcom,mdss-dsi-bllp-eof-power-mode;
		qcom,mdss-dsi-bllp-power-mode;
		qcom,mdss-dsi-lane-0-state;
		qcom,mdss-dsi-te-pin-select = <1>;
		qcom,mdss-dsi-te-dcs-command = <1>;
		qcom,mdss-dsi-te-using-te-pin;
		qcom,mdss-dsi-te-check-enable;
		qcom,mdss-dsi-panel-timings = [65 12 0C 00 34 38 10 16 0F 03 04 00];
		qcom,mdss-dsi-t-clk-post = <0x05>;
		qcom,mdss-dsi-t-clk-pre = <0x16>;
		qcom,mdss-dsi-bl-min-level = <1>;
		qcom,mdss-dsi-bl-max-level = <255>;
		qcom,mdss-dsi-dma-trigger = "trigger_sw";
		qcom,mdss-dsi-mdp-trigger = "none";
		qcom,mdss-dsi-bl-pmic-control-type = "bl_ctrl_dcs";
		qcom,mdss-dsi-reset-sequence = <0 15>, <1 15>;
		qcom,mdss-dsi-panel-status-check-mode = "te_signal_check";
		/* qcom,partial-update-enabled; */
		/* qcom,panel-roi-alignment = <2 2 2 2 0 0>; */
	};
};
