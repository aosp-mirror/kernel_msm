/*
 * Copyright (c) 2015, The Linux Foundation. All rights reserved.
 *
 * This program is free software; you can redistribute it and/or modify
 * it under the terms of the GNU General Public License version 2 and
 * only version 2 as published by the Free Software Foundation.
 *
 * This program is distributed in the hope that it will be useful,
 * but WITHOUT ANY WARRANTY; without even the implied warranty of
 * MERCHANTABILITY or FITNESS FOR A PARTICULAR PURPOSE.  See the
 * GNU General Public License for more details.
 */

qcom,atl_opoww28_420mah {
	qcom,battery-type = "ATL-OPOWX64-435mah";
	qcom,nom-batt-capacity-mah = <435>;
	qcom,batt-id-kohm = <105>;
	qcom,battery-beta = <3380>;
	qcom,battery-thermal-coefficients = [a1 50 ff];
	qcom,default-rbatt-mohm = <200>;
	qcom,max-voltage-uv = <4435000>;
	qcom,fastchg-current-ma = <875>;
	qcom,fg-cc-cv-threshold-mv = <4425>;

	qcom,checksum = <0x5270>;
	qcom,gui-version = "PM660GUI - 0.0.0.45";
	qcom,fg-profile-data = [
		 4A 26 95 15
		 EF 13 A1 0C
		 09 1D 43 01
		 03 FD 4D 02
		 3C 19 40 22
		 AF 3C 5E 4B
		 A2 00 00 00
		 15 00 00 00
		 00 00 16 C4
		 4A BD 9A CA
		 39 00 08 00
		 C4 EB 56 07
		 99 ED 44 E5
		 24 EB C7 02
		 88 15 C1 52
		 0D 06 09 20
		 27 00 14 00
		 E9 20 E5 0D
		 30 12 22 04
		 D1 1C BD 02
		 81 0C 02 12
		 B0 18 2E 23
		 10 45 C7 53
		 71 00 00 00
		 10 00 00 00
		 00 00 AF CD
		 E5 C2 B9 C5
		 32 00 00 00
		 6F F3 56 07
		 2C ED 67 DC
		 6F E2 71 FA
		 FF F4 84 1B
		 B0 33 CC FF
		 07 10 00 00
		 BB 01 33 47
		 32 00 40 00
		 F0 02 0A FA
		 FF 00 00 00
		 00 00 00 00
		 00 00 00 00
		 00 00 00 00
		 00 00 00 00
		 00 00 00 00
		 00 00 00 00
		 00 00 00 00
		 00 00 00 00
		 00 00 00 00
		 00 00 00 00
		 00 00 00 00
		 00 00 00 00
		 00 00 00 00
		 00 00 00 00
		 00 00 00 00
		 00 00 00 00
		 00 00 00 00
		 00 00 00 00
	];
};
