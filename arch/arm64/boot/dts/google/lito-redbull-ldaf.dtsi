// SPDX-License-Identifier: GPL-2.0
/*
 * Copyright (c) 2019, The Linux Foundation. All rights reserved.
 *
 * This program is free software; you can redistribute it and/or modify
 * it under the terms of the GNU General Public License version 2 and
 * only version 2 as published by the Free Software Foundation.
 *
 * This program is distributed in the hope that it will be useful,
 * but WITHOUT ANY WARRANTY; without even the implied warranty of
 * MERCHANTABILITY or FITNESS FOR A PARTICULAR PURPOSE.  See the
 * GNU General Public License for more details.
 */

&qupv3_se11_i2c {
	/* VL53L1 */
	status = "ok";
	stmvl53l1: stmvl53l1@29 {
		compatible = "st,stmvl53l1";
		reg = <0x29>;
		xsdn-gpio = <&tlmm 74 0>;
		intr-gpio = <&tlmm 107 0>;
		boot-reg = <0x29>;
		vdd-supply = <&pm8150a_l9>;//L9C
		vio-supply = <&slg51000_ldo7>;
		regulator-names = "vdd", "vio";
		status = "ok";
	};
};
