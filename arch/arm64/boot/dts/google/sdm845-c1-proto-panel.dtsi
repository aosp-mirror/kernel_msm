/* Copyright (c) 2018 Google, Inc.
 *
 * This software is licensed under the terms of the GNU General Public
 * License version 2, as published by the Free Software Foundation, and
 * may be copied, distributed, and modified under those terms.
 *
 * This program is distributed in the hope that it will be useful,
 * but WITHOUT ANY WARRANTY; without even the implied warranty of
 * MERCHANTABILITY or FITNESS FOR A PARTICULAR PURPOSE.  See the
 * GNU General Public License for more details.
 *
 */

&dsi_s6e3ha8_dsc_wqhd_cmd {
	qcom,mdss-brightness-max-level = <255>;
	qcom,mdss-dsi-bl-lut = <
		0x0   0x5d  0x71  0x83  0x95  0xa6  0xb6  0xc1
		0xcb  0xd5  0xde  0xe8  0xf1  0xfb  0x105 0x10e
		0x117 0x11e 0x125 0x12c 0x132 0x139 0x140 0x147
		0x14d 0x154 0x15b 0x162 0x169 0x16f 0x175 0x17b
		0x180 0x185 0x18a 0x190 0x195 0x19a 0x19f 0x1a5
		0x1aa 0x1b0 0x1b6 0x1bb 0x1c1 0x1c6 0x1cc 0x1d1
		0x1d5 0x1da 0x1de 0x1e3 0x1e7 0x1ec 0x1f1 0x1f5
		0x1fa 0x1fe 0x203 0x208 0x20c 0x211 0x216 0x21b
		0x220 0x225 0x22a 0x22f 0x233 0x237 0x23b 0x23f
		0x242 0x246 0x249 0x24c 0x24f 0x252 0x255 0x258
		0x25c 0x25f 0x263 0x266 0x269 0x26d 0x270 0x273
		0x275 0x278 0x27b 0x27d 0x280 0x283 0x286 0x289
		0x28d 0x290 0x293 0x296 0x299 0x29c 0x29f 0x2a1
		0x2a4 0x2a7 0x2aa 0x2ac 0x2af 0x2b1 0x2b3 0x2b6
		0x2b8 0x2bb 0x2bd 0x2c0 0x2c3 0x2c6 0x2c9 0x2cb
		0x2ce 0x2d1 0x2d4 0x2d6 0x2d8 0x2da 0x2dc 0x2de
		0x2e0 0x2e2 0x2e5 0x2e7 0x2ea 0x2ee 0x2f1 0x2f4
		0x2f8 0x2fb 0x2fd 0x300 0x302 0x305 0x307 0x30a
		0x30c 0x30f 0x311 0x313 0x316 0x318 0x31a 0x31c
		0x31f 0x321 0x323 0x326 0x328 0x32a 0x32d 0x32f
		0x332 0x334 0x336 0x339 0x33c 0x33e 0x341 0x344
		0x347 0x349 0x34c 0x34e 0x350 0x352 0x354 0x356
		0x358 0x35b 0x35d 0x35f 0x361 0x363 0x365 0x367
		0x36a 0x36c 0x36e 0x370 0x372 0x375 0x377 0x37a
		0x37c 0x37f 0x382 0x384 0x387 0x389 0x38b 0x38d
		0x38f 0x391 0x393 0x395 0x397 0x399 0x39b 0x39d
		0x39f 0x3a1 0x3a3 0x3a5 0x3a7 0x3a8 0x3aa 0x3ac
		0x3ae 0x3b0 0x3b3 0x3b5 0x3b7 0x3ba 0x3bc 0x3be
		0x3c0 0x3c3 0x3c5 0x3c7 0x3c9 0x3cb 0x3cd 0x3cf
		0x3d0 0x3d2 0x3d4 0x3d6 0x3d8 0x3da 0x3dc 0x3de
		0x3df 0x3e1 0x3e3 0x3e5 0x3e6 0x3e8 0x3ea 0x3ec
		0x3ee 0x3f1 0x3f3 0x3f5 0x3f8 0x3fa 0x3fd 0x3ff
		>;
};
