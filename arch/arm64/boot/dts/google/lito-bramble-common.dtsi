// SPDX-License-Identifier: GPL-2.0
/* Copyright (c) 2019, The Linux Foundation. All rights reserved.
 *
 * This program is free software; you can redistribute it and/or modify
 * it under the terms of the GNU General Public License version 2 and
 * only version 2 as published by the Free Software Foundation.
 *
 * This program is distributed in the hope that it will be useful,
 * but WITHOUT ANY WARRANTY; without even the implied warranty of
 * MERCHANTABILITY or FITNESS FOR A PARTICULAR PURPOSE.  See the
 * GNU General Public License for more details.
 */

#include "lito-redbull-common.dtsi"
#include "lito-bramble-audio.dtsi"
#include "lito-bramble-thermal.dtsi"
#include "lito-bramble-usb.dtsi"
#include "lito-bramble-nfc.dtsi"
#include "lito-bramble-ese.dtsi"
#include "lito-bramble-haptics.dtsi"
#include "lito-bramble-rainbow.dtsi"
#include "lito-bramble-display.dtsi"
