// SPDX-License-Identifier: GPL-2.0
/* Copyright (c) 2019, The Linux Foundation. All rights reserved.
 *
 * This program is free software; you can redistribute it and/or modify
 * it under the terms of the GNU General Public License version 2 and
 * only version 2 as published by the Free Software Foundation.
 *
 * This program is distributed in the hope that it will be useful,
 * but WITHOUT ANY WARRANTY; without even the implied warranty of
 * MERCHANTABILITY or FITNESS FOR A PARTICULAR PURPOSE.  See the
 * GNU General Public License for more details.
 */

#include "lito-redbull-common.dtsi"
#include "lito-barbet-audio.dtsi"
#include "lito-barbet-usb.dtsi"
#include "lito-barbet-nfc.dtsi"
#include "lito-barbet-ese.dtsi"
#include "lito-barbet-haptics.dtsi"
#include "lito-barbet-display.dtsi"
#include "lito-barbet-touch.dtsi"
