/* Copyright (c) 2018 Google, Inc.
 *
 * This software is licensed under the terms of the GNU General Public
 * License version 2, as published by the Free Software Foundation, and
 * may be copied, distributed, and modified under those terms.
 *
 * This program is distributed in the hope that it will be useful,
 * but WITHOUT ANY WARRANTY; without even the implied warranty of
 * MERCHANTABILITY or FITNESS FOR A PARTICULAR PURPOSE.  See the
 * GNU General Public License for more details.
 *
 */

/* We need override the display on sequence for EVT1 devices. */
&dsi_sw43408_dsc_fhd_cmd {
	qcom,mdss-dsi-display-timings {
		timing@0 {
			qcom,mdss-dsi-on-command = [
				15 01 00 00 00 00 02 35 00

				39 01 00 00 00 00 03 53 0C 30

				05 01 00 00 C8 00 01 11
				/* TODO: delay specified as 100ms. 0xC8 translates to 200 ms */

				/* PPS */
				07 01 00 00 00 00 01 11

				0A 01 00 00 00 00 80 11
					00 00 89 30 80 08 70 04
					38 00 10 02 1C 02 1C 02
					00 02 0E 00 20 01 84 00
					07 00 0C 06 67 06 5C 18
					00 10 F0 03 0C 20 00 06
					0B 0B 33 0E 1C 2A 38 46
					54 62 69 70 77 79 7B 7D
					7E 01 02 01 00 09 40 09
					BE 19 FC 19 FA 19 F8 1A
					38 1A 78 1A B6 2A F6 2B
					34 2B 74 3B 74 6B F4 00
					00 00 00 00 00 00 00 00
					00 00 00 00 00 00 00 00
					00 00 00 00 00 00 00 00
					00 00 00 00 00 00 00 00
					00 00 00 00 00 00 00

				15 01 00 00 00 00 02 B0 AC

				15 01 00 00 00 00 02 26 02

				/* Edge Round coordination loaded from Flash to SRAM */
				15 01 00 00 00 00 02 B0 AC /* MCS Access */

				39 01 00 00 00 00 07 F7
					01 49 0C FF 7F 04 /* Flash memory power on */

				39 01 00 00 00 00 06 CB 80 5C 07 03 28

				39 01 00 00 00 00 06 CC
					02 00 00 00 41 /* Flash memory type check */

				39 01 00 00 00 00 13 CD
					00 00 00 20 20 20 20 20
					24 24 28 28 28 20 20 20
					20 16	       /* VSSEL band setting */

				15 01 00 00 00 00 02 EC 10 /* Data read enable from Flash */
				15 01 00 00 00 00 02 F3 AC /* Don't load OTP */


				/* Edge Round Blur(Anti-Aliasing) Func. ON */
				15 01 00 00 00 00 02 B0 55 /* MLPIS Access */

				39 01 00 00 00 00 0C D7
					03 02 00 02 00 01 00 01
					69 01 00 /* Edge Round Control1 */

				39 01 00 00 00 00 0E D8
					00 02 00 02 00 02 00 01
					00 01 00 02 1C /* Edge Round Control2 */

				39 01 00 00 00 00 07 55
					34 70 CB 04 70 DB /* Edge Round function on */

				15 01 00 00 00 00 02 B0 CA /* Lock MCS Access */

				05 01 00 00 00 00 01 29
			];
		};
	};
};

