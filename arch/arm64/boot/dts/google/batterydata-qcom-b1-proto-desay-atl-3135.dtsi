qcom,b1_proto_desay_atl_3135 {
	qcom, = <24>;
	/* #3141156_Google_B1atl_3135mAh_averaged_MasterSlave_Nov16th2017*/
	qcom,max-voltage-uv = <4400000>;
	qcom,nom-batt-capacity-mah = <3135>;
	qcom,fastchg-current-ma = <3135>;
	qcom,fg-cc-cv-threshold-mv = <4390>;
	qcom,batt-id-kohm = <47>;
	qcom,battery-beta = <4360>;
	qcom,battery-type = "b1_proto_desay_atl_3135";
	qcom,checksum = <0xBFC5>;
	qcom,gui-version = "PMI8998GUI - 2.0.0.58";
	/* hysteresis = 100000 */
	qcom,step-chg-ranges = <
		/* 20C =< temp < 42C */
		3000000 4100000 3135000 /* 1.0C */
		4100000 4200000 2194500 /* 0.7C */
		4200000 4400000 1567500 /* 0.5C */
		>;

	qcom,fg-profile-data = [
		 B2 1F 63 05
		 AE 0A 0F 06
		 4E 1D 54 E2
		 14 0A 71 0C
		 E7 18 88 22
		 3A 3C CC 4B
		 5C 00 00 00
		 10 00 00 00
		 00 00 1C C5
		 7F C4 82 C3
		 1E 00 08 00
		 1B E2 F6 ED
		 25 F4 73 EA
		 2B FB 60 12
		 EF FC 8A 2B
		 1B 06 09 20
		 27 00 14 00
		 E3 1E 79 06
		 BC 03 D2 06
		 18 1D 87 FB
		 58 05 C9 FA
		 68 19 93 22
		 E1 45 5A 52
		 6A 00 00 00
		 0D 00 00 00
		 00 00 54 CC
		 41 AA AD CA
		 19 00 00 00
		 07 EB F6 ED
		 39 07 27 E3
		 92 00 4D 0A
		 E4 CC 6D 1A
		 A2 33 CC FF
		 07 10 00 00
		 09 0C 66 46
		 19 00 40 00
		 C1 01 0A FA
		 FF 00 00 00
		 00 00 00 00
		 00 00 00 00
		 00 00 00 00
		 00 00 00 00
		 00 00 00 00
		 00 00 00 00
		 00 00 00 00
		 00 00 00 00
		 00 00 00 00
		 00 00 00 00
		 00 00 00 00
		 00 00 00 00
		 00 00 00 00
		 00 00 00 00
		 00 00 00 00
		 00 00 00 00
		 00 00 00 00
		 00 00 00 00
	];
};
