/* Copyright (c) 2018, The Linux Foundation. All rights reserved.
 *
 * This program is free software; you can redistribute it and/or modify
 * it under the terms of the GNU General Public License version 2 and
 * only version 2 as published by the Free Software Foundation.
 *
 * This program is distributed in the hope that it will be useful,
 * but WITHOUT ANY WARRANTY; without even the implied warranty of
 * MERCHANTABILITY or FITNESS FOR A PARTICULAR PURPOSE.  See the
 * GNU General Public License for more details.
 */

#include "sm8150-floral-common.dtsi"
#include "sm8150-floral-jaws-audio.dtsi"
#include "sm8150-floral-jaws-citadel.dtsi"
#include "sm8150-floral-jaws-haptics.dtsi"
#include "sm8150-floral-jaws-qup.dtsi"
#include "sm8150-floral-jaws-display.dtsi"
#include "sm8150-floral-jaws-touch.dtsi"
#include "sm8150-floral-jaws-battery.dtsi"
#include "sm8150-floral-jaws-camera-sensor.dtsi"
#include "sm8150-floral-jaws-pac193x.dtsi"
