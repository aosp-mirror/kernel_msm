/* Copyright (c) 2017, The Linux Foundation. All rights reserved.
 *
 * This program is free software; you can redistribute it and/or modify
 * it under the terms of the GNU General Public License version 2 and
 * only version 2 as published by the Free Software Foundation.
 *
 * This program is distributed in the hope that it will be useful,
 * but WITHOUT ANY WARRANTY; without even the implied warranty of
 * MERCHANTABILITY or FITNESS FOR A PARTICULAR PURPOSE.  See the
 * GNU General Public License for more details.
 */


/dts-v1/;

#include "../qcom/sdm670.dtsi"
#include "sdm670-s4-common.dtsi"

/* TODO: Add dev board display and touch includes here */
/* TODO: Fix model/compatible/board-id */

/ {
	model = "Qualcomm Technologies, Inc. SDM670 PM660 + PM660L MTP";
	compatible = "qcom,sdm670-mtp", "qcom,sdm670", "qcom,mtp";
	qcom,board-id = <0x00040305 0>;
};

&int_codec {
	qcom,model = "sdm670-s4-snd-card";
};
