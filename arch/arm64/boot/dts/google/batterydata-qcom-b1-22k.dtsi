
qcom,b1-22k {
	qcom, = <24>;
	/* #3353346_Google_B1SwdLsn_2970mAh_averaged_MasterSlave_Feb27th2018*/
	qcom,max-voltage-uv = <4400000>;
	qcom,nom-batt-capacity-mah = <2970>;
	qcom,batt-id-kohm = <22>;
	qcom,battery-beta = <4360>;
	qcom,fg-cc-cv-threshold-mv = <4390>;
	qcom,battery-type = "b1-22k";
	qcom,checksum = <0x74FF>;
	qcom,gui-version = "PMI8998GUI - 2.0.0.58";
	qcom,fg-profile-data = [
		 5E 1F EE 05
		 25 0A 5F FD
		 F0 1C 83 FB
		 42 04 27 0A
		 71 18 49 23
		 00 45 C1 53
		 7A 00 00 00
		 11 00 00 00
		 00 00 15 BD
		 A2 CD 2E C2
		 22 00 08 00
		 FB DB BC E4
		 5D FC 33 FA
		 85 06 C3 0B
		 43 DB 2F 32
		 22 06 09 20
		 27 00 14 00
		 90 1F D9 05
		 38 0A 27 FD
		 C7 1C 09 03
		 E3 15 51 12
		 7F 18 27 2A
		 5B 4D 40 62
		 67 00 00 00
		 0C 00 00 00
		 00 00 0C CC
		 CE CA 6B B4
		 1C 00 00 00
		 47 EA BC E4
		 C6 06 97 F2
		 97 F5 24 03
		 19 FA 56 1A
		 B3 33 CC FF
		 07 10 00 00
		 A1 0B 66 46
		 1C 00 40 00
		 AD 01 0A FA
		 FF 00 00 00
		 00 00 00 00
		 00 00 00 00
		 00 00 00 00
		 00 00 00 00
		 00 00 00 00
		 00 00 00 00
		 00 00 00 00
		 00 00 00 00
		 00 00 00 00
		 00 00 00 00
		 00 00 00 00
		 00 00 00 00
		 00 00 00 00
		 00 00 00 00
		 00 00 00 00
		 00 00 00 00
		 00 00 00 00
		 00 00 00 00
	];
};
