/* Copyright (c) 2017, The Linux Foundation. All rights reserved.
 *
 * This program is free software; you can redistribute it and/or modify
 * it under the terms of the GNU General Public License version 2 and
 * only version 2 as published by the Free Software Foundation.
 *
 * This program is distributed in the hope that it will be useful,
 * but WITHOUT ANY WARRANTY; without even the implied warranty of
 * MERCHANTABILITY or FITNESS FOR A PARTICULAR PURPOSE.  See the
 * GNU General Public License for more details.
 */

#include "sdm845-b1c1-common.dtsi"

#include "sdm845-b1-touch.dtsi"
#include "sdm845-b1c1-audio.dtsi"
#include "sdm845-b1-battery.dtsi"

&dsi_sw43408_cmd_display {
	qcom,dsi-display-active;
};

&p9221 {
	fod = [a8 28 86 34 82 38 9a 12 9c 0b 84 65];
	fod_epp = [a4 2a 86 36 84 3d 9a 14 9d 0b a2 fb];
};

&actuator_rear {
	param-index = <5>;
};
