/* Copyright (c) 2018 Google, Inc.
 *
 * This software is licensed under the terms of the GNU General Public
 * License version 2, as published by the Free Software Foundation, and
 * may be copied, distributed, and modified under those terms.
 *
 * This program is distributed in the hope that it will be useful,
 * but WITHOUT ANY WARRANTY; without even the implied warranty of
 * MERCHANTABILITY or FITNESS FOR A PARTICULAR PURPOSE.  See the
 * GNU General Public License for more details.
 *
 */

/dts-v1/;

#include "sdm845-c1-common.dtsi"
#include "sdm845-c1-proto-panel.dtsi"
#include "sdm845-b1c1-audio-cal.dtsi"
#include "sdm845-patherm.dtsi"
#include "sdm845-b1c1-thermal-v2.dtsi"

/ {
	model = "Google Inc. MSM sdm845 C1 EVT v1.0";
	compatible = "google,b1c1-sdm845", "qcom,sdm845";
	qcom,board-id = <0x00010A05 0>;
};

&p9221 {
	pinctrl-0 = <&p9221_int>;
	interrupts = <124 0>;
	idt,irq_det_gpio = <0>;
	idt,gpio_qien = <0>;
	idt,gpio_slct = <0>;
};

&nq {
	ese {
		loader_scripts_path =
				"/vendor/etc/ese/loaderservice_updater_eng_";
	};
};
