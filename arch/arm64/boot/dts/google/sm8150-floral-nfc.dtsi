/* Copyright (c) 2018, The Linux Foundation. All rights reserved.
 *
 * This program is free software; you can redistribute it and/or modify
 * it under the terms of the GNU General Public License version 2 and
 * only version 2 as published by the Free Software Foundation.
 *
 * This program is distributed in the hope that it will be useful,
 * but WITHOUT ANY WARRANTY; without even the implied warranty of
 * MERCHANTABILITY or FITNESS FOR A PARTICULAR PURPOSE.  See the
 * GNU General Public License for more details.
 */



&qupv3_se9_i2c {
    status = "ok";

    st21nfc@08 {
        compatible = "st,st21nfc";
        reg = <0x08>;
        interrupt-parent = <&tlmm>;
        interrupts = <47  0>;
        st,reset_gpio = <&tlmm 21 0x00>;
        st,irq_gpio = <&tlmm 47 0x00>;
        status = "ok";
    };
};
