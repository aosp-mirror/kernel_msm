
qcom,b1-47k {
	qcom, = <24>;
	/* #3353334_Google_B1DsyAtl_2970mAh_averaged_MasterSlave_Feb27th2018*/
	qcom,max-voltage-uv = <4400000>;
	qcom,nom-batt-capacity-mah = <2970>;
	qcom,batt-id-kohm = <47>;
	qcom,battery-beta = <4360>;
	qcom,fg-cc-cv-threshold-mv = <4390>;
	qcom,battery-type = "b1-47k";
	qcom,checksum = <0x393A>;
	qcom,gui-version = "PMI8998GUI - 2.0.0.58";
	qcom,fg-profile-data = [
		 FD 1F 43 05
		 9C 0A 46 06
		 F9 1C 99 01
		 E6 04 98 03
		 B5 17 D1 23
		 7E 44 33 5A
		 85 00 00 00
		 11 00 00 00
		 00 00 CD C4
		 36 C5 68 C3
		 1E 00 08 00
		 74 DB 1A E4
		 DB FD 8A EB
		 97 FB 82 12
		 8F DA C4 32
		 19 06 09 20
		 27 00 14 00
		 DF 1F 75 05
		 86 0A 91 FC
		 D1 1C D0 02
		 43 0C 03 12
		 91 18 D3 23
		 E8 4D 2E 5B
		 6D 00 00 00
		 0E 00 00 00
		 00 00 F8 07
		 89 BB AD CA
		 19 00 00 00
		 0A EB 1A E4
		 1D 07 01 EB
		 64 EA 23 0A
		 87 FA 79 1A
		 AE 33 CC FF
		 07 10 00 00
		 B6 0B 66 46
		 19 00 40 00
		 B1 01 0A FA
		 FF 00 00 00
		 00 00 00 00
		 00 00 00 00
		 00 00 00 00
		 00 00 00 00
		 00 00 00 00
		 00 00 00 00
		 00 00 00 00
		 00 00 00 00
		 00 00 00 00
		 00 00 00 00
		 00 00 00 00
		 00 00 00 00
		 00 00 00 00
		 00 00 00 00
		 00 00 00 00
		 00 00 00 00
		 00 00 00 00
		 00 00 00 00
	];
};
