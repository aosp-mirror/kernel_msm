/* Copyright (c) 2016, The Linux Foundation. All rights reserved.
 *
 * This program is free software; you can redistribute it and/or modify
 * it under the terms of the GNU General Public License version 2 and
 * only version 2 as published by the Free Software Foundation.
 *
 * This program is distributed in the hope that it will be useful,
 * but WITHOUT ANY WARRANTY; without even the implied warranty of
 * MERCHANTABILITY or FITNESS FOR A PARTICULAR PURPOSE.  See the
 * GNU General Public License for more details.
 */


/dts-v1/;

#include "../qcom/sdm845.dtsi"
#include "sdm845-v1-b1c1-common.dtsi"

/* TODO: Add dev board display and touch includes here */
/* TODO: Fix model/compatible/board-id */

/ {
	model = "Qualcomm Technologies, Inc. MSM sdm845 v1 MTP";
	compatible = "qcom,sdm845-mtp", "qcom,sdm845", "qcom,mtp";
	qcom,board-id = <8 0>;
};
