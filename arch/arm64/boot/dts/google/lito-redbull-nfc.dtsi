// SPDX-License-Identifier: GPL-2.0
/* Copyright (c) 2019, The Linux Foundation. All rights reserved.
 *
 * This program is free software; you can redistribute it and/or modify
 * it under the terms of the GNU General Public License version 2 and
 * only version 2 as published by the Free Software Foundation.
 *
 * This program is distributed in the hope that it will be useful,
 * but WITHOUT ANY WARRANTY; without even the implied warranty of
 * MERCHANTABILITY or FITNESS FOR A PARTICULAR PURPOSE.  See the
 * GNU General Public License for more details.
 */
&qupv3_se7_i2c {
	pinctrl-1 = <&qupv3_se7_i2c_active>;
	status = "ok";
	st21nfc: st21nfc@08 {
		compatible = "st,st21nfc";
		reg = <0x08>;
		interrupt-parent = <&tlmm>;
		interrupts = <34  0>;
		reset-gpios = <&tlmm 12 0x00>;
		irq-gpios = <&tlmm 34 0x00>;
		pidle-gpios = <&tlmm 69 0x00>;
		clkreq-gpios = <&tlmm 58 0x00>;
		st,clk_pinctrl;
		status = "ok";
	};
};
