
qcom,s4-47k {
	qcom, = <24>;
	/* #3816479_Google_S4DesCos_3000mAh_averaged_MasterSlave_Jan8th2019*/
	qcom,max-voltage-uv = <4400000>;
	qcom,fg-cc-cv-threshold-mv = <4390>;
	qcom,nom-batt-capacity-mah = <3000>;
	qcom,batt-id-kohm = <47>;
	qcom,battery-beta = <4360>;
	qcom,battery-type = "s4-47k";
	qcom,checksum = <0x4DA4>;
	qcom,gui-version = "PM660GUI - 0.0.0.45";
	qcom,fg-profile-data = [
		 37 1F F7 05
		 44 0A E9 FC
		 D7 1C FA 01
		 BD 0D A2 0A
		 6E 18 27 23
		 38 45 61 53
		 71 00 00 00
		 11 00 00 00
		 00 00 71 B5
		 F7 CD 69 BA
		 2B 00 08 00
		 17 DB A8 E5
		 D8 05 C5 FA
		 9D FD AC 13
		 01 FD B5 2A
		 22 06 09 20
		 27 00 14 00
		 DC 1F 61 05
		 B5 0A 02 06
		 C8 1C E7 02
		 18 0C 24 12
		 98 18 C6 23
		 EF 4D 22 5B
		 6B 00 00 00
		 0E 00 00 00
		 00 00 C5 D5
		 3A BB 65 CA
		 20 00 00 00
		 26 E3 A8 E5
		 59 FD 11 F3
		 0B FD 79 FA
		 E2 07 2F 22
		 BF 33 CC FF
		 07 10 00 00
		 09 0C 66 46
		 20 00 40 00
		 72 01 0A FA
		 FF 00 00 00
		 00 00 00 00
		 00 00 00 00
		 00 00 00 00
		 00 00 00 00
		 00 00 00 00
		 00 00 00 00
		 00 00 00 00
		 00 00 00 00
		 00 00 00 00
		 00 00 00 00
		 00 00 00 00
		 00 00 00 00
		 00 00 00 00
		 00 00 00 00
		 00 00 00 00
		 00 00 00 00
		 00 00 00 00
		 00 00 00 00
	];
};
