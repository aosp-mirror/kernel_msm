// SPDX-License-Identifier: GPL-2.0
/* Copyright (c) 2019, The Linux Foundation. All rights reserved.
 *
 * This program is free software; you can redistribute it and/or modify
 * it under the terms of the GNU General Public License version 2 and
 * only version 2 as published by the Free Software Foundation.
 *
 * This program is distributed in the hope that it will be useful,
 * but WITHOUT ANY WARRANTY; without even the implied warranty of
 * MERCHANTABILITY or FITNESS FOR A PARTICULAR PURPOSE.  See the
 * GNU General Public License for more details.
 */

#include "lito-bramble.dtsi"
#include "lito-bramble-touch-dev.dtsi"
#include "lito-bramble-camera-sensor.dtsi"

&wcd938x_codec {
	qcom,wcd-rst-gpio-node = <&wcd938x_rst_lpi_gpio>;
};

&sde_dsi {
	qcom,dsi-default-panel = <&dsi_sofef00_sdc_1080p_cmd>;
};
