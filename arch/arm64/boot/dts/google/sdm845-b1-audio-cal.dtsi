&soc {
	msm_cirrus_playback {
		/* the resistance is 7.7296 ohm */
		cirrus,top-speaker-impedance = <10811>;

		/* the percentage of tolerance is 10 */
		cirrus,top-speaker-tolerance = <10>;

		/* the resistance is 6.9567 ohm */
		cirrus,top-speaker-mean = <9730>;

		/* the resistance is 7.0497 ohm */
		cirrus,bottom-speaker-impedance = <9860>;

		/* the percentage of tolerance is 10 */
		cirrus,bottom-speaker-tolerance = <10>;

		/* the resistance is 6.3447 ohm */
		cirrus,bottom-speaker-mean = <8874>;
	};
};