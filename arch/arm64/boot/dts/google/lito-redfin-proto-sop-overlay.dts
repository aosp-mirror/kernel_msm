// SPDX-License-Identifier: GPL-2.0
/*
 * Copyright (c) 2018, The Linux Foundation. All rights reserved.
 */

/dts-v1/;
/plugin/;

#include "lito-redfin-proto.dtsi"

/ {
	model = "Google Inc. MSM sm7250 Redfin PROTO1.0 SOP";
	compatible = "google,redfin-sm7250", "qcom,sm7250";
	qcom,msm-id = <400 0x10000>;
	qcom,board-id = <0x0B0105 0>;
};
