#include "sdm670-b4s4-common.dtsi"
#include "sdm670-s4-touch.dtsi"
#include "sdm670-s4-usb.dtsi"
#include "sdm670-s4-battery.dtsi"
#include "sdm670-s4-thermal.dtsi"
#include "sdm670-s4-haptics.dtsi"

&dsi_s6e3fa7_sdc_1080p_cmd_display {
	qcom,dsi-display-active;
};

&routing {
	qcom,msm-pcm-config = "s4";
};
