
qcom,s4-10k {
	qcom, = <24>;
	/* #3583253_Google_S4NvtAtl_3000mAh_averaged_MasterSlave_Aug8th2018*/
	qcom,max-voltage-uv = <4400000>;
	qcom,fg-cc-cv-threshold-mv = <4390>;
	qcom,nom-batt-capacity-mah = <3000>;
	qcom,batt-id-kohm = <10>;
	qcom,battery-beta = <4360>;
	qcom,battery-type = "s4-10k";
	qcom,checksum = <0x3CD1>;
	qcom,gui-version = "PM660GUI - 0.0.0.45";
	qcom,fg-profile-data = [
		 B6 1E A1 06
		 5A 03 57 F4
		 CE 1C 40 02
		 17 0D 6B 0B
		 F8 17 A9 23
		 91 44 36 5A
		 65 00 00 00
		 10 00 00 00
		 00 00 78 BC
		 5D C5 F2 C2
		 1B 00 08 00
		 A1 DA 7F E4
		 D7 06 95 F2
		 35 FB C7 12
		 F3 F5 56 32
		 1C 06 09 20
		 27 00 14 00
		 A2 1F B4 05
		 62 0A C3 FC
		 C4 1C 0E 03
		 DE 15 5A 12
		 8F 18 EE 23
		 C5 4D 82 5B
		 67 00 00 00
		 0D 00 00 00
		 00 00 40 CC
		 00 8C 03 CB
		 17 00 00 00
		 DA EA 7F E4
		 9B F4 69 EB
		 A0 00 FB 0A
		 AB F2 76 1A
		 AD 33 CC FF
		 07 10 00 00
		 F2 0B 66 46
		 17 00 40 00
		 E4 01 0A FA
		 FF 00 00 00
		 00 00 00 00
		 00 00 00 00
		 00 00 00 00
		 00 00 00 00
		 00 00 00 00
		 00 00 00 00
		 00 00 00 00
		 00 00 00 00
		 00 00 00 00
		 00 00 00 00
		 00 00 00 00
		 00 00 00 00
		 00 00 00 00
		 00 00 00 00
		 00 00 00 00
		 00 00 00 00
		 00 00 00 00
		 00 00 00 00
	];
};
