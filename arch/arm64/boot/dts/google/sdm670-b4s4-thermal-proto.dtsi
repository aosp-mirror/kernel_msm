/* Copyright (c) 2018, The Linux Foundation. All rights reserved.
 *
 * This program is free software; you can redistribute it and/or modify
 * it under the terms of the GNU General Public License version 2 and
 * only version 2 as published by the Free Software Foundation.
 *
 * This program is distributed in the hope that it will be useful,
 * but WITHOUT ANY WARRANTY; without even the implied warranty of
 * MERCHANTABILITY or FITNESS FOR A PARTICULAR PURPOSE.  See the
 * GNU General Public License for more details.
 */

/* Since b4s4 proto device have usbc-therm HW issue
 * (always report extremely high value)
 * To prevent usb overheat mitigation from being triggered permanently,
 * default disable it and change reading channel to key-therm(0x4e).
 */

&thermal_zones {
	usbc-therm-monitor {
		thermal-sensors = <&pm660_adc_tm 0x4e>;
		disable-thermal-zone;
	};
};
