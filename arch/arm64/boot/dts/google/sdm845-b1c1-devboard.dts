/* Copyright (c) 2016, The Linux Foundation. All rights reserved.
 *
 * This program is free software; you can redistribute it and/or modify
 * it under the terms of the GNU General Public License version 2 and
 * only version 2 as published by the Free Software Foundation.
 *
 * This program is distributed in the hope that it will be useful,
 * but WITHOUT ANY WARRANTY; without even the implied warranty of
 * MERCHANTABILITY or FITNESS FOR A PARTICULAR PURPOSE.  See the
 * GNU General Public License for more details.
 */


/dts-v1/;

#include "../qcom/sdm845.dtsi"
#include "sdm845-b1c1-devboard-common.dtsi"

/ {
	model = "Google Inc. MSM sdm845 Dev Board";
	compatible = "google,b1c1-sdm845", "qcom,sdm845";
	qcom,board-id = <0x00010205 0>;
};

#include "sdm845-b1c1-haptics-drv2624-overlay.dtsi"
