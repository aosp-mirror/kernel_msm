// SPDX-License-Identifier: GPL-2.0
/*
 * Copyright (c) 2019, The Linux Foundation. All rights reserved.
 */

/dts-v1/;
/plugin/;

#include "lito-v2-bramble-proto1_2.dtsi"

/ {
	model = "Google Inc. MSM sm7250 v2 Bramble PROTO 1.2";
	compatible = "google,bramble-sm7250", "qcom,sm7250";
	qcom,msm-id = <400 0x20000>, <440 0x20000>;
	qcom,board-id = <0x0a0505 0>;
};
