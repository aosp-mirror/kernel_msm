## Documentation/devicetree/bindings/sound/goog-audio-dev.txt
```
Google audio devices for ALSA sound SoC

Polaris Machine Driver
-----------------------
Devices are based on Qualcomm audio and share most properties with those.
See "MSMCOBALT ASoC Machine driver" in qcom-audio-dev.txt.

Additional or modified required properties:
- compatible : "goog,polaris-snd"
- qcom,model : "goog-polaris-snd-card"

Additional optional properties:
- goog,us-euro-supply : Regulator that supplies voltage to the OMTP/CTIA switch.

Example:

	sound-9335 {
		compatible = "goog,polaris-snd";
		qcom,model = "goog-polaris-snd-card";

		qcom,audio-routing =
			"AIF4 VI", "MCLK",
			"RX_BIAS", "MCLK",
			"MADINPUT", "MCLK",
			"AMIC2", "MIC BIAS2",
			"MIC BIAS2", "Headset Mic",
			"AMIC5", "MIC BIAS3",
			"AMIC6", "MIC BIAS3",
			"MIC BIAS3", "Loopback Input",
			"DMIC0", "MIC BIAS1",
			"MIC BIAS1", "Digital Mic0",
			"DMIC1", "MIC BIAS1",
			"MIC BIAS1", "Digital Mic1",
			"DMIC2", "MIC BIAS4",
			"MIC BIAS4", "Digital Mic2",
			"DMIC3", "MIC BIAS4",
			"MIC BIAS4", "Digital Mic3",
			"DMIC4", "MIC BIAS4",
			"MIC BIAS4", "Digital Mic4",
			"DMIC5", "MIC BIAS4",
			"MIC BIAS4", "Digital Mic5",
			"Loopback Output", "LINEOUT1",
			"Loopback Output", "LINEOUT2",
			"SpkrLeft IN", "SPK1 OUT",
			"SpkrRight IN", "SPK2 OUT";

		qcom,msm-mbhc-hphl-swh = <1>;
		qcom,msm-mbhc-gnd-swh = <1>;
		goog,us-euro-supply = <&pmcobalt_l28>;
		qcom,tasha-mclk-clk-freq = <9600000>;
		asoc-platform = <&pcm0>, <&pcm1>, <&pcm2>, <&voip>, <&voice>,
				<&loopback>, <&compress>, <&hostless>,
				<&afe>, <&lsm>, <&routing>, <&cpe>, <&compr>;
		asoc-platform-names = "msm-pcm-dsp.0", "msm-pcm-dsp.1",
				"msm-pcm-dsp.2", "msm-voip-dsp",
				"msm-pcm-voice", "msm-pcm-loopback",
				"msm-compress-dsp", "msm-pcm-hostless",
				"msm-pcm-afe", "msm-lsm-client",
				"msm-pcm-routing", "msm-cpe-lsm",
				"msm-compr-dsp";
		asoc-cpu = <&dai_hdmi>,
				<&sb_0_rx>, <&sb_0_tx>, <&sb_1_rx>, <&sb_1_tx>,
				<&sb_2_rx>, <&sb_2_tx>, <&sb_3_rx>, <&sb_3_tx>,
				<&sb_4_rx>, <&sb_4_tx>, <&sb_5_tx>,
				<&afe_pcm_rx>, <&afe_pcm_tx>, <&afe_proxy_rx>,
				<&afe_proxy_tx>, <&incall_record_rx>,
				<&incall_record_tx>, <&incall_music_rx>,
				<&incall_music_2_rx>, <&sb_5_rx>;
		asoc-cpu-names = "msm-dai-q6-hdmi.8",
				"msm-dai-q6-dev.16384", "msm-dai-q6-dev.16385",
				"msm-dai-q6-dev.16386", "msm-dai-q6-dev.16387",
				"msm-dai-q6-dev.16388", "msm-dai-q6-dev.16389",
				"msm-dai-q6-dev.16390", "msm-dai-q6-dev.16391",
				"msm-dai-q6-dev.16392", "msm-dai-q6-dev.16393",
				"msm-dai-q6-dev.16395", "msm-dai-q6-dev.224",
				"msm-dai-q6-dev.225", "msm-dai-q6-dev.241",
				"msm-dai-q6-dev.240", "msm-dai-q6-dev.32771",
				"msm-dai-q6-dev.32772", "msm-dai-q6-dev.32773",
				"msm-dai-q6-dev.32770", "msm-dai-q6-dev.16394";
		asoc-codec = <&stub_codec>;
		asoc-codec-names = "msm-stub-codec.1";
		qcom,wsa-max-devs = <2>;
		qcom,wsa-devs = <&wsa881x_211>, <&wsa881x_212>,
				<&wsa881x_213>, <&wsa881x_214>;
		qcom,wsa-aux-dev-prefix = "SpkrRight", "SpkrLeft",
					  "SpkrRight", "SpkrLeft";
	};
```

## Documentation/devicetree/bindings/sound/max98927.txt
```
max98927 audio CODEC

This device supports I2C.

Required properties:

  - compatible : "maxim,max98927"

  - maxim,vmon-slot-no : slot number used to send voltage information
                   or in inteleave mode this will be used as
                   interleave slot.
                   This property can be set to values from 0 to 15 for slot 0 to 15.
                   Default value is 0.

  - maxim,imon-slot-no : slot number used to send current information
                   This property can be set to values from 0 to 15 for slot 0 to 15.
                   Default value is 0.

  - maxim,interleave-mode : When using two MAX98927 in a system it is
                   possible to create ADC data that that will
                   overflow the frame size. Digital Audio Interleave
                   mode provides a means to output VMON and IMON data
                   from two devices on a single DOUT line when running
                   smaller frames sizes such as 32 BCLKS per LRCLK or
                   48 BCLKS per LRCLK.
                   This property can be set to values from 0 to 1 for off and on.
                   Default value is 0.

  - reg : the I2C address of the device for I2C

Example:

codec: max98927@3a {
   compatible = "maxim,max98927";
   maxim,vmon-slot-no = <0>;
   maxim,imon-slot-no = <1>;
   maxim,interleave-mode = <0>;
   reg = <0x3a>;
};
```

## Documentation/devicetree/bindings/sound/nxp_tfa.txt
```
TFA I2C audio CODEC

Required properties:

 - compatible : "nxp,tfa98xx" or "nxp,tfa9890" or "nxp,tfa9888"
		or "nxp,tfa9891" for NXP TFA98xx

 - reg : slave address
 - reset-gpio : GPIO output high active
 - upper-spk : Define for upper speaker

Example:

i2c@c1b5000 {
	nxp_tfa98xx_amp@34 {
		compatible = "nxp,tfa98xx";
		reg = <0x34>;
		reset-gpio = <&pmcobalt_gpios 6 0x1>;
		upper-spk;
	};
	nxp_tfa98xx_amp@35 {
		compatible = "nxp,tfa98xx";
		reg = <0x35>;
		reset-gpio = <&pmcobalt_gpios 7 0x1>;
	};
};
```
