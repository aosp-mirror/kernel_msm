## Documentation/devicetree/bindings/nfc/ese/pn81a.txt
```
* NXP PN81A Embedded Secure Element

PN81A is part of an NXP NFC controller and depends on
access to eSE power via the controller.

Required properties:
- compatible: Should be "nxp,pn81a"
- reg: SPI chip select.
- spi-max-frequency: SPI maximum speed.
- nxp,nfcc: Name of the i2c device where an nq-nci device is mapped.
- nxp,clear-n: Optional GPIO for clearing a inbound application GPIO.

Examples:

&spi_bus {
	pn81a@0 {
		compatible = "nxp,pn81a";
		reg = <0>
		spi-max-frequency = <8000000>;
		nxp,nfcc = "8-0028";
		nxp,clear-n = <&tlmm 29 0x00>;
	};
};
```

## Documentation/devicetree/bindings/paj9124u1/paj9124u1.txt
```
PixArt Optical Track Sensor PAJ9124U1

Required properties:
- compatible: should be 'paj9124u1'

Example:

&spi_0  {
		pinctrl-names = "spi_default", "spi_sleep";
		pinctrl-0 = <&spi0_default>;
		pinctrl-1 = <&spi0_sleep>;
		paj9124u1: paj9124u1@0 {
			compatible = "paj9124u1";
			reg = <0>;
			interrupt-parent = <&msm_gpio>;
			interrupts = <95 0x00>;
			spi-max-frequency = <2000000>;
			pixart,vld-supply = <&haptic_ext_vreg>;
			pixart,vdd-supply = <&pm8916_l16>;
			pinctrl-names = "default";
			pinctrl-0 = <&paj9124u1_motion_gpio>;
		};
};
```

## Documentation/devicetree/bindings/power/fan5451x.txt
```
Fairchild Switch mode Charger

The charger module supports the switch battery charger peripherals on
Fairchild Semiconductor.

This node should be included into I2C parent node.
The node required properties:

- compatible: Must be "fcs,fan5451x".
- reg:        Specifies the I2C address.
- interrupts: Specifies the interrupt GPIO with the peripheral.
- interrupt-names: Specifies the interrupt names for the peripheral.

- qcom,chg-vadc: Specifies PMIC's vadc dev reference.
- stat-gpio:     Specifies /STAT GPIO output pin that open-drain output indicating charge status.
- disable-gpio:  Specifies DIS GPIO input pin that turned off creating a high Z condition
                 if this pin is held HIGH.

- vbatmin: Specifies CC start voltage.
- vfloat:  Specifies Battery maximum charge voltage.
- ibus:    Specifies vbus maximum current draw.
- iochrg:  Specifies Battery charge current.
- iterm:   Specifies charge termination current in condition CV charge state.
- prechg:  Specifies trickle charge current.
- topoff-enable: Specifies post charging configuration that
                 is able to charge battery after happening charge termination.
- vbusovp: Specifies over voltage protection for vbus input.
- vbuslim: Specifies under voltage protection for vbus input.
- vinovp: Specifies over voltage protection for vin input.
- vinlim: Specifies under voltage protection for vin input.
- fctmr:  Specifies fast charge time timer configuration.

Example:
	fan5451x_chg: fan5451x@6b {
		status = "ok";
		compatible = "fcs,fan5451x";
		reg = <0x6b>;
		interrupt-parent = <&msm_gpio>;
		interrupts = <92 0>;

		qcom,chg-vadc = <&pm8916_vadc>;
		stat-gpio = <&msm_gpio 16 0x00>;
		disable-gpio = <&msm_gpio 83 0x00>;

		vbatmin = <3000>;    //CC start voltage 3.0V
		vfloat = <4400>;     //vbatmax
		ibus = <500>;        //iusb for vbus
		iochrg = <400>;      //CC current
		iterm = <50>;        //term current
		prechg = <200>;      //pre charge current
		topoff-enable = <0>; //post charging flag
		vbusovp = <10500>;   //ovd for usb
		vbuslim = <4560>;    //uvd for usb
		vinovp = <10500>;    //ovd for wireless
		vinlim = <4560>;     //uvd for wireless
		fctmr = <0>;         //fast charge timer off
	};
```

## Documentation/devicetree/bindings/power/reset/msm-poweroff.txt
```
MSM Restart Driver

A power supply hold (ps-hold) bit is set to power the msm chipsets.
Clearing that bit allows us to restart/poweroff. The difference
between poweroff and restart is determined by unique power manager IC
settings.

Required Properties:
-compatible: "qcom,pshold"
-reg: Specifies the physical address of the ps-hold register

Optional Properties:
-qcom,force-warm-reboot-on-thermal-shutdown: Issue a warm reboot on
				"shutdown,thermal" restart reason.

Example:

	restart@fc4ab000 {
		compatible = "qcom,pshold";
		reg = <0xfc4ab000 0x4>;
	};
```

## Documentation/devicetree/bindings/power/supply/google_charger.txt
```
google_charger
~~~~~~~~~~~~~~

Required properties:
 - compatible : "google,charger"
 - google,chg-power-supply: name of the charge control power supply
 - google,bat-power-supply: name of the Fuel Gauge power supply
 - google,chg-update-interval: delay in ms to wait before re-running the work
     item
 - google,chg-battery-capacity: the nominal capacity used to compute the
     effective 1C charge rate
 - google,chg-temp-limits: the temperature buckets limits defining the indexes
     of the constant charge limits (row index in google,chg-cc-limits)
 - google,chg-cv-limits: steps voltage limits (column index in
     google,chg-cc-limits)
 - google,chg-cc-limits: the array of constant current charge rates given in %
     of google,chg-battery-capacity

Optional properties:
 - google,wlc-power-supply: name of wireless charing input power supply
 - google,cv-hw-resolution: the constant voltage setting resolution in micro
     volt defaults to 25000
 - google,cc-hw-resolution: the constant current setting resolution in micro amp
     defaults to 25000
 - google,cv-range-accuracy: the voltage margin in micro volt used at taper to
     determine whether battery voltage should be raised in an attempt to match
     tier voltage for ir drop compensation. Defaults to cv-hw-resolution / 2.
 - google,cv-debounce-cnt: the number of cv-update-interval to wait after
     entering taper or after raising charging voltage for ir drop compensation
     before a new attempt. Defaults to 3 (eg 6 seconds for default
     cv-update-interval).
 - google,cv-update-interval: delay in ms to wait before re-running the work
     item while in taper. Defaults to 2000 (2 seconds)
 - google,cv-tier-ov-delay: the number of cv-update-interval to wait after
     battery voltage has raised above tier limit during ir drop compensation
     before a new attempt to raise voltage. Defaults to 10 (eg 20 seconds for
     default cv-update-interval).
 - google,chg-tolerance: the deci-percent tolerance we need to give the PMIC to
     ensure actual current is below chg-cc-limits (divide by 10 to get
     percentage points). Max allowed tolerance is 25%.
```

## Documentation/devicetree/bindings/power/supply/max1720x_battery.txt
```
MAX17201/MAX17205 Fuel Gauge
----------------------------

Required properties :
 - compatible : "maxim,max1720x"

Optional properties :
 - maxim,fg-config: array of bytes to be uploaded to the shadow RAM to either
   use this config or burn it to the non volatile area.
 - maxim,force-load-config: load the maxim,fg-config data into shadow RAM and
   run the fuel gauge using this config instead of the one from the NV RAM.
 - maxim,force-flash-config: program the loaded config (maxim,fg-config) into
   the non volatile if the this flag is set AND nVEmpty are not matching. Number
   NV block writes are limited to 7 so use with care.
 - maxim,psy-type-unknown: if set, forces poser supply type to be
   POWER_SUPPLY_TYPE_UNKNOWN rather than POWER_SUPPLY_TYPE_BATTERY
 - maxim,empty-voltage: Sets the voltage level for detecting empty. The unit is
   millivolt.
 - maxim,recovery-voltage: Sets the voltage level for clearing empty detection.
   Once the cell voltage rises above this point, empty voltage detection is
   reenabled.
 - maxim,battery-qrtables: initial learning parameters that should be specified
   when a new maxim,empty-voltage is specified.
 - maxim,maxim,valrtth-vmax: An alert is generated if the VCell register reading
   exceeds this value. The unit is millivolt.
 - maxim,maxim,valrtth-vmin: An alert is generated if the VCell register reading
   falls below this value. The unit is millivolt.
```

## Documentation/devicetree/bindings/power/supply/overheat_mitigation.txt
```
google,overheat_mitigation
~~~~~~~~~~~~~~

Required properties:
 - compatible : "google,overheat_mitigation"
 - google,begin-mitigation-temp: USB port temperature threshold in decidegrees
     Celsius at which to begin overheat mitigation
 - google,end-mitigation-temp: USB port temperature threshold in decidegrees
     Celsius at which to end overheat mitigation
 - google,port-overheat-work-interval: period in milliseconds at which the
     driver should monitor the overheat status
 - google,accessory-monitoring-period: time in seconds that the driver should
     monitor usb accessories after they are first connected
 - google,polling-freq: period in port-overheat-work-interval that the driver
     should poll the USB connection status to maintain the desired duty cycle
```

## Documentation/devicetree/bindings/power/usb_temp.txt
```
To proetect the usb hardware by usb temperature

The hardware must be have a thermistor to monitor the temperature of usb side.
We can to enable/disable charging by HW with this temperature.

- qcom,open_mosfet_temp:		If the diff of (Tusb - Tbatt) is bigger
					than this value, it would be to disable
					charging.
- qcom,close_mosfet_temp:		If the diff of (Tusb - Tbatt) is less
					than this value, it would be to enable
					charging again.
- qcom,interval_switch_temp:	If the diff of (Tusb - Tbatt) is bigger
					than this value, it would be to set the
					the montor to fast check mode.

Example:
	usb_temp {
		compatible = "qcom,usb_temp_protect";
		pinctrl-names = "default";
		pinctrl-0 = <&usb_temp_default>;
		qcom,gpio_usb_temp_protect = <&msm_gpio 131 0x00>;
		qcom,open_mosfet_temp = <15>;
		qcom,close_mosfet_temp = <10>;
		qcom,interval_switch_temp = <7>;
		vdd-supply = <&pm8950_l16>;
		qcom,usb_temp-vadc = <&pm8950_vadc>;
		status = "okay";
	};
```

## Documentation/devicetree/bindings/power_supply/stc3117_battery.txt
```
/* STMicroelectronics stc3117 battery gauge */

Required properties:
       - compatible : should be: "st,stc3117"
               - Magnetometer:  "st,lsm303agr-magn"
       - reg : the I2C address the device 0x70

       Electrical parameters:
       - st,nbc-mAh :
               nominal battery capacity [mAh];
       - st,nbii-microohm:
               nominal battery internal impedance [mOhms];
       - st,ncc-cnf:
               nominal CC_cnf;
       - st,nvm-cnf:
               nominal VM cnf;
       - st,rsns-microhom:
               sense resistor [mOhms];
Example:

stc3117@70 {
       pinctrl-names = "default";
       compatible = "st,stc3117";
       reg = <0x70>;
       status = "ok";
       st,nbc-mAh = <1500>;
       st,nbii-microohm = <200>;
       st,ncc-cnf = <303>;
       st,nvm-cnf = <307>;
       st,rsns-microhom = <10>;
};
```

## Documentation/devicetree/bindings/regulator/rt9055.txt
```
Richtek RT9055 Dual LDO regulator

Required properties:
- compatible: "richtek,rt9055"
- regulators: A node that houses two sub-nodes for output 1 and output 2 of
  RT9055. Each sub-node is identified using the node's name with available
  voltage versions. The content of each sub-node is defined by the standard
  binding for regulators, and an additional GPIO enable pin.

Optional properties:
- none

Example
	rt9055 {
		compatible = "richtek,rt9055";
		pinctrl-names = "default", "sleep";
		pinctrl-0 = <&rt9055_en_active>;
		pinctrl-1 = <&rt9055_en_suspend>;

		regulators {
			rt9055_gg_vout1: rt9055_gg_vout1 {
				regulator-name = "pp1800_tp";
				regulator-min-microvolt = <1800000>;
				regulator-max-microvolt = <1800000>;
				richtek,en-gpio = <&tlmm 51 0>;
			};

			rt9055_gg_vout2: rt9055_gg_vout2 {
				regulator-name = "pp1800_panel";
				regulator-min-microvolt = <1800000>;
				regulator-max-microvolt = <1800000>;
				richtek,en-gpio = <&tlmm 50 0>;
			};
		};
	};
```

## Documentation/devicetree/bindings/rsb/rsb.txt
```
LGE RSB rotating side button

Required properties:
- compatible: should be 'rsb'

Example:

&spi_3 {
	rsb@0 {
		compatible = "rsb";
		reg = <0>;
		spi-max-frequency = <2000000>;

		rsb,spi-cs-gpio = <&msm_gpio 2 0x00>;

		pinctrl-names = "default";
		pinctrl-0 = <&rsb_ctrl_active>;
	};
};
```

## Documentation/devicetree/bindings/soc/htc/htc_radio_smem.txt
```
htc_radio_smem (HTC Radio Shared Memory) Driver

The htc_radio_smem driver is used to notify with modem subsystem about
hardware and software information via SMD channel.

Required properties:

- compatible: name of the component used for driver matching, should be
              "htc,htc_radio_smem"

Example:
    htc_radio_smem {
	compatible = "htc,htc_radio_smem";
    };
```

## Documentation/devicetree/bindings/soc/htc/rtel-uio.txt
```
htc rtel (HTC modem runtime embedded logging) driver

The htc rtel-uio driver is used to allocate memory for saving
modem runtime embedded log

Required properties:

- compatible: name of the component used for driver matching, should be
              "htc,rtel-uio"

Example:
        htc,rtel_sharedmem@0 {
                compatible = "htc,rtel-uio";
                reg = <0xa1800000 0x02000000>;
                memory-region = <&htc_rtel_mem>;
        };
```
