## Documentation/devicetree/bindings/arm/google-b1c1.txt
```
Google Platforms Device Tree Bindings
---------------------------------------

Google boards

Required root node properties:
- compatible: it should be "google,b1c1-sdm845";
- qcom,board-id: qcom board-id as described in [1]. The following rules are used
  for Google boards:
	- Platform Type ID: must use 0x05 (which is OEM code reserved by QCOM)
	- Major ID: global Google-wide major for the product
	- Minor ID: product-specific Minor as HW version (EVT, DVT etc)
	- Subtype: product-specific Subtype as HW modification

Example:
	compatible = "google,b1c1-sdm845", "qcom,sdm845";
	qcom,board-id = <0x00010205 0>;


[1] Documentation/devicetree/bindings/arm/msm/board-id.txt
```

## Documentation/devicetree/bindings/arm/msm/clk-q6-mi2s-mclk.txt
```
Hexagon AFE MI2S MCLK Driver

This driver provides a standard clock driver interface for use in I2S devices
that are connected to the MSM LPASS.

Required properties:
- compatible:		Must be "qcom,q6-mi2s-mclk".
- #clock-cells:		Must be <1>.

Example:
	&soc {
		mi2s_mclk: mi2s_mclk {
			compatible = "qcom,q6-mi2s-mclk";
			#clock-cells = <1>;
		};
	};

I2S devices refer to the clock as follows:

	headset: name {
		...
		clocks = <&mi2s_mclk clk_sec_mi2s_mclk>;
		clock-names = "mclk";
		...
	};

Where 'clk_sec_mi2s_mclk' specifies the MCLK for the secondary I2S bus.
See include/dt-bindings/clock/audio-ext-clk.h for a list of supported
I2S interfaces.
```

## Documentation/devicetree/bindings/cs40l2x.txt
```
CS40L20 Boosted Haptics Driver

Required properties:

  - compatible : One of "cirrus,cs40l20", "cirrus,cs40l25", "cirrus,cs40l25a"
    or "cirrus,cs40l25b".

  - reg : The I2C slave address of the device.

  - VA-supply, VP-supply : Regulators for the device's VA and VP supplies,
    respectively. See the following:
    Documentation/devicetree/bindings/regulator/regulator.txt

  - cirrus,boost-ind-nanohenry : Boost inductor value, expressed in nH. Valid
    values include 1000, 1200, 1500 and 2200.

  - cirrus,boost-cap-microfarad : Total equivalent boost capacitance on the VBST
    and VAMP pins, derated at 11 volts DC. The value must be rounded to the
    nearest integer and expressed in uF.

  - cirrus,boost-ipk-milliamp : Boost inductor peak current, expressed in mA.
    Valid values range from 1600 to 4500 (inclusive) in steps of 50.

Optional properties:

  - reset-gpios : GPIO used for resetting the device.

  - cirrus,refclk-gpio2 : Boolean for configuring the device to expect its
    32.768-kHz reference clock on the REFCLK/GPIO2 pin. If this property is
    omitted, the device expects its 32.768-kHz reference clock on the
    ASP_BCLK/REFCLK pin. This property is ignored for CS40L25A and CS40L25B
    devices as reference clock selection is configured automatically.

  - cirrus,f0-default : Default LRA resonant frequency (f0), expressed as
    follows: cirrus,f0-default = f0 (Hz) * 2^14. This value represents the
    frequency used during playback of PWLE segments specified with frequency
    equal to f0; it also serves as the unit-specific f0 input to the click
    compensation algorithm. It can be overwritten at a later time by writing
    to the f0_stored sysfs control.

    If this value is omitted or specified as zero, the measurement recorded in
    the f0_measured sysfs control is used. If LRA diagnostics has not been
    administered and f0_measured is uninitialized, 2621440 (160 Hz) is used.

  - cirrus,f0-min : Minimum LRA resonant frequency (f0) that may be written to
    the f0_stored sysfs control, expressed using the same numerical format as
    cirrus,f0-default. If this value is omitted or specified as zero, no lower-
    bound validation is performed.

  - cirrus,f0-max : Maximum LRA resonant frequency (f0) that may be written to
    the f0_stored sysfs control, expressed using the same numerical format as
    cirrus,f0-default. If this value is omitted or specified as zero, no upper-
    bound validation is performed.

  - cirrus,redc-default : Default LRA series resistance (ReDC), expressed as
    follows: cirrus,redc-default = ReDC (ohms) / 5.857 * 2^17. This value
    represents the unit-specific ReDC input to the click compensation algorithm.
    It can be overwritten at a later time by writing to the redc_stored sysfs
    control.

    If this value is omitted or specified as zero, the measurement recorded in
    the redc_measured sysfs control is used. If LRA diagnostics has not been
    administered and redc_measured is uninitialized, 340787 (15.2 ohms) is used.

  - cirrus,redc-min : Minimum LRA series resistance (ReDC) that may be written
    to the redc_stored sysfs control, expressed using the same numerical format
    as cirrus,redc-default. If this value is omitted or specified as zero, no
    lower-bound validation is performed.

  - cirrus,redc-max : Maximum LRA series resistance (ReDC) that may be written
    to the redc_stored sysfs control, expressed using the same numerical format
    as cirrus,redc-default. If this value is omitted or specified as zero, no
    upper-bound validation is performed.

Example:

  cs40l20: cs40l20@43 {
    compatible = "cirrus,cs40l20";
    reg = <0x43>;
    reset-gpios = <&gpio0 54 0>;
    VA-supply = <&dummy_vreg>;
    VP-supply = <&dummy_vreg>;
    cirrus,boost-ind-nanohenry = <1000>;
    cirrus,boost-cap-microfarad = <4>;
    cirrus,boost-ipk-milliamp = <4500>;
    cirrus,refclk-gpio2;
  };
```

## Documentation/devicetree/bindings/drm/msm/google-bl.txt
```
Google binned low power mode panel

This is an extension of QTI's mdss-dsi-panel to handle additional command
sequences for low power modes.

Required properties:
- compatible:           "google,dsi_binned_lp"


==============================================================

Google low power display modes

Required properties:
- compatible:		"google,lp-modes"
- label:			Name of the entry
- dsi-lp-brightness-threshold:
			Max brightness supported by the mode
- dsi-lp-command:	Command sequence to enter this mode
- dsi-lp-command-state:	Command state used in this mode

Example:

/ {
	...
	google,lp-modes {
		lp-mode@0 {
			label = "off";
			google,dsi-lp-brightness-threshold = <0>;
			google,dsi-lp-command = [
				05 01 00 00 00 00 01 22
			];
			google,dsi-lp-command-state = "dsi_lp_mode";
		};

		lp-mode@1 {
			label = "high";
			google,dsi-lp-brightness-threshold = <255>;
			google,dsi-lp-command = [
				39 01 00 00 00 00 03 51 01 FF
				05 01 00 00 00 00 01 12
			];
			google,dsi-lp-command-state = "dsi_lp_mode";
		};
};
```

## Documentation/devicetree/bindings/hwmon/max31760.txt
```
MAX31760 fan controller
-----------------------

This device supports I2C only. Fan sub-nodes must be defined in order to enable
the fan tachometer input. See also the datasheet:
https://datasheets.maximintegrated.com/en/ds/MAX31760.pdf

Required node properties:
 - compatible: "maxim,max31760"
 - reg: The I2C address of the device. This is 0x50 - 0x57 depending on the
   hardware configuration.
 - #address-cells: Must be 1.
 - #size-cells: Must be 0.

Optional node properties:
 - maxim,fan-fail-full-only: Boolean; Fan failure can be asserted if and only if
   the PWM is set at 100%.
 - maxim,fan-rd-signal: Boolean; Fans provide a rotation detection (RD) signal
   instead of generating square-wave pulses.
 - maxim,fan-rd-polarity-high: Boolean; If true, RD is high when the fan is
   running; otherwise, it is low. Only relevant when fan-rd-signal is true.
 - maxim,fan-signal-enabled: Boolean; Externally driving FF/FS low forces PWM
   output to 100%.
 - maxim,fan-spin-up-enabled: Boolean; On fan startup set the PWM to 100% until
   tach is detected or two seconds have passed before reducing to the target
   value.
 - maxim,pwm-polarity-negative: Boolean; If trye, 100% PWM is when PWM is low,
   not high.
 - maxim,pwm-pulse-stretch-enabled: Boolean; Enable PWM pulse stretching.
 - maxim,pwm-zero-fan-can-fail: Boolean; Enable fan failure detection while
   ramping to 0% PWM.

Fan sub-nodes must be present in order to enable the fan.

Required fan sub-node properties:
 - reg: Fan address. Must be <0x00> or <0x01>.

Optional fan sub-node properties:
 - label: String; Assigned to the hwmon fanX_label property.

Temperature sub-nodes are optional.

Required temp sub-node properties:
 - reg: Temperature sensor address. Must be <0x00> or <0x01>.

Optional temp sub-node properties:
 - label: String; Assigned to the hwmon tempX_label property.
 - ideality: For temperature node with reg 1 only: Set ideality factor for the
   remote temperature sensor. Integer with range 0 to 63, representing a
   multiplication factor of 0.9844 to 1.0489. Default: 24 (1.0080).

Example:
	max31760@50 {
		compatible = "maxim,max31760";
		reg = <0x50>;
		#address-cells = <1>;
		#size-cells = <0>;

		maxim,fan-spin-up-enabled;

		fan@0 {
			reg = <0x00>;
			label = "Left";
		};
		fan@1 {
			reg = <0x01>;
			label = "Right";
		};
		temp@1 {
			reg = <0x01>;
			label = "CPU";
		};
	};
```

## Documentation/devicetree/bindings/hwmon/tmp108.txt
```
TMP108 temperature sensor
-------------------------

This device supports I2C only.

Required node properties:
- compatible : "ti,tmp108"
- reg : the I2C address of the device. This is 0x48, 0x49, 0x4a, or 0x4b.

Optional node properties:
- label : String; Assigned to the hwmon temp1_label property.

Example:
	tmp108@48 {
		compatible = "ti,tmp108";
		reg = <0x48>;
		label = "Right Side";
	};
```

## Documentation/devicetree/bindings/input/ti,drv2624.txt
```
* Texas Instruments - drv2624 Haptics driver

Required properties:
	- compatible - "ti,drv2624" - DRV2624
	- reg -  I2C slave address
	- ti,reset-gpio - GPIO to reset the device

Optional properties:
	- ti,irq-gpio - GPIO to receive the interrupt
	- ti,voltage-comp - Voltage compensation for any resistive losses in the
	  driver IC.
	- ti,ol-lra-frequency - LRA frequency for open-loop mode
	- ti,bemf-factor - Sets the feedback gain for closed-loop operation
	- ti,bemf-gain - Sets the analog gain of the back-EMF amplifier
	- ti,blanking-time - Time waiting for BEMF to settle. Before ADC
	  sampling
	- ti,idiss-time - Sime waiting for inductor current to discharge
	- ti,zc-det-time - Zero crossing detection time
	- ti,lra-wave-shape - Selects which shape to use for driving the LRA
	  when in open loop mode. 0 - Square Wave, 1 - Sine Wave.
	- ti,waveform-interval - Sets the internal memory playback interval to
	  either 5 ms or 1 ms. 0 - 5 ms, 1 - 1 ms.

Example:

drv2624: drv2624@5a {
	compatible = "ti,drv2624";
	reg = <0x5a>;
	ti,reset-gpio = <&tlmm 95 0>;
};

For more product information please see the link below:
http://www.ti.com/product/drv2624
```

## Documentation/devicetree/bindings/input/touchscreen/ftm4_ts.txt
```
FTS Capacitive touch screen controller (FingerTipS)
----------------

Required properties:
- compatible: "stm,ftm4_fts"
- stm,irq_gpio: Interrupt GPIO
- stm,irq_type: Type of IRQ (edge/level and high/low)
- stm,num_lines: Number of RX(SenseChannelLength), TX(ForceChannelLength)
- stm,max_coords: Maximum X/Y values reported to the client
- stm,regulator_dvdd: 1.8V digital supply
- stm,regulator_avdd: 3.3V analog supply
- stm,firmware_name: Firmware file to load

Optional properties:
- stm,switch_gpio: Used to control external I2C switch

Node should be a child node to a relevant I2C bus.

Example:
&qupv3_se2_i2c {
	ftm4_fts@49 {
		status = "ok";
		compatible = "stm,ftm4_fts";
		reg = <0x49>;

		pinctrl-names = "on_state", "off_state";
		pinctrl-0 = <&ts_active>;
		pinctrl-1 = <&ts_suspend>;

		stm,switch_gpio= <&tlmm 128 0>;
		stm,irq_gpio = <&tlmm 125 0>;
		stm,irq_type = <0x2004>; /* Trigger high */
		stm,num_lines = <32 16>;
		stm,max_coords = <1440 2880>;
		stm,regulator_dvdd = "pm8998_l14";
		stm,regulator_avdd = "pm8998_l19";

		stm,firmware_name = "ftm4_fw.ftb";
	};
};
```
