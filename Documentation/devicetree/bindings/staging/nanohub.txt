## drivers/htc_debug/stability/Kconfig
```kconfig
#
# HTC_DEBUG stability Kconfig
#
config HTC_REBOOT_BLOCK
	bool "Store reboot reason / msg ...etc. in IMEM or storage"
	default n
	help
	  Say Y here if you want the HTC Reboot Block features

config HTC_DEBUG_RESTART_TIMER
	bool "add a timer in restart notifier chain"
	default y
	depends on HTC_DEBUG

config HTC_NC_GPIO_PIN_SETTING
	bool "HTC style nc pin setting features"
	default n
	depends on PINCTRL
	help
	  Say Y here if you want the HTC style nc pin setting features

config PRINTK_CPU_ID
	depends on PRINTK
	default y
	bool "Enable support for Print working core no. in dmesg" if EXPERT
	help
	  Print working CPU number in the dmesg as default, it can be turned
	  off by writing 0 to module parameter cpu.

config PRINTK_PID
	depends on PRINTK
	default y
	bool "Enable support for Print working task id in dmesg" if EXPERT
	help
	  Print working process id in the dmesg as default, it can be turned
	  off by writing 0 to module parameter pid.

config HTC_DEBUG_BOOTLOADER_LOG
	bool "HTC style ram console debug features"
	default n
	depends on PSTORE_CONSOLE
	help
	  Say Y here if you want the HTC style ram console debug features
```

## drivers/htc_mnemosyne/Kconfig
```kconfig
config HTC_DEBUG_FOOTPRINT
    bool "HTC Debug footprint support"
    depends on CONFIG_ARCH_MSM8996
    default y
    help
      Say yes to enable HTC debug footprint for CPU related function.
```

## drivers/htc_radio/Kconfig
```kconfig
config HTC_RADIO_SMEM
	bool "RADIO SMEM"
	default N
	---help---
	Enable to move htc radio data to shared memory
```

## drivers/hwid/Kconfig
```kconfig
config GAR_HARDWARE_ID
       bool "GAR Hardware ID Module"
       depends on MSM_SMD
       default y
```

## drivers/i2c/chips/Kconfig
```kconfig
#
# Miscellaneous I2C chip drivers configuration
#
# *** DEPRECATED! Do not add new entries! See Makefile ***
#

menu "Miscellaneous I2C Chip support"

config AMP_TFA9888
	tristate "NXP TFA9888 Speaker AMP Driver"
	depends on I2C=y
	help
		NXP TFA9888 Speaker AMP Driver implemented by HTC.

endmenu
```

## drivers/i2c/chips/stmvl53l0/Kconfig
```kconfig
#
# Miscellaneous I2C sensor drivers configuration
#
# *** DEPRECATED! Do not add new entries! See Makefile ***
#

menu "Miscellaneous I2C Chip support"

config LASER_STMVL53L0_SUPPORT
       tristate "ST VL53L0 Laser Sensor"
       depends on I2C
       help
         This driver provides support for VL53L0 Laser Sensor.

endmenu
```

## drivers/input/misc/fpc_fingerprint/Kconfig
```kconfig
#-----------------------------------#
#    Kconfig for FingerprintCard    #
#-----------------------------------#

config FPC_FINGERPRINT
	default n
	tristate "fpc1020 fingerprint driver"
```

## drivers/input/misc/vl53L0/Kconfig
```kconfig
#
# ST VL53L0 Laser Sensor Driver
#

config STMVL53L0
       tristate "ST VL53L0 Laser Sensor"
       depends on I2C
       help
         This driver provides support for VL53L0 Laser Sensor.
```

## drivers/input/misc/vl53L1/Kconfig
```kconfig
#
# ST VL53L1 Laser Sensor Driver
#

config INPUT_STMVL53L1
       tristate "ST VL53L1 Laser Sensor"
       depends on I2C
       help
         This driver provides support for VL53L1 Laser Sensor.
```
